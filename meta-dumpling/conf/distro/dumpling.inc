## meta-tq/conf/machine/include/tqma6dl-mba6x.inc
```bitbake
# Common definitions for TQ-Systems GmbH TQMa6[S,DL] modules on MBa6x

# Common device trees used in linux-imx-qt and linux-tq
KERNEL_DEVICETREE = "\
    imx6dl-mba6a.dtb \
    imx6dl-mba6a-duallvds-tm070jvhg33.dtb \
    imx6dl-mba6a-hdmi.dtb \
    imx6dl-mba6a-lvds-tm070jvhg33.dtb \
        \
    imx6dl-mba6b.dtb \
    imx6dl-mba6b-duallvds-tm070jvhg33.dtb \
    imx6dl-mba6b-hdmi.dtb \
    imx6dl-mba6b-lvds-tm070jvhg33.dtb \
"

KERNEL_DEVICETREE_linux-tq = "\
    imx6dl-mba6a-cdtech-dc44.dtb \
    imx6dl-mba6a-cdtech-fc21.dtb \
    imx6dl-mba6a-lvds-g133han01.dtb \
    imx6dl-mba6a-multi.dtb \
    \
    imx6dl-mba6b-cdtech-dc44.dtb \
    imx6dl-mba6b-cdtech-fc21.dtb \
    imx6dl-mba6b-lvds-g133han01.dtb \
    imx6dl-mba6b-multi.dtb \
"
```

## meta-tq/conf/machine/include/tqma6dl.inc
```bitbake
# Common definitions for TQ-Systems GmbH TQMa6[S,DL] modules

MACHINEOVERRIDES =. "imx:mx6dl:"

require conf/machine/include/tqma6x.inc
```

## meta-tq/conf/machine/include/tqma6q-mba6x.inc
```bitbake
# Common definitions for TQ-Systems GmbH TQMa6[Q,D] modules on MBa6x

# Common device trees used in linux-imx-tq and linux-tq
KERNEL_DEVICETREE = "\
    imx6q-mba6a.dtb \
    imx6q-mba6a-duallvds-tm070jvhg33.dtb \
    imx6q-mba6a-hdmi.dtb \
    imx6q-mba6a-lvds-tm070jvhg33.dtb \
    \
    imx6q-mba6b.dtb \
    imx6q-mba6b-duallvds-tm070jvhg33.dtb \
    imx6q-mba6b-hdmi.dtb \
    imx6q-mba6b-lvds-tm070jvhg33.dtb \
"

KERNEL_DEVICETREE_linux-tq = "\
    imx6q-mba6a-cdtech-dc44.dtb \
    imx6q-mba6a-cdtech-fc21.dtb \
    imx6q-mba6a-multi.dtb \
    \
    imx6q-mba6b-cdtech-dc44.dtb \
    imx6q-mba6b-cdtech-fc21.dtb \
    imx6q-mba6b-multi.dtb \
"
```

## meta-tq/conf/machine/include/tqma6q.inc
```bitbake
# Common definitions for TQ-Systems GmbH TQMa6[Q,D,QP,DP] modules

MACHINEOVERRIDES =. "imx:mx6q:"

require conf/machine/include/tqma6x.inc
```

## meta-tq/conf/machine/include/tqma6ul.inc
```bitbake
# Common definitions for TQ-Systems GmbH TQMa6UL SOM

# optionally source the machine specific features for multimedia etc. from
# meta-freescale

MACHINEOVERRIDES =. "imx:mx6ul:tqma6ulx:"

include conf/machine/include/imx-base.inc

DEFAULTTUNE:mx6ul ?= "cortexa7thf-neon"
require conf/machine/include/arm/armv7a/tune-cortexa7.inc

# Machine specific options
#
MACHINE_EXTRA_RRECOMMENDS += "\
    kernel-devicetree \
    kernel-modules \
    linux-firmware-imx-sdma-imx6q \
"

MACHINE_FEATURES:append = "\
    alsa \
    can \
    ext2 \
    rtc \
    serial \
    usbhost \
    vfat \
    ubi \
"

# TQ u-boot and kernel
#
require conf/machine/include/tqmxx.inc

KERNEL_IMAGETYPE = "zImage"

PREFERRED_PROVIDER_u-boot:tqma6ulx ?= "u-boot-imx-tq"
PREFERRED_PROVIDER_virtual/bootloader:tqma6ulx ?= "u-boot-imx-tq"

UBOOT_SUFFIX:${MACHINE} ?= "imx"
UBOOT_MAKE_TARGET:${MACHINE} ?= "u-boot.imx"

# Image Options
#
EXTRA_IMAGEDEPENDS += "virtual/bootloader"

# Verified values to generate UBI image:
# physical erase block size
UBI_PEB_SIZE = "65536"
UBI_MINIMUM_IO_UNIT_SIZE = "1"
UBI_SUB_PAGE_SIZE = "1"
# UBI_VID_HEADER_OFFSET="64"
# logical erase block size
UBI_LEB_SIZE = "65408"

# we have 64 MB flash, 8 MB for bootloader and env should be enough
# so use 1024 - 128 LEB
UBI_MAX_LEB_COUNT = "896"

MKUBIFS_ARGS = "\
    --min-io-size=${UBI_MINIMUM_IO_UNIT_SIZE} \
    --leb-size=${UBI_LEB_SIZE} \
    --max-leb-cnt=${UBI_MAX_LEB_COUNT} \
"

UBINIZE_ARGS = "\
    --peb-size=${UBI_PEB_SIZE} \
    --min-io-size=${UBI_MINIMUM_IO_UNIT_SIZE} \
    --sub-page-size=${UBI_SUB_PAGE_SIZE} \
"

# needs to be set to have it consistent for kernel command line
# Use the expected value of the ubifs filesystem's volume name in the kernel
# and u-boot.
UBI_VOLNAME = "root"

# Do not update fstab file when using wic images
WIC_CREATE_EXTRA_ARGS ?= "--no-fstab-update"

WKS_FILE_DEPENDS = "\
    mtools-native \
    dosfstools-native \
    parted-native \
    virtual/kernel \
    virtual/bootloader \
"
```

## meta-tq/conf/machine/include/tqma6ulx-mba6ulx.inc
```bitbake
# Common definitions for TQ-Systems GmbH MBa6ULx baseboard for TQMa6ULx SOM

KERNEL_DEVICETREE_linux-imx-tq = "\
    imx6ul-mba6ulx.dtb \
    imx6ul-mba6ulx-g1.dtb \
    imx6ul-mba6ulx-lvds.dtb \
    imx6ul-mba6ulx-dmb-ct21.dtb \
    imx6ul-mba6ulx-dmb-ct44.dtb \
    imx6ul-mba6ulx-glyn-etm0700g0edh6.dtb \
"
KERNEL_DEVICETREE_linux-tq = "\
    imx6ul-tqma6ul1-mba6ulx.dtb \
    imx6ul-tqma6ul2-mba6ulx.dtb \
    imx6ul-tqma6ul2-mba6ulx-cdtech-dc44.dtb \
    imx6ul-tqma6ul2-mba6ulx-cdtech-fc21.dtb \
    imx6ul-tqma6ul2-mba6ulx-lvds.dtb \
"

KERNEL_DEVICETREE += "${@kernel_provider_dtbs(d)}"
```

## meta-tq/conf/machine/include/tqma6ulxl-mba6ulx.inc
```bitbake
# Common definitions for TQ-Systems GmbH MBa6ULx baseboard for TQMa6ULxL SOM

KERNEL_DEVICETREE_linux-imx-tq = "\
    imx6ul-mba6ulx-lga.dtb \
    imx6ul-mba6ulx-lga-lvds.dtb \
    imx6ul-mba6ulx-lga-dmb-ct21.dtb \
    imx6ul-mba6ulx-lga-dmb-ct44.dtb \
    imx6ul-mba6ulx-lga-glyn-etm0700g0edh6.dtb \
"

KERNEL_DEVICETREE_linux-tq = "\
    imx6ul-tqma6ul2l-mba6ulx.dtb \
    imx6ul-tqma6ul2l-mba6ulx-lvds.dtb \
    imx6ul-tqma6ul2l-mba6ulx-cdtech-dc44.dtb \
    imx6ul-tqma6ul2l-mba6ulx-cdtech-fc21.dtb \
"

KERNEL_DEVICETREE += "${@kernel_provider_dtbs(d)}"
```

## meta-tq/conf/machine/include/tqma7x-mba7.inc
```bitbake
# Common definitions for TQ-Systems GmbH MBa7x baseboard for TQMa7x modules

include conf/machine/include/tqma7.inc

SERIAL_CONSOLES = "115200;ttymxc5"

# disable virtual console support for this board and limit getty to SERIAL_CONSOLES only
USE_VT = "0"

KERNEL_DEVICETREE = "\
    imx7d-mba7.dtb \
    imx7d-mba7-lvds.dtb \
    imx7s-mba7.dtb \
    imx7s-mba7-lvds.dtb \
"

KERNEL_DEVICETREE_linux-imx-tq = "\
    imx7d-mba7-dmb-ct21.dtb \
    imx7d-mba7-dmb-ct44.dtb \
    imx7d-mba7-glyn-etm0700g0edh6.dtb \
    imx7s-mba7-dmb-ct21.dtb \
    imx7s-mba7-dmb-ct44.dtb \
    imx7s-mba7-glyn-etm0700g0edh6.dtb \
"

KERNEL_DEVICETREE_linux-tq = "\
    imx7d-mba7-cdtech-fc21.dtb \
    imx7d-mba7-cdtech-dc44.dtb \
    imx7s-mba7-cdtech-fc21.dtb \
    imx7s-mba7-cdtech-dc44.dtb \
"

KERNEL_DEVICETREE += "${@kernel_provider_dtbs(d)}"

# Files are needed in IMAGE_BOOT_FILES because we use an extra partition for
# backward compatibility.
IMAGE_BOOT_FILES = "\
    ${KERNEL_IMAGETYPE};linuximage \
    ${KERNEL_DEVICETREE} \
"

MACHINE_FEATURES += "\
    bluetooth \
    screen \
    touchscreen \
    wifi \
"

# install kernel and devicetree also under /boot inside the rootfs,
# needed for UBIFS use case and perpare removal of extra FAT boot partition
# on SD / e-MMC
MACHINE_EXTRA_RRECOMMENDS += "\
    kernel-devicetree \
    kernel-image \
    linux-firmware-ath10k \
    linux-firmware-qca \
"

WKS_FILE = "tqmaxx-sdimg.wks"

# EXTRA_IMAGEDEPENDS are applied to do_image_complete only. do_image_wic may run
# before and needs those packages as well
WKS_FILE_DEPENDS += "${EXTRA_IMAGEDEPENDS}"
```

## meta-tq/conf/machine/include/tqma8mpxl-mba8mpxl.inc
```bitbake
# Common definitions for TQ-Systems GmbH MBa8MPxL baseboard for TQMa8MPxL modules

require conf/machine/include/tqma8mpxl.inc
require conf/machine/include/mba8-common.inc

# Set u-boot DTB
UBOOT_DTB_NAME = "imx8mp-tqma8mpql-mba8mpxl.dtb"

KERNEL_DEVICETREE = "\
    freescale/imx8mp-tqma8mpql-mba8mpxl.dtb \
"

KERNEL_DEVICETREE_linux-imx-tq = "\
    freescale/imx8mp-tqma8mpql-mba8mpxl-hdmi.dtb \
    freescale/imx8mp-tqma8mpql-mba8mpxl-hdmi-imx327.dtb \
    freescale/imx8mp-tqma8mpql-mba8mpxl-hdmi-ov9281.dtb \
    freescale/imx8mp-tqma8mpql-mba8mpxl-lvds-tm070jvhg33.dtb \
    freescale/imx8mp-tqma8mpql-mba8mpxl-rpmsg.dtb \
"

KERNEL_DEVICETREE_linux-imx-tq:append:mx8mp-nxp-bsp = "\
    ${@bb.utils.contains('MACHINE_FEATURES', 'basler', \
        ' freescale/imx8mp-tqma8mpql-mba8mpxl-lvds-basler.dtb', '', d)} \
"

KERNEL_DEVICETREE += "${@kernel_provider_dtbs(d)}"

MACHINE_FEATURES:append = "\
    bluetooth \
    camera \
    screen \
    touchscreen \
    wifi \
"

MACHINE_EXTRA_RRECOMMENDS += "\
    linux-firmware-ath10k \
    linux-firmware-qca \
    tq-extlinux \
"

# Add packages we want to be deployed, even when they are not part of rootfs
# We need these here to support UBI / NFS boot case
EXTRA_IMAGEDEPENDS += "\
    virtual/imx-cortexm-demos \
    tq-bootscripts \
"

# Set Serial console
SERIAL_CONSOLES = "115200;ttymxc3"

# disable virtual console support for this board and limit getty to SERIAL_CONSOLES only
USE_VT = "0"

CORTEXM_DEMOS += "\
    hello_world.bin \
    rpmsg_lite_pingpong_rtos_linux_remote.bin \
"

IMAGE_BOOT_FILES = "\
    ${@create_image_boot_dtb_files(d)} \
    boot-blockdev.scr;boot.scr \
    ${CORTEXM_DEMOS} \
    ${KERNEL_IMAGETYPE} \
"

# SD boot image and FlexSPI boot image can be built using same U-Boot config
IMXBOOT_TARGETS ?= "\
    flash_evk_flexspi \
    flash_spl_uboot \
"

#
# bootstream name, construction see imx-boot recipe, do_deploy
#
MACHINE_WKS_BOOTSTREAM ?= "imx-boot-${MACHINE}-sd.bin-flash_spl_uboot"
```
