## meta-dumpling/conf/distro/dumpling.inc
```bitbake
require conf/distro/poky.conf
require tq-common.inc

DISTRO_SHORT_NAME = "dumpling"
DISTRO_FEATURES_DEFAULT:remove = "argp irda pcmcia zeroconf x11"
DISTRO_FEATURES = "${DISTRO_FEATURES_DEFAULT} npu opengl systemd"

# add some locales per default
IMAGE_LINGUAS:append = " de-de en-us"

# point some runtime providers to full fledged packages
PREFERRED_PROVIDER_virtual/base-utils = "packagegroup-core-base-utils"
VIRTUAL-RUNTIME_base-utils = "packagegroup-core-base-utils"
VIRTUAL-RUNTIME_base-utils-hwclock = "util-linux-hwclock"
VIRTUAL-RUNTIME_base-utils-lscpu = "util-linux-lscpu"

# strip some unused stuff to lower dependencies, work in progress:

# we do not have firewire support
PACKAGECONFIG_pn_gstreamer1.0-plugin-good:remove = "dv1394"
# at the moment gtk is not used
PACKAGECONFIG_pn_gstreamer1.0-plugin-good:remove = "gtk"

# Conflicts with systemd-networkd
SYSTEMD_AUTO_ENABLE:dhcpcd = "disable"

# TODO: cairo and gdk-pixbuf are default on - if not gstreamer dependencies
# can be removed.
```

## meta-dumpling/conf/distro/tq-common.inc
```bitbake
VENDOR_SHORT_NAME = "tq"
VENDOR_LONG_NAME = "TQ-Systems"
TARGET_VENDOR = "-${VENDOR_SHORT_NAME}"
# should be set to a useful name as soon as we want to go away from
# poky/meta-poky/conf/distro/poky.conf
DISTRO_VERSION ??= "${VENDOR_SHORT_NAME}.0.1"

# The bundle version interacts with the downgrade barrier.
# "r0" as version, disables the downgrade barrier. If a
# downgrade barrier is set with r1, you have to increase
# the version for every update. In that way old security
# vulnerabilities cannot be exploited.
RAUC_BUNDLE_VERSION ?= "r0"

SDK_VENDOR = "-${VENDOR_SHORT_NAME}sdk"
SDK_VERSION := "${DISTRO_VERSION}"
SDK_NAME = "${VENDOR_SHORT_NAME}-${DISTRO}-${TCLIBC}-${SDK_ARCH}-${IMAGE_BASENAME}-${TUNE_PKGARCH}"
SDKPATH = "/opt/${VENDOR_SHORT_NAME}-${DISTRO}/${SDK_VERSION}"

# include the config checker
INHERIT += "sanity"

# run QA tests
INHERIT += "insane"
QA_LOG = "1"

# include the version package
DISTRO_EXTRA_RDEPENDS += "os-release"

# include additional udev rules
DISTRO_EXTRA_RDEPENDS += "tq-udev-rules"

# listed checks from ERROR_QA to WARN_QA (from insane.bbclass)
ERROR_TO_WARN_QA = "version-going-backwards"

VIRTUAL-RUNTIME_dev_manager = "udev"
VIRTUAL-RUNTIME_init_manager = "systemd"
DISTRO_FEATURES_BACKFILL_CONSIDERED += "sysvinit"
VIRTUAL-RUNTIME_login_manager = "busybox"
VIRTUAL-RUNTIME_syslog = ""
VIRTUAL-RUNTIME_initscripts = ""

# home for root is '/root' and nothing else
ROOT_HOME ?= "/root"

IMAGE_FSTYPES ?= " tar.gz"

#
# busybox has prio 50 per default, inetutils has 79
# ping from iputils should have same features as full featured
# busybox ping and has priority of 100
# to prevent installing a crippled ping, decrease prio for inetutils
# implementation, so that we have
# inetutils.ping < busybox.ping < iputils.ping
#
ALTERNATIVE_PRIORITY_inetutils-ping[ping] = "27"
ALTERNATIVE_PRIORITY_inetutils-ping6[ping6] = "27"
```

## meta-dumpling/conf/distro/tq-provider-imx.inc
```bitbake
# This file is used for all distro configs based on imx / fslc-imx kernel and
# vendor software stacks. To make it usable also with distros based on
# poky-tiny we need to add a specific PREFERRED_PROVIDER for virtual/kernel
# since poky-tiny has a hard assignment for linux-yocto-tiny

# variable from meta-freescale
# TODO: QORIQ_DEFAULT_BSP
IMX_DEFAULT_BSP = "nxp"
IMX_DEFAULT_KERNEL = "linux-imx-tq"

PREFERRED_PROVIDER_virtual/kernel ?= "linux-imx-tq"

PREFERRED_PROVIDER_virtual/bootloader = "u-boot-imx-tq"

# machine without drm/kms in fslc BSP have no libgbm
PREFERRED_PROVIDER_virtual/libgbm = ""
PREFERRED_PROVIDER_virtual/libgbm:mx8-nxp-bsp = "imx-gpu-viv"
```

## meta-dumpling/conf/distro/tq-provider-ti.inc
```bitbake
PREFERRED_PROVIDER_virtual/kernel:tqma335x = "linux-ti-tq"
PREFERRED_PROVIDER_virtual/kernel:tqma57xx = "linux-ti-tq"

# Workaround for incorrect SIGGEN_EXCLUDERECIPES_ABISAFE in meta-ti
SIGGEN_EXCLUDERECIPES_ABISAFE:remove = "mesa-pvr"

# Add MLO SD/e-MMC image generation for SOM based on TI SOC
# This image is a stripped down version of the normal .wic, consisting
# only of partition table, boot VFAT containing bootloader image(s)
# and environment for bootloader.

IMAGE_CLASSES += "image_type_bootonly"
IMAGE_FSTYPES += "wic.bootonly"
```

## meta-tq/conf/machine/include/imx-base-extend.inc
```bitbake
# This file is included from meta-freescale/conf/machine/include/imx-base.inc
# and provides a simple mechanism to override settings in the file

# should be removed as soon as meta-freescale has imx93 support

# i.MX 93
MACHINEOVERRIDES_EXTENDER:mx93:use-nxp-bsp  = "imx-generic-bsp:imx-nxp-bsp:imxdrm:imxpxp:mx9-generic-bsp:mx9-nxp-bsp:mx93-generic-bsp:mx93-nxp-bsp"
MACHINEOVERRIDES_EXTENDER_FILTER_OUT += "mx93"
MACHINE_SOCARCH_SUFFIX:mx93-nxp-bsp = "-mx93"

# Graphics libraries
PREFERRED_PROVIDER_virtual/libg2d:mx93-nxp-bsp ?= "imx-pxp-g2d"
PREFERRED_VERSION_wayland-protocols:mx9-nxp-bsp ??= "1.25.imx"
PREFERRED_VERSION_libdrm:mx9-nxp-bsp ??= "2.4.109.imx"
```

## meta-tq/conf/machine/include/mba57xx-common.inc
```bitbake
# Common definitions for TQ-Systems GmbH TQMa57xx modules on MBa57xx

KERNEL_DEVICETREE ?= "\
    am571x-mba57xx.dtb \
    am572x-mba57xx.dtb \
    am574x-mba57xx.dtb \
"

MACHINE_EXTRA_RRECOMMENDS += "\
    kernel-devicetree \
    kernel-modules \
"

MACHINE_FEATURES:append = "\
    screen \
    touchscreen \
"

SERIAL_CONSOLES ?= "115200;ttyS2"

# disable virtual console support for this board and limit getty to SERIAL_CONSOLES only
USE_VT = "0"

# Add packages we want to be deployed, even when they are not part of rootfs
# We need these here to support UBI / NFS boot case
EXTRA_IMAGEDEPENDS += "\
    virtual/bootloader \
"

WKS_FILE = "tqmaxx-ti-sdimg.wks.in"

# EXTRA_IMAGEDEPENDS are applied to do_image_complete only. do_image_wic may run
# before and needs those packages as well
WKS_FILE_DEPENDS += "${EXTRA_IMAGEDEPENDS}"

WIC_BOOTPART_SIZE = "32M"
```

## meta-tq/conf/machine/include/tqma57xx-prueth.inc
```bitbake
MACHINE_EXTRA_RRECOMMENDS += "\
    ${@bb.utils.contains('BBFILE_COLLECTIONS', 'meta-ti-bsp', 'prueth-fw', '', d)} \
"
```

## meta-tq/conf/machine/include/tqma57xx.inc
```bitbake
# Common definitions for TQ-Systems GmbH TQMa57xx modules

# needed for easier compatible / preferred_provider
MACHINEOVERRIDES =. "tqma57xx:"

# Default providers, may need to override for specific machines
# needs to be set before inclusion of am57xx.inc
PREFERRED_PROVIDER_virtual/kernel ?= "linux-ti-tq"
PREFERRED_VERSION_linux-ti-tq ?= "5.10%"
TI_SGX_DDK_KM_KERNVER ?= "5.10"

PREFERRED_PROVIDER_u-boot ?= "u-boot-tq"
PREFERRED_PROVIDER_virtual/bootloader ?= "u-boot-tq"

# from meta-ti-bsp: will handle SOC_FAMILY:append = ":am57xx" needed for TI recipes
include conf/machine/include/am57xx.inc

# prevent inclusion of tune settings if meta-ti is present -
# otherwise we get nasty double inclusion warnings
DEFAULTTUNE ?= "${@bb.utils.contains("BBFILE_COLLECTIONS", "meta-ti-bsp", "", "armv7athf-neon", d)}"
require ${@bb.utils.contains("BBFILE_COLLECTIONS", "meta-ti-bsp", '', 'conf/machine/include/arm/armv7a/tune-cortexa15.inc', d)}

# Machine specific options
#
MACHINE_EXTRA_RRECOMMENDS += "\
    kernel-devicetree \
    kernel-modules \
"

# TQ u-boot and kernel
#
require conf/machine/include/tqmxx.inc

KERNEL_IMAGETYPE ?= "zImage"

UBOOT_ARCH = "arm"
UBOOT_ENTRYPOINT = "0x80008000"
UBOOT_LOADADDRESS = "0x80008000"
SPL_BINARY = "MLO"
UBOOT_SUFFIX = "img"

# we still need this, since meta-ti sets KERNEL_IMAGETYPES to contain uImage
# and forces building this ancient image which forces us to provide this var
KERNEL_EXTRA_ARGS:prepend = "LOADADDR=${UBOOT_ENTRYPOINT} "

# Image Options
#
EXTRA_IMAGEDEPENDS += "virtual/bootloader"

# needs to be set to have it consistent for kernel command line
# Use the expected value of the ubifs filesystem's volume name in the kernel
# and u-boot.
UBI_VOLNAME = "rootfs"

IMAGE_BOOT_FILES = "\
    MLO \
    u-boot.img \
"

# List common SoC features
MACHINE_FEATURES += "\
    apm \
    can \
    dsp \
    ethernet \
    ext2 \
    gpu \
    kernel26 \
    mmip \
    pci \
    screen \
    usbgadget \
    usbhost \
    vfat \
"

# We have no sound support for now.
# Remove the alsa feature, which is added by default in meta-ti
MACHINE_FEATURES:remove = "alsa"
```

## meta-tq/conf/machine/include/tqma62xx-k3r5.inc
```bitbake
# Common definitions for R5 bootloader on TQMa62xx

MACHINEOVERRIDES =. "tqma62xx-k3r5:"

# From meta-ti
require conf/machine/include/k3r5.inc

# The tiboot3.bin filename is built from these variables. The sysfw
# configuration can be adjusted in the U-Boot source.
SYSFW_SOC = "am62x"
SYSFW_CONFIG = "evm"
SYSFW_SUFFIX = "gp"

PREFERRED_PROVIDER_virtual/bootloader = "u-boot-ti-tq"
PREFERRED_PROVIDER_u-boot = "u-boot-ti-tq"
```

## meta-tq/conf/machine/include/tqma64xxl-k3r5-gp.inc
```bitbake
# Common definitions for R5 bootloader on TQMa64xxL (AM64xx GP)

require tqma64xxl-k3r5.inc

# Booting GP requires different SYSFW, the rest is handled at runtime

SOC_FAMILY:append = ":k3r5-gp"

SYSFW_SOC = "am64x"
SYSFW_SUFFIX = "gp"

UBOOT_IMAGE = "u-boot-r5spl-gp-${MAINMACHINE}-${PV}-${PR}.${UBOOT_SUFFIX}"
UBOOT_SYMLINK = "u-boot-r5spl-gp.${UBOOT_SUFFIX}"
```

## meta-tq/conf/machine/include/tqma64xxl-k3r5-sr2-hs-fs.inc
```bitbake
# Common definitions for R5 bootloader on TQMa64xxL (AM64xx SR2.0 HS-FS)

require tqma64xxl-k3r5.inc

# Booting SR2.0 HS-FS requires different SYSFW, the rest is handled at runtime

SOC_FAMILY:append = ":k3r5-sr2-hs-fs"

SYSFW_SOC = "am64x_sr2"
SYSFW_SUFFIX = "hs-fs"

UBOOT_IMAGE = "u-boot-r5spl-sr2-hs-fs-${MAINMACHINE}-${PV}-${PR}.${UBOOT_SUFFIX}"
UBOOT_SYMLINK = "u-boot-r5spl-sf2-hs-fs.${UBOOT_SUFFIX}"
```

## meta-tq/conf/machine/include/tqma64xxl-k3r5-sr2-hs-se.inc
```bitbake
# Common definitions for R5 bootloader on TQMa64xxL (AM64xx SR2.0 HS-SE)

require tqma64xxl-k3r5.inc

# Booting SR2.0 HS-SE requires different SYSFW, the rest is handled at runtime

SOC_FAMILY:append = ":k3r5-sr2-hs-se"

SYSFW_SOC = "am64x_sr2"
SYSFW_SUFFIX = "hs"

UBOOT_IMAGE = "u-boot-r5spl-sr2-hs-se-${MAINMACHINE}-${PV}-${PR}.${UBOOT_SUFFIX}"
UBOOT_SYMLINK = "u-boot-r5spl-sr2-hs-se.${UBOOT_SUFFIX}"
```

## meta-tq/conf/machine/include/tqma64xxl-k3r5.inc
```bitbake
# Common definitions for R5 bootloader on TQMa64xxL

MACHINEOVERRIDES =. "tqma64xxl-k3r5:"

# From meta-ti
require conf/machine/include/k3r5.inc

# The tiboot3.bin filename is built from these variables. The sysfw
# configuration can be adjusted in the U-Boot source.
SYSFW_SOC = "am64x"
SYSFW_CONFIG = "evm"
SYSFW_SUFFIX = "gp"

PREFERRED_PROVIDER_virtual/bootloader = "u-boot-ti-tq"
PREFERRED_PROVIDER_u-boot = "u-boot-ti-tq"

# R5 sysfw and U-Boot are built using the Bitbake MultiConfig feature. To avoid
# conflicts and race conditions, in particular when using the "rm_work" class,
# each of the multiconfigs must use a separate TMPDIR (resulting in directory
# names like "tmp-k3r5").
#
# We still need the alternative multiconfigs to use the same DEPLOY_DIR_IMAGE
# as the main configuration, so the value of that variable is expanded using :=
# before modifying TMPDIR.

MAIN_DEPLOY_DIR_IMAGE := "${DEPLOY_DIR_IMAGE}"
DEPLOY_DIR_IMAGE = "${MAIN_DEPLOY_DIR_IMAGE}"

TMPDIR .= "${@ '-${BB_CURRENT_MC}' if d.getVar('BB_CURRENT_MC') else ''}"
```

## meta-tq/conf/machine/include/tqma64xxl-mbax4xxl-k3r5.inc
```bitbake
# Common definitions for R5 bootloader on TQMa64xxL Module on MBaX4XxL baseboard

UBOOT_MACHINE = "tqma64xxl_mbax4xxl_r5_defconfig"
```

## meta-tq/conf/machine/include/tqma65xx-mba65xx.inc
```bitbake
# Common definitions for TQ-Group TQMa65xx modules on MBa65xx

KERNEL_DEVICETREE = " \
    ti/k3-am654-tqma65xx-mba65xx.dtb \
    ti/k3-am65-tqma65xx-mba65xx-eth-prg0.dtbo \
    ti/k3-am65-tqma65xx-mba65xx-eth-prg1.dtbo \
    ti/k3-am65-tqma65xx-mba65xx-audio.dtbo \
    ti/k3-am65-tqma65xx-mba65xx-lvds-display.dtbo \
    ti/k3-am65-tqma65xx-mba65xx-dmb-dc44.dtbo \
    ti/k3-am65-tqma65xx-mba65xx-dmb-fc21.dtbo \
"

SERIAL_CONSOLES = "115200;ttyS2"

# disable virtual console support for this board and limit getty to SERIAL_CONSOLES only
USE_VT = "0"

# Add packages we want to be deployed, even when they are not part of rootfs
# We need these here to support UBI / NFS boot case
EXTRA_IMAGEDEPENDS += "\
    virtual/bootloader \
"

# Do not update fstab file when using wic images
WIC_CREATE_EXTRA_ARGS ?= "--no-fstab-update"

# EXTRA_IMAGEDEPENDS are applied to do_image_complete only. do_image_wic may run
# before and needs those packages as well
WKS_FILE_DEPENDS += "${EXTRA_IMAGEDEPENDS}"

MACHINE_FEATURES += "\
    screen \
    touchscreen \
"

WKS_FILE = "tqmaxx-ti-sdimg.wks.in"

WIC_BOOTPART_SIZE = "32M"
```

## meta-tq/conf/machine/include/tqma65xx.inc
```bitbake
# Common definitions for TQ-Systems GmbH TQMa65xx modules

# needed for easier compatible / preferred_provider
MACHINEOVERRIDES =. "tqma65xx:"

# Default providers, may need to override for specific machines
# needs to be set before inclusion of am65xx.inc
PREFERRED_PROVIDER_virtual/kernel ?= "linux-ti-tq"
PREFERRED_PROVIDER_u-boot ?= "u-boot-ti-tq"
PREFERRED_PROVIDER_virtual/bootloader ?= "u-boot-ti-tq"

# From meta-ti-bsp: PREFERRED_PROVIDER and tuning
require conf/machine/include/am65xx.inc

# Machine specific options
#
MACHINE_EXTRA_RRECOMMENDS += "\
    kernel-devicetree \
    kernel-modules \
"

# TQ u-boot and kernel
#
require conf/machine/include/tqmxx.inc
KERNEL_IMAGETYPE = "Image"
# TI enforces also fitimage and vmlinux.gz
# this will enlarge our rootfs
KERNEL_IMAGETYPES = "Image"

UBOOT_ARCH = "arm"
UBOOT_ENTRYPOINT = "0x80008000"
UBOOT_LOADADDRESS = "0x80008000"
SPL_BINARY = "tispl.bin"
UBOOT_SUFFIX = "img"

# we still need this, since meta-ti sets KERNEL_IMAGETYPES to contain uImage
# and forces building this ancient image which forces us to provide this var
KERNEL_EXTRA_ARGS:prepend = "LOADADDR=${UBOOT_ENTRYPOINT} "

# Image Options
#
EXTRA_IMAGEDEPENDS += "virtual/bootloader"

#
# dropped in dunfell branch of meta-ti after the kirkstone fork
# see https://git.yoctoproject.org/meta-ti
# commit 1eb6e71f "wic: revert grub-efi patch"
#
MACHINE_FEATURES:remove = "efi"
EFI_PROVIDER = ""

# Verified values to generate UBI image:
# physical erase block size
UBI_PEB_SIZE = "65536"
UBI_MINIMUM_IO_UNIT_SIZE = "1"
UBI_SUB_PAGE_SIZE = "1"
# UBI_VID_HEADER_OFFSET="64"
# logical erase block size
UBI_LEB_SIZE = "65408"

# we have 64 MB flash, 8 MB for bootloader and env should be enough
# so use 1024 - 128 LEB
UBI_MAX_LEB_COUNT = "896"

MKUBIFS_ARGS = "\
    --min-io-size=${UBI_MINIMUM_IO_UNIT_SIZE} \
    --leb-size=${UBI_LEB_SIZE} \
    --max-leb-cnt=${UBI_MAX_LEB_COUNT} \
"

UBINIZE_ARGS = "\
    --peb-size=${UBI_PEB_SIZE} \
    --min-io-size=${UBI_MINIMUM_IO_UNIT_SIZE} \
    --sub-page-size=${UBI_SUB_PAGE_SIZE} \
"

# needs to be set to have it consistent for kernel command line
# Use the expected value of the ubifs filesystem's volume name in the kernel
# and u-boot.
UBI_VOLNAME = "rootfs"

# List common SoC features
MACHINE_FEATURES += "\
    alsa \
    apm \
    can \
    dsp \
    ethernet \
    ext2 \
    gpu \
    kernel26 \
    mmip \
    pci \
    screen \
    sgx \
    ubi \
    usbgadget \
    usbhost \
    vfat \
"
```
