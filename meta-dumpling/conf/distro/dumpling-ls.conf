## meta-dumpling/conf/distro/dumpling-ls.conf
```bitbake
require conf/distro/include/dumpling.inc
require conf/distro/include/tq-provider-ls.inc

DISTRO = "dumpling-ls"
DISTRO_NAME = "Dumpling (TQ-Systems Dumpling Distribution) for TQ-Systems Layerscape BSP"
```

## meta-dumpling/conf/distro/dumpling-nxp.conf
```bitbake
require conf/distro/include/dumpling.inc
require conf/distro/include/tq-provider-imx.inc

DISTRO = "dumpling-nxp"
DISTRO_NAME = "Dumpling (TQ-Systems Dumpling Distribution) for TQ-Systems NXP BSP"
```

## meta-dumpling/conf/distro/dumpling-ti.conf
```bitbake
require conf/distro/include/dumpling.inc
require conf/distro/include/tq-provider-ti.inc

DISTRO = "dumpling-ti"
DISTRO_NAME = "Dumpling (TQ-Systems Dumpling Distribution) for TQ-Systems TI BSP"
```

## meta-dumpling/conf/distro/dumpling-wayland-nxp.conf
```bitbake
require conf/distro/include/dumpling.inc
require conf/distro/include/tq-provider-imx.inc

DISTRO = "dumpling-wayland-nxp"
DISTRO_NAME = "Dumpling Wayland (TQ-Systems Dumpling Wayland Distribution)"
```

## meta-dumpling/conf/distro/dumpling-wayland-ti.conf
```bitbake
require conf/distro/include/dumpling.inc
require conf/distro/include/tq-provider-ti.inc

DISTRO = "dumpling-wayland-ti"
DISTRO_NAME = "Dumpling Wayland (TQ-Systems Dumpling Wayland Distribution for TI BSP)"
```

## meta-dumpling/conf/distro/dumpling-wayland.conf
```bitbake
require conf/distro/include/dumpling.inc
require conf/distro/include/tq-provider-mainline.inc

DISTRO = "dumpling-wayland"
DISTRO_NAME = "Dumpling Wayland (TQ-Systems Dumpling Wayland Distribution)"
```

## meta-dumpling/conf/distro/dumpling.conf
```bitbake
require conf/distro/include/dumpling.inc
require conf/distro/include/tq-provider-mainline.inc

DISTRO = "dumpling"
DISTRO_NAME = "Dumpling (TQ-Systems Dumpling Distribution)"
```

## meta-dumpling/conf/distro/include/dumpling.inc
```bitbake
require conf/distro/poky.conf
require tq-common.inc

DISTRO_SHORT_NAME = "dumpling"
DISTRO_FEATURES_DEFAULT:remove = "argp irda pcmcia zeroconf x11"
DISTRO_FEATURES = "${DISTRO_FEATURES_DEFAULT}"
DISTRO_FEATURES += "npu"
DISTRO_FEATURES += "opengl"
DISTRO_FEATURES += "pam"
DISTRO_FEATURES += "pni-names"
DISTRO_FEATURES += "ppp"
DISTRO_FEATURES += "vulkan"
DISTRO_FEATURES += "wayland"
DISTRO_FEATURES += "wifi"

# add some locales per default
IMAGE_LINGUAS:append = " de-de en-us"

# point some runtime providers to full fledged packages
PREFERRED_PROVIDER_virtual/base-utils = "packagegroup-core-base-utils"
VIRTUAL-RUNTIME_base-utils = "packagegroup-core-base-utils"
VIRTUAL-RUNTIME_base-utils-hwclock = "util-linux-hwclock"
VIRTUAL-RUNTIME_base-utils-lscpu = "util-linux-lscpu"

# Conflicts with systemd-networkd
SYSTEMD_AUTO_ENABLE:dhcpcd = "disable"
```

## meta-dumpling/conf/distro/include/tq-provider-ls.inc
```bitbake
PREFERRED_PROVIDER_virtual/kernel:tqmls1012al ?= "linux-imx-tq"
PREFERRED_PROVIDER_virtual/kernel:tqmls1028a ?= "linux-imx-tq"
PREFERRED_PROVIDER_virtual/kernel:tqmls10xxa ?= "linux-tq"
PREFERRED_PROVIDER_virtual/kernel:tqmlx2160a ?= "linux-tq"

QORIQ_DEFAULT_BSP:tqmls102xa = "mainline"
QORIQ_DEFAULT_BSP:tqmls1028a = "mainline"
```

## meta-dumpling/conf/distro/spaetzle-ls.conf
```bitbake
require conf/distro/include/spaetzle.inc
require conf/distro/include/tq-provider-ls.inc

DISTRO = "spaetzle-ls"
DISTRO_NAME = "Spaetzle (TQ-Systems Spaetzle Distribution) for TQ-Systems Layerscape BSP"
```

## meta-dumpling/conf/distro/spaetzle-nxp.conf
```bitbake
require conf/distro/include/spaetzle.inc
require conf/distro/include/tq-provider-imx.inc

DISTRO = "spaetzle-nxp"
DISTRO_NAME = "Spaetzle (TQ-Systems Spaetzle Distribution) for NXP BSP"
```

## meta-dumpling/conf/distro/spaetzle-ti.conf
```bitbake
require conf/distro/include/spaetzle.inc
require conf/distro/include/tq-provider-ti.inc

DISTRO = "spaetzle-ti"
DISTRO_NAME = "Spaetzle (TQ-Systems Spaetzle Distribution) for TI BSP"
```

## meta-dumpling/conf/distro/spaetzle.conf
```bitbake
require conf/distro/include/spaetzle.inc
require conf/distro/include/tq-provider-mainline.inc

DISTRO = "spaetzle"
DISTRO_NAME = "Spaetzle (TQ-Systems Spaetzle Distribution)"
```

## meta-dumpling/conf/layer.conf
```bitbake
# We have a conf and classes directory, add to BBPATH
BBPATH .= ":${LAYERDIR}"

# We have recipes-* directories, add to BBFILES
BBFILES += "${LAYERDIR}/recipes-*/*/*.bb \
	${LAYERDIR}/recipes-*/*/*.bbappend"

BBFILE_COLLECTIONS += "dumpling"
BBFILE_PATTERN_dumpling = "^${LAYERDIR}/"
BBFILE_PRIORITY_dumpling = "7"

LAYERDEPENDS_dumpling = "core openembedded-layer tq-layer"
LAYERSERIES_COMPAT_dumpling = "wrynose"

BBFILES_DYNAMIC += "\
    chromium-browser-layer:${LAYERDIR}/dynamic-layers/chromium-browser-layer/recipes-*/*/*.bbappend \
    chromium-browser-layer:${LAYERDIR}/dynamic-layers/chromium-browser-layer/recipes-*/*/*.bb \
    freescale-layer:${LAYERDIR}/dynamic-layers/freescale-layer/recipes-*/*/*.bbappend \
    freescale-layer:${LAYERDIR}/dynamic-layers/freescale-layer/recipes-*/*/*.bb \
    qt6-layer:${LAYERDIR}/dynamic-layers/qt6-layer/recipes-*/*/*.bbappend \
    qt6-layer:${LAYERDIR}/dynamic-layers/qt6-layer/recipes-*/*/*.bb \
    rauc:${LAYERDIR}/dynamic-layers/rauc/recipes-*/*/*.bbappend \
    rauc:${LAYERDIR}/dynamic-layers/rauc/recipes-*/*/*.bb \
"

# keep LAYERRECOMMENDS in sync with dynamic layers
# to prevent parsing errors from layer index
LAYERRECOMMENDS_tq-layer = "\
    chromium-browser-layer \
    freescale-layer \
    qt6-layer \
    rauc \
"

DUMPLING_LAYERDIR := "${LAYERDIR}"
```

## meta-tq/conf/machine/include/mba8mx-common.inc
```bitbake
require conf/machine/include/tq-machine.inc

# Set Serial console @ UART3
SERIAL_CONSOLES = "115200;ttymxc2"
# recipe imx-atf-tq: boot / debug UART. i.MX8M families have the same IP base addresses
# for UART3
ATF_IMX_BOOT_UART_BASE ?= "0x30880000"

CORTEXM_DEMOS = "\
    hello_world.bin \
    rpmsg_lite_pingpong_rtos_linux_remote.bin \
"

IMAGE_BOOT_FILES = "\
    ${CORTEXM_DEMOS} \
    ${KERNEL_IMAGETYPE} \
"

MACHINE_FEATURES += "\
    bluetooth \
    camera \
    screen \
    wifi \
"

MACHINE_EXTRA_RRECOMMENDS += "${@bb.utils.contains('COMBINED_FEATURES', 'wifi', 'linux-firmware-ath10k', '', d)}"
MACHINE_EXTRA_RRECOMMENDS += "${@bb.utils.contains('COMBINED_FEATURES', 'bluetooth', 'linux-firmware-qca', '', d)}"

EXTRA_IMAGEDEPENDS += "\
    virtual/imx-cortexm-demos \
"

require tq-distroboot.inc
```
