## conf/machine/include/tqma7.inc
```bitbake
# Common definitions for TQ-Systems GmbH TQMa7x modules

MACHINEOVERRIDES =. "mx7:mx7d:tqma7x:"

# optionally source the machine specific features for multimedia etc. from
# meta-freescale
include conf/machine/include/imx-base.inc

DEFAULTTUNE ?= "cortexa7thf-neon"
require conf/machine/include/tune-cortexa7.inc

# Machine specific options
#
MACHINE_EXTRA_RRECOMMENDS += "kernel-modules kernel-devicetree"
MACHINE_EXTRA_RRECOMMENDS += " linux-firmware-imx-sdma-imx7d"
MACHINE_FEATURES_append = " alsa ext2 pci rtc serial usbhost vfat can ubi"

# TQ u-boot and kernel
#
require conf/machine/include/tqmxx.inc

PREFERRED_PROVIDER_virtual/kernel_tqma7x ?= "linux-imx-tq"
PREFERRED_PROVIDER_virtual/kernel_tqma7x_use-mainline-bsp ?= "linux-tq"
KERNEL_IMAGETYPE = "zImage"

PREFERRED_PROVIDER_u-boot_tqma7x ?= "u-boot-imx-tq"
PREFERRED_PROVIDER_virtual/bootloader_tqma7x ?= "u-boot-imx-tq"

UBOOT_SUFFIX_${MACHINE} ?= "imx"
UBOOT_MAKE_TARGET_${MACHINE} ?= "u-boot.imx"

# Image Options
#
EXTRA_IMAGEDEPENDS += "virtual/bootloader"

# from PTXdist BSP:
# PTXCONF_IMAGE_ROOT_UBIFS_PEB_SIZE="65536"
# PTXCONF_IMAGE_ROOT_UBIFS_MINIMUM_IO_UNIT_SIZE="1"
# PTXCONF_IMAGE_ROOT_UBIFS_SUB_PAGE_SIZE="1"
# PTXCONF_IMAGE_ROOT_UBIFS_VID_HEADER_OFFSET="64"
# PTXCONF_IMAGE_ROOT_UBIFS_LEB_SIZE="65408"

MKUBIFS_ARGS = " -m 1 -e 65408 -c 896 "
UBINIZE_ARGS = " -p 65536 -m 1 -s 1 "
# needs to be set to have it consistent for kernel command line
UBI_VOLNAME = "root"

# Do not update fstab file when using wic images
WIC_CREATE_EXTRA_ARGS ?= "--no-fstab-update"

WKS_FILE_DEPENDS = "\
    mtools-native \
    dosfstools-native \
    parted-native \
    virtual/kernel \
    virtual/bootloader \
    "
```

## conf/machine/include/tqma7x-mba7.inc
```bitbake
# Common definitions for TQ-Systems GmbH MBa7x baseboard for TQMa7x modules

include conf/machine/include/tqma7.inc

SERIAL_CONSOLES = "115200;ttymxc5"

# disable virtual console support for this board and limit getty to SERIAL_CONSOLES only
USE_VT = "0"

KERNEL_DEVICETREE = "\
    imx7d-mba7.dtb \
    imx7d-mba7-lvds.dtb \
    imx7s-mba7.dtb \
    imx7s-mba7-lvds.dtb \
"

KERNEL_DEVICETREE_linux-imx-tq = "\
    imx7d-mba7-dmb-ct21.dtb \
    imx7d-mba7-dmb-ct44.dtb \
    imx7d-mba7-glyn-etm0700g0edh6.dtb \
    imx7s-mba7-dmb-ct21.dtb \
    imx7s-mba7-dmb-ct44.dtb \
    imx7s-mba7-glyn-etm0700g0edh6.dtb \
"

KERNEL_DEVICETREE_linux-tq = "\
    imx7d-mba7-cdtech-fc21.dtb \
    imx7d-mba7-cdtech-dc44.dtb \
    imx7s-mba7-cdtech-fc21.dtb \
    imx7s-mba7-cdtech-dc44.dtb \
"

KERNEL_DEVICETREE_append = " ${@kernel_provider_dtbs(d)} "

# Files are needed in IMAGE_BOOT_FILES because /boot is on an extra partition.
# If those files should be installed under /boot inside the rootfs, you can
# achieve this in your BSP layer adding them via
# IMAGE_INSTALL_append = " kernel-devicetree kernel-image-zimage"
#
IMAGE_BOOT_FILES = "\
    ${KERNEL_IMAGETYPE};linuximage \
    ${KERNEL_DEVICETREE} \
"

WKS_FILE = "tqmaxx-sdimg.wks"

MACHINE_FEATURES_append = "\
    bluetooth \
    wifi \
"

MACHINE_EXTRA_RRECOMMENDS_append = "\
    linux-firmware-ath10k \
    linux-firmware-qca \
"
```

## conf/machine/include/tqma8-common.inc
```bitbake
# Common definitions for all TQ-Systems GmbH TQMa8x / TQMa8Xx / TQMa8Mx /
# TQMa8MxML / TQMa8MxNL / TQMa8MPxL modules

require conf/machine/include/tqmxx.inc

MACHINE_EXTRA_RRECOMMENDS += " kernel-modules kernel-devicetree"

MACHINE_FEATURES += "alsa usbhost rtc serial ext2 ext3 vfat ubi"
MACHINE_FEATURES += "vpu"
MACHINE_FEATURES_remove_mx8mn = "vpu"

PREFERRED_PROVIDER_u-boot-fw-utils_mx8 ?= "u-boot-fw-utils-imx-tq"

PREFERRED_PROVIDER_imx-boot ?= "imx-boot-tq"

KERNEL_IMAGETYPE = "Image"

SPL_BINARY = "spl/u-boot-spl.bin"

PREFERRED_PROVIDER_u-boot_mx8 ?= "u-boot-imx-tq"
PREFERRED_PROVIDER_virtual/bootloader_mx8 ?= "u-boot-imx-tq"

PREFERRED_PROVIDER_virtual/imx-cortexm-demos ?= "tqma8-cortexm-demos"

# provide dt name handling to prevent a lot of copy and paste
# in kernel prefix where to find dtb

KERNEL_DEVICETREE_PATH_PREFIX = "freescale/"

python () {
    dt_list = d.getVar("BOARD_DEVICETREE_FILES").split()
    dt_prefix = d.getVar("KERNEL_DEVICETREE_PATH_PREFIX")
    dt_prefix += "% s"
    dt_list =  [dt_prefix % i for i in dt_list]
    d.setVar("KERNEL_DEVICETREE", ' '.join(dt_list))
}

# Do not update fstab file when using wic images
WIC_CREATE_EXTRA_ARGS ?= "--no-fstab-update"

WKS_FILE ?= "tqma8-sdimg.wks.in"
```

## conf/machine/include/tqma8mpxl-mba8mpxl.inc
```bitbake
# Common definitions for TQ-Systems GmbH MBa8MPxL baseboard for TQMa8MPxL modules

# Set u-boot DTB
UBOOT_DTB_NAME = "imx8mp-mba8mpxl.dtb"

BOARD_DEVICETREE_FILES = "\
    imx8mp-tqma8mpql-mba8mpxl.dtb \
    imx8mp-tqma8mpql-mba8mpxl-hdmi.dtb \
    imx8mp-tqma8mpql-mba8mpxl-hdmi-imx327.dtb \
    imx8mp-tqma8mpql-mba8mpxl-hdmi-ov9281.dtb \
    imx8mp-tqma8mpql-mba8mpxl-lvds-tm070jvhg33.dtb \
    imx8mp-tqma8mpql-mba8mpxl-rpmsg.dtb \
"

KERNEL_DEVICETREE = ""

require conf/machine/include/tqma8-common.inc

MACHINE_FEATURES_append = "\
  wifi \
  camera \
"

# Set Serial console
SERIAL_CONSOLES = "115200;ttymxc3"

# disable virtual console support for this board and limit getty to SERIAL_CONSOLES only
USE_VT = "0"

IMAGE_BOOT_FILES ?= "\
    ${KERNEL_IMAGETYPE} \
    ${BOARD_DEVICETREE_FILES} \
"

# SD boot image and FlexSPI boot image can be built using same U-Boot config
IMXBOOT_TARGETS ?= "flash_spl_uboot flash_evk_flexspi"

IMAGE_BOOT_FILES += "\
    hello_world.bin \
    rpmsg_lite_pingpong_rtos_linux_remote.bin \
"

WKS_FILE_DEPENDS_append = "\
    virtual/imx-cortexm-demos \
"
```

## conf/machine/include/tqma8mpxl.inc
```bitbake
# Common definitions for TQ-Group TQMa8MPxL modules

MACHINEOVERRIDES =. "imx:mx8:mx8m:mx8mp:tqma8mpxl:"

# Don't include kernels in standard images
RDEPENDS_${KERNEL_PACKAGE_NAME}-base = ""

LOADADDR = ""

# Machine specific options
#
MACHINE_FEATURES_append = " pci alsa usbhost can rtc serial ext2 ext3 vfat"

# Set DDR FIRMWARE
DDR_FIRMWARE_NAME = " \
  lpddr4_pmu_train_1d_dmem_202006.bin \
  lpddr4_pmu_train_1d_imem_202006.bin \
  lpddr4_pmu_train_2d_dmem_202006.bin \
  lpddr4_pmu_train_2d_imem_202006.bin \
"

LOADADDR = ""
UBOOT_SUFFIX = "bin"
UBOOT_MAKE_TARGET = ""

# for sdcard image rule
BOOT_SPACE = "65536"
IMAGE_BOOTLOADER = "imx-boot"

# for sdcard + wic image rule
IMX_BOOT_SEEK = "32"
IMX_BOOT_SOC_TARGET = "iMX8MP"

ATF_PLATFORM = "imx8mp"

# TODO:
# optee rule filters for matching machine names and expects at least imx for MX8
#MACHINE_FEATURES_append = " optee"
#OPTEE_BIN_EXT = "8mn"
DISTRO_FEATURES_remove = " optee"
MACHINE_FEATURES_remove = " optee"
IMAGE_INSTALL_remove = " packagegroup-fsl-optee-imx"

# Image Options
#
EXTRA_IMAGEDEPENDS += "u-boot imx-boot"

WKS_FILE_DEPENDS = "\
	mtools-native \
	dosfstools-native \
	parted-native \
	virtual/kernel \
	virtual/bootloader \
	imx-boot \
	"

# optionally source the machine specific features for multimedia etc. from
# meta-freescale

include conf/machine/include/imx-base.inc
require conf/machine/include/tune-cortexa53.inc
```

## conf/machine/include/tqma8mx-mba8mx.inc
```bitbake
# Common definitions for TQ-Systems GmbH MBa8Mx baseboard for TQMa8Mx modules

# Set u-boot DTB
UBOOT_DTB_NAME = "imx8mq-mba8mx.dtb"

BOARD_DEVICETREE_FILES = "\
    imx8mq-tqma8mq-mba8mx.dtb \
    imx8mq-tqma8mq-mba8mx-dcss-hdmi.dtb \
    imx8mq-tqma8mq-mba8mx-dcss-hdmi-ov9281.dtb \
    imx8mq-tqma8mq-mba8mx-dcss-hdmi-imx327.dtb \
    imx8mq-tqma8mq-mba8mx-dcss-lvds-tm070jvhg33.dtb \
    imx8mq-tqma8mq-mba8mx-lcdif-lvds-tm070jvhg33.dtb \
    imx8mq-tqma8mq-mba8mx-rpmsg.dtb \
"

KERNEL_DEVICETREE = ""

require conf/machine/include/tqma8-common.inc

# Set Serial console
SERIAL_CONSOLES = "115200;ttymxc2"

# disable virtual console support for this board and limit getty to SERIAL_CONSOLES only
USE_VT = "0"

IMAGE_BOOT_FILES = "\
    ${KERNEL_IMAGETYPE} \
    ${BOARD_DEVICETREE_FILES} \
"

IMAGE_BOOT_FILES += "\
    hello_world.bin \
    rpmsg_lite_pingpong_rtos_linux_remote.bin \
"

IMXBOOT_TARGETS ?= "flash_hdmi_spl_uboot flash_spl_uboot"

WKS_FILE_DEPENDS_append = "\
    virtual/imx-cortexm-demos \
"

MACHINE_FEATURES_append = "\
    camera \
    display \
    wifi \
"

MACHINE_EXTRA_RRECOMMENDS_append = " linux-firmware-ath10k"
```

## conf/machine/include/tqma8mx.inc
```bitbake
# Common definitions for TQ-Group TQMa8MX modules

MACHINEOVERRIDES =. "imx:mx8:mx8m:mx8mq:tqma8mq:"

# Don't include kernels in standard images
RDEPENDS_${KERNEL_PACKAGE_NAME}-base = ""

LOADADDR = ""

# Machine specific options
#
MACHINE_FEATURES_append = " pci alsa"

# Set DDR FIRMWARE
DDR_FIRMWARE_NAME = "\
  lpddr4_pmu_train_1d_imem.bin \
  lpddr4_pmu_train_1d_dmem.bin \
  lpddr4_pmu_train_2d_imem.bin \
  lpddr4_pmu_train_2d_dmem.bin \
"

LOADADDR = ""
UBOOT_SUFFIX = "bin"
UBOOT_MAKE_TARGET = ""

# for sdcard image rule
BOOT_SPACE = "65536"
IMAGE_BOOTLOADER ?= "imx-boot"

ATF_PLATFORM = "imx8mq"

# for sdcard + wic image rule
IMX_BOOT_SEEK = "33"
IMX_BOOT_SOC_TARGET = "iMX8M"

# TODO:
# optee rule filters for matching machine names and expects at least imx for MX8
#MACHINE_FEATURES_append = " optee"
#OPTEE_BIN_EXT = "8mq"
DISTRO_FEATURES_remove = " optee"
MACHINE_FEATURES_remove = " optee"
IMAGE_INSTALL_remove = " packagegroup-fsl-optee-imx"

# Image Options
#
EXTRA_IMAGEDEPENDS += "u-boot imx-boot"

WKS_FILE_DEPENDS = "\
	mtools-native \
	dosfstools-native \
	parted-native \
	virtual/kernel \
	virtual/bootloader \
	imx-boot \
	"

# optionally source the machine specific features for multimedia etc. from
# meta-freescale

include conf/machine/include/imx-base.inc
require conf/machine/include/tune-cortexa53.inc
```

## conf/machine/include/tqma8mxml-mba8mx.inc
```bitbake
# Common definitions for TQ-Systems GmbH TQMa8MxML modules on MBa8Mx starter kit

require conf/machine/include/tqma8mxml.inc

# Set u-boot DTB
UBOOT_DTB_NAME = "imx8mm-mba8mx.dtb"

BOARD_DEVICETREE_FILES = "\
    imx8mm-tqma8mqml-mba8mx.dtb \
    imx8mm-tqma8mqml-mba8mx-lcdif-lvds-tm070jvhg33.dtb \
    imx8mm-tqma8mqml-mba8mx-lcdif-lvds-tm070jvhg33-imx327.dtb \
    imx8mm-tqma8mqml-mba8mx-lcdif-lvds-tm070jvhg33-ov9281.dtb \
    imx8mm-tqma8mqml-mba8mx-rpmsg.dtb \
"

KERNEL_DEVICETREE = ""

require conf/machine/include/tqma8-common.inc

# Set Serial console
SERIAL_CONSOLES = "115200;ttymxc2"

IMAGE_BOOT_FILES ?= "\
    ${KERNEL_IMAGETYPE} \
    ${BOARD_DEVICETREE_FILES} \
"

MACHINE_FEATURES_append = " camera wifi"

MACHINE_EXTRA_RRECOMMENDS_append = " linux-firmware-ath10k"

IMAGE_BOOT_FILES += "\
    hello_world.bin \
    rpmsg_lite_pingpong_rtos_linux_remote.bin \
"

WKS_FILE_DEPENDS_append = "\
    virtual/imx-cortexm-demos \
"
```

## conf/machine/include/tqma8mxnl.inc
```bitbake
# Common definitions for TQ-Group TQMa8MxNL modules

MACHINEOVERRIDES =. "imx:mx8:mx8m:mx8mn:tqma8mxnl:"

# Don't include kernels in standard images
RDEPENDS_${KERNEL_PACKAGE_NAME}-base = ""

LOADADDR = ""

# Machine specific options
#
MACHINE_FEATURES_append = " pci alsa"

# Set DDR FIRMWARE
DDR_FIRMWARE_NAME = "lpddr4_pmu_train_1d_imem.bin lpddr4_pmu_train_1d_dmem.bin lpddr4_pmu_train_2d_imem.bin lpddr4_pmu_train_2d_dmem.bin"

# Set imx-mkimage boot target
IMX_BOOT_SOC_TARGET = "iMX8MN"

ATF_PLATFORM = "imx8mn"

LOADADDR = ""
UBOOT_SUFFIX = "bin"
UBOOT_MAKE_TARGET = ""

# for sdcard image rule
BOOT_SPACE = "65536"
IMAGE_BOOTLOADER = "imx-boot"

# for sdcard + wic image rule
IMX_BOOT_SEEK = "32"

# TODO:
# optee rule filters for matching machine names and expects at least imx for MX8
#MACHINE_FEATURES_append = " optee"
#OPTEE_BIN_EXT = "8mn"
DISTRO_FEATURES_remove = " optee"
MACHINE_FEATURES_remove = " optee"
IMAGE_INSTALL_remove = " packagegroup-fsl-optee-imx"

# Image Options
#
EXTRA_IMAGEDEPENDS += "u-boot imx-boot"

WKS_FILE_DEPENDS = "\
	mtools-native \
	dosfstools-native \
	parted-native \
	virtual/kernel \
	virtual/bootloader \
	imx-boot \
	"

# optionally source the machine specific features for multimedia etc. from
# meta-freescale

include conf/machine/include/imx-base.inc
require conf/machine/include/tune-cortexa53.inc
```

## conf/machine/include/tqma8qx-common.inc
```bitbake
# Common definitions for all TQ-Group TQMa8QX / TQMa8QXS modules

MACHINEOVERRIDES =. "mx8:mx8qxp:"

require conf/machine/include/arm/arch-arm64.inc

# Don't include kernels in standard images
RDEPENDS_kernel-base = ""

LOADADDR = ""

# Machine specific options
#
MACHINE_EXTRA_RRECOMMENDS = " kernel-modules kernel-devicetree"
MACHINE_FEATURES_append = " pci alsa"

# TQ u-boot and kernel
#
require conf/machine/include/tqmxx.inc

PREFERRED_PROVIDER_virtual/kernel_mx8 ?= "linux-tq"
KERNEL_IMAGETYPE = "Image"

PREFERRED_PROVIDER_u-boot_mx8 ?= "u-boot-tq"
PREFERRED_PROVIDER_virtual/bootloader_mx8 ?= "u-boot-tq"

UBOOT_MAKE_TARGET = "u-boot.bin"
UBOOT_SUFFIX = "bin"

# for sdcard image rule
BOOT_SPACE = "65536"
IMAGE_BOOTLOADER = "imx-boot"

# Image Options
#
EXTRA_IMAGEDEPENDS += "u-boot imx-boot imx-sc-firmware"
IMAGE_FSTYPES_append = " tar.gz ext4 wic"
IMAGE_FSTYPES_remove = " tar.bz2 sdcard.bz2"

# need to have the kernel modules in rootfs
IMAGE_INSTALL_append = " kernel-modules"

# Do not update fstab file when using wic images
WIC_CREATE_EXTRA_ARGS ?= "--no-fstab-update"

# for sdcard image rule
IMX_BOOT_SEEK = "32"

WKS_FILE ?= "tqma8x-b0-sdimg.wks"

do_image_wic[depends] += " \
	mtools-native:do_populate_sysroot \
	dosfstools-native:do_populate_sysroot \
	parted-native:do_populate_sysroot \
	virtual/kernel:do_deploy \
	imx-boot:do_deploy \
	imx-sc-firmware:do_deploy \
	"

# optionally source the machine specific features for multimedia etc. from
# meta-freescale

MACHINEOVERRIDES =. "imx:"

include conf/machine/include/imx-base.inc
```

## conf/machine/include/tqma8qx.inc
```bitbake
# Common definitions for TQ-Group TQMa8QX b0 modules

MACHINEOVERRIDES =. "tqma8qx:"

require conf/machine/include/tqma8qx-common.inc
```

## conf/machine/include/tqma8qxa0.inc
```bitbake
# Common definitions for TQ-Group TQMa8QX A0 modules

MACHINEOVERRIDES =. "mx8:mx8qxp:mx8qxpa0:"

require conf/machine/include/tqma8qx-common.inc

# for sdcard image rule
IMX_BOOT_SEEK = "33"

WKS_FILE ?= "tqma8x-a0-sdimg.wks"
```

## conf/machine/include/tqma8qxs.inc
```bitbake
# Common definitions for TQ-Group TQMa8XxS b0 modules

MACHINEOVERRIDES =. "tqma8qxs:"

require conf/machine/include/tqma8xx-common.inc
```

## conf/machine/include/tqma8x-common.inc
```bitbake
# Common definitions for all TQ-Group TQMa8x modules

MACHINEOVERRIDES =. "mx8:mx8qm:"

# Don't include kernels in standard images
RDEPENDS_${KERNEL_PACKAGE_NAME}-base = ""

LOADADDR = ""

# Machine specific options
#
MACHINE_FEATURES_append = " can pci alsa rtc serial ext2 ext3 vfat usbhost"

PREFERRED_PROVIDER_virtual/imx-cortexm-demos = "tqma8-cortexm-demos"
PREFERRED_PROVIDER_imx-sc-firmware ?= "imx-sc-firmware-tq"

UBOOT_MAKE_TARGET ?= "all"
UBOOT_SUFFIX ?= "bin"

ATF_PLATFORM = "imx8qm"

# for sdcard image rule
BOOT_SPACE = "65536"
IMAGE_BOOTLOADER = "imx-boot"
# for sdcard + wic image rule
IMX_BOOT_SEEK = "32"
IMX_BOOT_SOC_TARGET = "iMX8QM"


# Image Options
#
EXTRA_IMAGEDEPENDS += "u-boot imx-boot imx-sc-firmware"

# Verified values to generate UBI image:
# UBIFS_PEB_SIZE="65536"
# UBIFS_MINIMUM_IO_UNIT_SIZE="1"
# UBIFS_SUB_PAGE_SIZE="1"
# UBIFS_VID_HEADER_OFFSET="64"
# UBIFS_LEB_SIZE="65408"

MKUBIFS_ARGS = " -m 1 -e 65408 -c 896 "
UBINIZE_ARGS = " -p 65536 -m 1 -s 1 "
# needs to be set to have it consistent for kernel command line
UBI_VOLNAME = "root"

WKS_FILE_DEPENDS = "\
	mtools-native \
	dosfstools-native \
	parted-native \
	virtual/kernel \
	virtual/bootloader \
	imx-boot \
	imx-sc-firmware \
	"

# optionally source the machine specific features for multimedia etc. from
# meta-freescale

include conf/machine/include/imx-base.inc
require conf/machine/include/tune-cortexa72-cortexa53.inc

# need to do after imx-base, not included in firmware-imx-8.3
MACHINE_FIRMWARE_remove = "firmware-imx-brcm"
```
