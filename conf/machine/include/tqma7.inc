## conf/machine/include/tqma8x.inc
```bitbake
# Common definitions for TQ-Group TQMa8x b0 modules

MACHINEOVERRIDES =. "tqma8x:"

require conf/machine/include/tqma8x-common.inc

# force to use older version
PREFERRED_VERSION_u-boot-imx-tq_${MACHINE} = "2019.04"
PREFERRED_VERSION_imx-sc-firmware_${MACHINE} = "1.3.1"
PREFERRED_VERSION_imx-atf_${MACHINE} = "2.0"
PREFERRED_VERSION_imx-seco_${MACHINE} = "2.5.6"
```

## conf/machine/include/tqma8xx-common.inc
```bitbake
# Common definitions for all TQ-Group TQMa8Xx / TQMa8XxS modules

MACHINEOVERRIDES =. "mx8:mx8x:mx8qxp:mx8qxpc0:"

# Don't include kernels in standard images
RDEPENDS_${KERNEL_PACKAGE_NAME}-base = ""

LOADADDR = ""

# Machine specific options
#
MACHINE_FEATURES_append = " can pci"

# TQ u-boot and kernel
#
PREFERRED_PROVIDER_imx-sc-firmware ?= "imx-sc-firmware-tq"

UBOOT_MAKE_TARGET ?= "all"
UBOOT_SUFFIX ?= "bin"

ATF_PLATFORM = "imx8qx"

# for sdcard image rule
BOOT_SPACE = "65536"
IMAGE_BOOTLOADER = "imx-boot"
# for sdcard + wic image rule
IMX_BOOT_SEEK = "32"
IMX_BOOT_SOC_TARGET = "iMX8QX"

# Image Options
#
EXTRA_IMAGEDEPENDS += "u-boot imx-boot imx-sc-firmware"

# Verified values to generate UBI image:
# UBIFS_PEB_SIZE="65536"
# UBIFS_MINIMUM_IO_UNIT_SIZE="1"
# UBIFS_SUB_PAGE_SIZE="1"
# UBIFS_VID_HEADER_OFFSET="64"
# UBIFS_LEB_SIZE="65408"

MKUBIFS_ARGS = " -m 1 -e 65408 -c 896 "
UBINIZE_ARGS = " -p 65536 -m 1 -s 1 "
# needs to be set to have it consistent for kernel command line
UBI_VOLNAME = "root"

WKS_FILE_DEPENDS = "\
	mtools-native \
	dosfstools-native \
	parted-native \
	virtual/kernel \
	virtual/bootloader \
	imx-boot \
	imx-sc-firmware \
	"

# optionally source the machine specific features for multimedia etc. from
# meta-freescale

include conf/machine/include/imx-base.inc
require conf/machine/include/tune-cortexa35.inc

# need to do after imx-base, not included in firmware-imx-8.3
MACHINE_FIRMWARE_remove = "firmware-imx-brcm"
```

## conf/machine/include/tqma8xx.inc
```bitbake
# Common definitions for TQ-Systems GmbH TQMa8Xx b0 modules

MACHINEOVERRIDES =. "tqma8xx:"

require conf/machine/include/tqma8xx-common.inc
```

## conf/machine/include/tqma8xxs-mb-smarc-2-common.inc
```bitbake
# shared definitions for MB-SMARC-2 mainboard

# We have to disable SERIAL_CONSOLE due to auto-serial-console
SERIAL_CONSOLES = "115200;ttyLP0"

# we do not want to have getty running on tty1 as we run
# auto-serial-console there
USE_VT = "0"
```

## conf/machine/include/tqma8xxs.inc
```bitbake
# Common definitions for TQ-Group TQMa8XxS b0 modules

MACHINEOVERRIDES =. "tqma8xxs:"

require conf/machine/include/tqma8xx-common.inc

# force to use older version
PREFERRED_VERSION_u-boot-imx-tq_${MACHINE} = "2019.04"
PREFERRED_VERSION_imx-sc-firmware_${MACHINE} = "1.3.1"
PREFERRED_VERSION_imx-atf_${MACHINE} = "2.0"
PREFERRED_VERSION_imx-seco_${MACHINE} = "2.5.6"
```

## conf/machine/include/tqmarzg2h.inc
```bitbake
require conf/machine/include/tqmarzg2x.inc

SOC_FAMILY = "r8a774e1"
MACHINEOVERRIDES =. "r8a774e1:tqmarzg2h:"

DEFAULTTUNE ?= "cortexa57-cortexa53"
TUNE_CONF ?= "conf/machine/include/tune-cortexa57-cortexa53.inc"
require conf/machine/include/${SOC_FAMILY}.inc
require ${TUNE_CONF}
```

## conf/machine/include/tqmarzg2h_c-mbarzg2x.inc
```bitbake
# Common definitions for TQ-Group TQMaRZG2H_C module on MBaRZG2x

# Device tree for RZG2H
KERNEL_DEVICETREE = " \
	renesas/r8a774e1-tqmarzg2h_c-mbarzg2x.dtb \
	renesas/r8a774e1-tqmarzg2h_c-mbarzg2x-lvds-tm070jvhg33.dtb \
"

# RZG2M u-boot configure
UBOOT_CONFIG ??= "tqmarzg2h_c-mbarzg2x"
UBOOT_CONFIG[tqmarzg2h_c-mbarzg2x] = "tqmarzg2h_c-mbarzg2x_defconfig"

# Files are needed in IMAGE_BOOT_FILES because /boot is on an extra partition.
# If those files should be installed under /boot inside the rootfs, you can
# achieve this in your BSP layer adding them via
# IMAGE_INSTALL_append = " kernel-devicetree kernel-image-zimage"
#
IMAGE_BOOT_FILES ?= "\
	${KERNEL_IMAGETYPE} \
	r8a774e1-tqmarzg2h_c-mbarzg2x.dtb \
	r8a774e1-tqmarzg2h_c-mbarzg2x-lvds-tm070jvhg33.dtb \
"
```

## conf/machine/include/tqmarzg2h_c.inc
```bitbake
require conf/machine/include/tqmarzg2x.inc

SOC_FAMILY = "r8a774e1"
MACHINEOVERRIDES =. "r8a774e1:tqmarzg2h_c:"
```

## conf/machine/include/tqmarzg2m_aa-mbarzg2x.inc
```bitbake
# Common definitions for TQ-Group TQMaRZG2M_AA module on MBaRZG2x

# Device tree for RZG2M
KERNEL_DEVICETREE = " \
	renesas/r8a774a1-tqmarzg2m_aa-mbarzg2x.dtb \
	renesas/r8a774a1-tqmarzg2m_aa-mbarzg2x-lvds-tm070jvhg33.dtb \
"

# RZG2M u-boot configure
UBOOT_CONFIG ??= "tqmarzg2m_aa-mbarzg2x"
UBOOT_CONFIG[tqmarzg2m_aa-mbarzg2x] = "tqmarzg2m_aa-mbarzg2x_defconfig"

# Files are needed in IMAGE_BOOT_FILES because /boot is on an extra partition.
# If those files should be installed under /boot inside the rootfs, you can
# achieve this in your BSP layer adding them via
# IMAGE_INSTALL_append = " kernel-devicetree kernel-image-zimage"
#
IMAGE_BOOT_FILES ?= "\
	${KERNEL_IMAGETYPE} \
	r8a774a1-tqmarzg2m_aa-mbarzg2x.dtb \
	r8a774a1-tqmarzg2m_aa-mbarzg2x-lvds-tm070jvhg33.dtb \
"
```

## conf/machine/include/tqmarzg2m_aa.inc
```bitbake
require conf/machine/include/tqmarzg2x.inc

SOC_FAMILY = "r8a774a1"
MACHINEOVERRIDES =. "r8a774a1:tqmarzg2m_aa:"
```

## conf/machine/include/tqmarzg2m_e.inc
```bitbake
require conf/machine/include/tqmarzg2x.inc

SOC_FAMILY = "r8a774a1"
MACHINEOVERRIDES =. "r8a774a1:tqmarzg2m_e:"

DEFAULTTUNE ?= "cortexa57-cortexa53"
TUNE_CONF ?= "conf/machine/include/tune-cortexa57-cortexa53.inc"
require conf/machine/include/${SOC_FAMILY}.inc
require ${TUNE_CONF}
```
