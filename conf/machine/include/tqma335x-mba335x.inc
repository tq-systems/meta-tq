## conf/machine/include/tqma6ul.inc
```bitbake
# Common definitions for TQ-Systems GmbH TQMa6UL SOM

# optionally source the machine specific features for multimedia etc. from
# meta-freescale

MACHINEOVERRIDES =. "imx:mx6:mx6ul:tqma6ulx:"

include conf/machine/include/imx-base.inc

DEFAULTTUNE ?= "cortexa7thf-neon"
require conf/machine/include/tune-cortexa7.inc

# Machine specific options
#
MACHINE_EXTRA_RRECOMMENDS += "kernel-modules kernel-devicetree"
MACHINE_EXTRA_RRECOMMENDS += " linux-firmware-imx-sdma-imx6q"
MACHINE_FEATURES_append = " alsa ext2 rtc serial usbhost vfat can ubi"

# TQ u-boot and kernel
#
require conf/machine/include/tqmxx.inc

PREFERRED_PROVIDER_virtual/kernel ??= "linux-imx-tq"
PREFERRED_PROVIDER_virtual/kernel_use-mainline-bsp ??= "linux-tq"
KERNEL_IMAGETYPE = "zImage"

PREFERRED_PROVIDER_u-boot_tqma6ulx ?= "u-boot-imx-tq"
PREFERRED_PROVIDER_virtual/bootloader_tqma6ulx ?= "u-boot-imx-tq"

UBOOT_SUFFIX_${MACHINE} ?= "imx"
UBOOT_MAKE_TARGET_${MACHINE} ?= "u-boot.imx"

UBOOT_CONFIG ?= "sd qspi"


# Image Options
#
EXTRA_IMAGEDEPENDS += "virtual/bootloader"

# from PTXdist BSP:
# PTXCONF_IMAGE_ROOT_UBIFS_PEB_SIZE="65536"
# PTXCONF_IMAGE_ROOT_UBIFS_MINIMUM_IO_UNIT_SIZE="1"
# PTXCONF_IMAGE_ROOT_UBIFS_SUB_PAGE_SIZE="1"
# PTXCONF_IMAGE_ROOT_UBIFS_VID_HEADER_OFFSET="64"
# PTXCONF_IMAGE_ROOT_UBIFS_LEB_SIZE="65408"

MKUBIFS_ARGS = " -m 1 -e 65408 -c 896 "
UBINIZE_ARGS = " -p 65536 -m 1 -s 1 "
# needs to be set to have it consistent for kernel command line
UBI_VOLNAME = "root"

# Do not update fstab file when using wic images
WIC_CREATE_EXTRA_ARGS ?= "--no-fstab-update"

WKS_FILE_DEPENDS = "\
    mtools-native \
    dosfstools-native \
    parted-native \
    virtual/kernel \
    virtual/bootloader \
"

# TODO:
#IMAGE_INSTALL_append = " kernel-devicetree kernel-image-zimage"
```

## conf/machine/include/tqma6ull.inc
```bitbake
# Common definitions for TQ-Group TQMa6ULL modules

MACHINEOVERRIDES =. "mx6:mx6ull:tqma6ullx:"

DEFAULTTUNE ?= "cortexa7thf-neon"
require conf/machine/include/tune-cortexa7.inc

# Machine specific options
#
MACHINE_EXTRA_RRECOMMENDS = " kernel-modules kernel-devicetree"
MACHINE_FEATURES_append = " alsa ext2 rtc serial usbhost vfat"

# TQ u-boot and kernel
#
require conf/machine/include/tqmxx.inc

PREFERRED_PROVIDER_virtual/kernel = "linux-tq"
KERNEL_IMAGETYPE = "zImage"

PREFERRED_PROVIDER_u-boot = "u-boot-tq"
PREFERRED_PROVIDER_virtual/bootloader = "u-boot-tq"

UBOOT_SUFFIX ?= "imx"
UBOOT_MAKE_TARGET ?= "u-boot.imx"

UBOOT_CONFIG = "sd qspi"

# Image Options
#
EXTRA_IMAGEDEPENDS += "virtual/bootloader"
IMAGE_FSTYPES ?= "tar.gz ext4 wic ubi"

DISTRO_FEATURES_remove += "${@bb.utils.contains('IMAGE_FSTYPES', 'ubi', 'wayland weston x11', '', d)}"

# needed for Rootfs on QSPI
IMAGE_INSTALL_append = " mtd-utils-jffs2 mtd-utils-ubifs mtd-utils-misc"
# need to have the kernel modules in rootfs
IMAGE_INSTALL_append = " kernel-modules"

# from PTXdist BSP:
# PTXCONF_IMAGE_ROOT_UBIFS_PEB_SIZE="65536"
# PTXCONF_IMAGE_ROOT_UBIFS_MINIMUM_IO_UNIT_SIZE="1"
# PTXCONF_IMAGE_ROOT_UBIFS_SUB_PAGE_SIZE="1"
# PTXCONF_IMAGE_ROOT_UBIFS_VID_HEADER_OFFSET="64"
# PTXCONF_IMAGE_ROOT_UBIFS_LEB_SIZE="65408"

MKUBIFS_ARGS = " -m 1 -e 65408 -c 896 "
UBINIZE_ARGS = " -p 65536 -m 1 -s 1 "
# needs to be set to have it consistent for kernel command line
UBI_VOLNAME = "root"

WKS_FILE_DEPENDS = "\
	mtools-native \
	dosfstools-native \
	parted-native \
	virtual/kernel \
	virtual/bootloader \
	"

# TODO:
#IMAGE_INSTALL_append = " kernel-devicetree kernel-image-zimage"

# optionally source the machine specific features for multimedia etc. from
# meta-freescale
include conf/machine/include/imx-base.inc
```

## conf/machine/include/tqma6ullx-mba6ulx.inc
```bitbake
# Common definitions for TQ-Systems GmbH MBa6ULx baseboard for TQMa6ULLx SOM

KERNEL_DEVICETREE_linux-imx-tq = "\
    imx6ull-mba6ulx.dtb \
    imx6ull-mba6ulx-lvds.dtb \
    imx6ull-mba6ulx-dmb-ct21.dtb \
    imx6ull-mba6ulx-dmb-ct44.dtb \
    imx6ull-mba6ulx-glyn-etm0700g0edh6.dtb \
"

KERNEL_DEVICETREE_linux-tq = "\
    imx6ull-tqma6ull2-mba6ulx.dtb \
    imx6ull-tqma6ull2-mba6ulx-lvds.dtb \
    imx6ull-tqma6ull2-mba6ulx-cdtech-dc44.dtb \
    imx6ull-tqma6ull2-mba6ulx-cdtech-fc21.dtb \
"

KERNEL_DEVICETREE:append = " ${@kernel_provider_dtbs(d)} "
```

## conf/machine/include/tqma6ulx-mba6ulx.inc
```bitbake
# Common definitions for TQ-Systems GmbH MBa6ULx baseboard for TQMa6ULx SOM

SERIAL_CONSOLES = "115200;ttymxc0"

# disable virtual console support for this board and limit getty to SERIAL_CONSOLES only
USE_VT = "0"

KERNEL_DEVICETREE_linux-imx-tq = "\
    imx6ul-mba6ulx.dtb \
    imx6ul-mba6ulx-g1.dtb \
    imx6ul-mba6ulx-lvds.dtb \
    imx6ul-mba6ulx-dmb-ct21.dtb \
    imx6ul-mba6ulx-dmb-ct44.dtb \
    imx6ul-mba6ulx-glyn-etm0700g0edh6.dtb \
"
KERNEL_DEVICETREE_linux-tq = "\
    imx6ul-tqma6ul1-mba6ulx.dtb \
    imx6ul-tqma6ul2-mba6ulx.dtb \
    imx6ul-tqma6ul2-mba6ulx-cdtech-dc44.dtb \
    imx6ul-tqma6ul2-mba6ulx-cdtech-fc21.dtb \
    imx6ul-tqma6ul2-mba6ulx-lvds.dtb \
"

KERNEL_DEVICETREE_append = " ${@kernel_provider_dtbs(d)} "

# Files are needed in IMAGE_BOOT_FILES because /boot is on an extra partition.
# If those files should be installed under /boot inside the rootfs, you can
# achieve this in your BSP layer adding them via
# IMAGE_INSTALL_append = " kernel-devicetree kernel-image-zimage"
#
IMAGE_BOOT_FILES = "\
    ${KERNEL_IMAGETYPE};linuximage \
    ${KERNEL_DEVICETREE} \
"

WKS_FILE = "tqmaxx-sdimg.wks"

MACHINE_FEATURES_append = "\
    display \
    wifi \
"

MACHINE_EXTRA_RRECOMMENDS += "linux-firmware-ath10k"
```

## conf/machine/include/tqma6ulxl-mba6ulx.inc
```bitbake
# Common definitions for TQ-Systems GmbH MBa6ULx baseboard for TQMa6ULxL SOM

SERIAL_CONSOLES = "115200;ttymxc0"

# disable virtual console support for this board and limit getty to SERIAL_CONSOLES only
USE_VT = "0"

KERNEL_DEVICETREE_linux-imx-tq = "\
    imx6ul-mba6ulx-lga.dtb \
    imx6ul-mba6ulx-lga-lvds.dtb \
    imx6ul-mba6ulx-lga-dmb-ct21.dtb \
    imx6ul-mba6ulx-lga-dmb-ct44.dtb \
    imx6ul-mba6ulx-lga-glyn-etm0700g0edh6.dtb \
"

KERNEL_DEVICETREE_linux-tq = "\
    imx6ul-tqma6ul2l-mba6ulx.dtb \
    imx6ul-tqma6ul2l-mba6ulx-lvds.dtb \
    imx6ul-tqma6ul2l-mba6ulx-cdtech-dc44.dtb \
    imx6ul-tqma6ul2l-mba6ulx-cdtech-fc21.dtb \
"

KERNEL_DEVICETREE_append = " ${@kernel_provider_dtbs(d)} "

# Files are needed in IMAGE_BOOT_FILES because /boot is on an extra partition.
# If those files should be installed under /boot inside the rootfs, you can
# achieve this in your BSP layer adding them via
# IMAGE_INSTALL_append = " kernel-devicetree kernel-image-zimage"
#
IMAGE_BOOT_FILES = "\
    ${KERNEL_IMAGETYPE};linuximage \
    ${KERNEL_DEVICETREE} \
"

WKS_FILE = "tqmaxx-sdimg.wks"

MACHINE_FEATURES_append = "\
    bluetooth \
    display \
    wifi \
"

MACHINE_EXTRA_RRECOMMENDS_append = "\
    linux-firmware-ath10k \
    linux-firmware-qca \
"
```

## conf/machine/include/tqma6x.inc
```bitbake
# Common definitions for TQ-Systems GmbH TQMa6 modules

# optionally source the machine specific features for multimedia etc. from
# meta-freescale

MACHINEOVERRIDES =. "imx:mx6:tqma6x:"

include conf/machine/include/imx-base.inc

DEFAULTTUNE:imx6 ?= "cortexa9thf-neon"
require conf/machine/include/arm/armv7a/tune-cortexa9.inc

# Machine specific options
#
MACHINE_EXTRA_RRECOMMENDS += "\
    firmware-imx-vpu-imx6d \
    firmware-imx-vpu-imx6q \
    kernel-devicetree \
    kernel-modules \
    linux-firmware-imx-sdma-imx6q \
"

MACHINE_FEATURES += "\
    alsa \
    can \
    ext2 \
    pci \
    rtc \
    serial \
    ubi \
    usbhost \
    vfat \
    vpu \
"

# TQ u-boot and kernel
#
require conf/machine/include/tqmxx.inc

KERNEL_IMAGETYPE = "zImage"

PREFERRED_PROVIDER_u-boot:tqma6x ?= "u-boot-imx-tq"
PREFERRED_PROVIDER_virtual/bootloader:tqma6x ?= "u-boot-imx-tq"

UBOOT_SUFFIX:tqma6x ?= "imx"
UBOOT_MAKE_TARGET:tqma6x ?= "u-boot.imx"

# Image Options
#
EXTRA_IMAGEDEPENDS += "virtual/bootloader"

# Do not update fstab file when using wic images
WIC_CREATE_EXTRA_ARGS ?= "--no-fstab-update"

WKS_FILE_DEPENDS = "\
    mtools-native \
    dosfstools-native \
    parted-native \
    virtual/kernel \
    virtual/bootloader \
"
```
