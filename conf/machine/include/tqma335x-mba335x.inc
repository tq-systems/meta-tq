## conf/machine/include/tqma335x-mba335x.inc
```bitbake
# Common definitions for TQ-Systems GmbH TQMa335x modules on MBA335x board

KERNEL_DEVICETREE = "\
    am335x-mba335x.dtb \
    am335x-mba335x-dmb-ct44.dtb \
    am335x-mba335x-glyn-etm0700.dtb \
    am335x-mba335x-lvds-g104x1.dtb \
"

# install also under /boot inside the rootfs, needed for UBIFS use case
# and because kernel / DTB in extra FAT boot partition on SD / e-MMC shall be
# removed in future
IMAGE_INSTALL:append = "\
    kernel-devicetree \
    kernel-image \
"

IMAGE_BOOT_FILES:append = "\
    ${KERNEL_IMAGETYPE};linuximage \
    ${KERNEL_DEVICETREE} \
"

MACHINE_FEATURES:append = "\
    display \
"

MACHINE_EXTRA_RRECOMMENDS += "${@bb.utils.contains('BBFILE_COLLECTIONS', 'meta-ti', 'ti-sgx-ddk-km', '', d)}"

SERIAL_CONSOLES ?= "115200;ttyS4"

# disable virtual console support for this board and limit getty to SERIAL_CONSOLES only
USE_VT = "0"

WKS_FILE = "tqmaxx-ti-sdimg.wks"
```

## conf/machine/include/tqma335x.inc
```bitbake
# Common definitions for TQ-Systems GmbH TQMa335x modules
# optional from meta-ti
# will handle SOC_FAMILY_append ?= ":ti33x" needed for TI recipes
include conf/machine/include/ti33x.inc

# needed for easier compatible / preferred_provider
MACHINEOVERRIDES =. "tqma335x:"

# prevent inclusion if meta-ti is present - otherwise we get nasty double inclusion warnings
DEFAULTTUNE ?= "${@bb.utils.contains("BBFILE_COLLECTIONS", "meta-ti", "", "armv7athf-neon", d)}"
require ${@bb.utils.contains("BBFILE_COLLECTIONS", "meta-ti", '', 'conf/machine/include/tune-cortexa8.inc', d)}

# Machine specific options
#
MACHINE_EXTRA_RRECOMMENDS += "kernel-modules kernel-devicetree"

# TQ u-boot and kernel
#
require conf/machine/include/tqmxx.inc

PREFERRED_PROVIDER_virtual/kernel ??= "linux-ti-tq"
KERNEL_IMAGETYPE ?= "zImage"

PREFERRED_PROVIDER_u-boot_tqma335x ?= "u-boot-tq"
PREFERRED_PROVIDER_virtual/bootloader_tqma335x ?= "u-boot-tq"

UBOOT_ARCH = "arm"
UBOOT_ENTRYPOINT = "0x80008000"
UBOOT_LOADADDRESS = "0x80008000"
UBOOT_SUFFIX ?= "img"
SPL_BINARY = "MLO"

# we still need this, since meta-ti sets KERNEL_IMAGETYPES to contain uImage
# and forces building this ancient image which forces us to provide this var
KERNEL_EXTRA_ARGS_prepend = "LOADADDR=${UBOOT_ENTRYPOINT} "

# Image Options
#
EXTRA_IMAGEDEPENDS += "virtual/bootloader"

# note: These settings are only usable with larger SPI NOR
# ubinize PEB_SIZE="65536"
# ubinize MINIMUM_IO_UNIT_SIZE="1"
# ubinize SUB_PAGE_SIZE="1"
# mkubifs VID_HEADER_OFFSET="64"
# mkubifs LEB_SIZE="65408"

MKUBIFS_ARGS = " -m 1 -e 65408 -c 896 "
UBINIZE_ARGS = " -p 65536 -m 1 -s 1 "
# needs to be set to have it consistent for kernel command line
UBI_VOLNAME = "root"

IMAGE_BOOT_FILES = "\
    MLO \
    u-boot.img \
"

# Do not update fstab file when using wic images
WIC_CREATE_EXTRA_ARGS ?= "--no-fstab-update"

# List common SoC features

MACHINE_FEATURES_append = "\
    alsa \
    apm \
    can \
    dsp \
    ethernet \
    ext2 \
    gpu \
    kernel26 \
    mmip \
    screen \
    sgx \
    ubi \
    usbgadget \
    usbhost \
    vfat \
"
```

## conf/machine/include/tqma57xx-mba57xx.inc
```bitbake
# Common definitions for TQ-Systems GmbH TQMa57xx modules on MBa57xx

KERNEL_DEVICETREE ?= " \
    am571x-mba57xx.dtb \
    am571x-mba57xx-cdtech-dc44.dtb \
    am571x-mba57xx-edt-etm0700g0edh6.dtb \
    am571x-mba57xx-tianma-tm070jvhg33.dtb \
    am572x-mba57xx.dtb \
    am572x-mba57xx-cdtech-dc44.dtb \
    am572x-mba57xx-edt-etm0700g0edh6.dtb \
    am572x-mba57xx-tianma-tm070jvhg33.dtb \
    am574x-mba57xx.dtb \
    am574x-mba57xx-cdtech-dc44.dtb \
    am574x-mba57xx-edt-etm0700g0edh6.dtb \
    am574x-mba57xx-tianma-tm070jvhg33.dtb \
"

# Files are needed in IMAGE_BOOT_FILES because /boot is on an extra partition.
# If those files should be installed under /boot inside the rootfs, you can
# achieve this in your BSP layer adding them via
# IMAGE_INSTALL_append = " kernel-devicetree kernel-image-zimage"
#
IMAGE_BOOT_FILES_append = "\
    ${KERNEL_IMAGETYPE};linuximage \
    ${KERNEL_DEVICETREE} \
"

SERIAL_CONSOLES ?= "115200;ttyS2"

WKS_FILE ?= "tqma57xx_tqma335x-sdimg.wks"
```

## conf/machine/include/tqma57xx-prueth.inc
```bitbake
EXTRA_IMAGEDEPENDS += "\
	${@bb.utils.contains('BBFILE_COLLECTIONS', 'meta-ti', ' prueth-fw', '', d)} \
"
```

## conf/machine/include/tqma57xx.inc
```bitbake
# Common definitions for TQ-Group TQMa57xx modules
# optional from meta-ti
# will handle SOC_FAMILY_append ?= ":dra7xx" needed for TI recipes
include conf/machine/include/dra7xx.inc

# needed for easier compatible / preferred_provider
MACHINEOVERRIDES =. "tqma57xx:"

MACHINE_FEATURES += "pci"

# prevent inclusion if meta-ti is present - otherwise we get nasty double inclusion warnings
DEFAULTTUNE ?= "${@bb.utils.contains("BBFILE_COLLECTIONS", "meta-ti", "", "armv7athf-neon", d)}"
require ${@bb.utils.contains("BBFILE_COLLECTIONS", "meta-ti", '', 'conf/machine/include/tune-cortexa15.inc', d)}

# Machine specific options
#
MACHINE_EXTRA_RRECOMMENDS += "kernel-modules kernel-devicetree"

# TQ u-boot and kernel
#
require conf/machine/include/tqmxx.inc

PREFERRED_PROVIDER_virtual/kernel_tqma57xx ?= "linux-tq"
KERNEL_IMAGETYPE ?= "zImage"

PREFERRED_PROVIDER_u-boot_tqma57xx ?= "u-boot-tq"
PREFERRED_PROVIDER_virtual/bootloader_tqma57xx ?= "u-boot-tq"

UBOOT_ARCH = "arm"
UBOOT_ENTRYPOINT = "0x80008000"
UBOOT_LOADADDRESS = "0x80008000"
UBOOT_SUFFIX ?= "img"

# Image Options
#
EXTRA_IMAGEDEPENDS += "virtual/bootloader"

IMAGE_INSTALL_append = " kernel kernel-modules"
IMAGE_INSTALL_append = " kernel-devicetree kernel-image-zimage"

IMAGE_BOOT_FILES = "\
	MLO \
	u-boot.img \
	${KERNEL_IMAGETYPE} \
"

IMAGE_FSTYPES ?= "tar.gz ext4 wic"

# Do not update fstab file when using wic images
WIC_CREATE_EXTRA_ARGS ?= "--no-fstab-update"

WKS_FILE_DEPENDS = "\
	mtools-native \
	dosfstools-native \
	parted-native \
	virtual/kernel \
	virtual/bootloader \
	"

# Use the expected value of the ubifs filesystem's volume name in the kernel
# and u-boot.
UBI_VOLNAME = "rootfs"

# List common SoC features
MACHINE_FEATURES = "kernel26 apm usbgadget usbhost vfat ext2 screen alsa ethernet sgx mmip dsp"
```

## conf/machine/include/tqma64xxl-pru.inc
```bitbake
# AM64x uses the prueth of AM65x as well
MACHINE_EXTRA_RRECOMMENDS += " \
    prueth-fw-am65x-sr2 \
"
```

## conf/machine/include/tqma64xxl.inc
```bitbake
# Common definitions for TQ-Systems GmbH TQMa64xxL modules

# needed for easier compatible / preferred_provider
MACHINEOVERRIDES =. "tqma64xxl:"

# Default providers, may need to override for specific machines
# needs to be set before inclusion of am64xx.inc
PREFERRED_PROVIDER_virtual/kernel ?= "linux-ti-tq"
PREFERRED_PROVIDER_u-boot ?= "u-boot-ti-tq"
PREFERRED_PROVIDER_virtual/bootloader ?= "u-boot-ti-tq"

# From meta-ti-bsp: PREFERRED_PROVIDER and tuning
require conf/machine/include/am64xx.inc

# Machine specific options
#
MACHINE_EXTRA_RRECOMMENDS += "\
    kernel-devicetree \
    kernel-modules \
"

# TQ u-boot and kernel
#
require conf/machine/include/tqmxx.inc
KERNEL_IMAGETYPE = "Image"

# Image Options
#
EXTRA_IMAGEDEPENDS += "virtual/bootloader"

# Verified values to generate UBI image:
# UBIFS_PEB_SIZE="65536"
# UBIFS_MINIMUM_IO_UNIT_SIZE="1"
# UBIFS_SUB_PAGE_SIZE="1"
# UBIFS_VID_HEADER_OFFSET="64"
# UBIFS_LEB_SIZE="65408"

MKUBIFS_ARGS = " -m 1 -e 65408 -c 896 "
UBINIZE_ARGS = " -p 65536 -m 1 -s 1 "
# needs to be set to have it consistent for kernel command line
# Use the expected value of the ubifs filesystem's volume name in the kernel
# and u-boot.
UBI_VOLNAME = "rootfs"

# List common SoC features
MACHINE_FEATURES += "\
    apm \
    can \
    ethernet \
    ext2 \
    kernel26 \
    pci \
    ubi \
    usbgadget \
    usbhost \
    vfat \
"
```

## conf/machine/include/tqma65xx-k3r5.inc
```bitbake
# Common definitions for R5 bootloader on TQMa65xx

require conf/machine/include/k3r5.inc

# See https://git.ti.com/cgit/k3-image-gen/k3-image-gen/tree/README.md
# for information on SYSFW configurations
#
# The "evm" configuration should work for most usecases. For more advanced
# setups, in particular those using the R5 core, it may be necessary to create
# a modified configuration. Unfortunately, meta-ti currently lacks a convenient
# way to do so.

SYSFW_SOC = "am65x"
SYSFW_CONFIG = "evm"
SYSFW_SUFFIX = "gp"
SYSFW_SYMLINK = ""

PREFERRED_PROVIDER_virtual/bootloader = "u-boot-ti-tq"
PREFERRED_PROVIDER_u-boot = "u-boot-ti-tq"

# R5 sysfw and U-Boot are build using the Bitbake MultiConfig feature. To avoid
# conflicts and race conditions, in particular when using the "rm_work" class,
# each of the multiconfigs must use a separate TMPDIR (resulting in directory
# names like "tmp-k3r5" and "tmp-k3r5-sr2").
#
# We still need the alternative multiconfigs to use the same DEPLOY_DIR_IMAGE
# as the main configuration, so the value of that variable is expanded using :=
# before modifying TMPDIR.

MAIN_DEPLOY_DIR_IMAGE := "${DEPLOY_DIR_IMAGE}"
DEPLOY_DIR_IMAGE = "${MAIN_DEPLOY_DIR_IMAGE}"

TMPDIR .= "${@ '-${BB_CURRENT_MC}' if d.getVar('BB_CURRENT_MC') else ''}"
```

## conf/machine/include/tqma65xx-mba65xx.inc
```bitbake
# Common definitions for TQ-Group TQMa65xx modules on MBa65xx
# WKS_FILE ?= "tqma65xx-sdimg.wks"


KERNEL_DEVICETREE ?= " \
    tq/am654-mba65xx-p1.dtb \
    tq/am654-mba65xx-p2.dtb \
    tq/am654-mba65xx-eth-prg0.dtbo \
    tq/am654-mba65xx-eth-prg1.dtbo \
    tq/am654-mba65xx-audio.dtbo \
    tq/am654-mba65xx-lvds-display.dtbo \
    tq/am654-mba65xx-dmb-dc44.dtbo \
    tq/am654-mba65xx-dmb-fc21.dtbo \
"

# Files are needed in IMAGE_BOOT_FILES because /boot is on an extra partition.
# If those files should be installed under /boot inside the rootfs, you can
# achieve this in your BSP layer adding them via
# IMAGE_INSTALL_append = " kernel-devicetree kernel-image-image"
#
IMAGE_BOOT_FILES_append = "\
	${KERNEL_IMAGETYPE};linuximage \
	${KERNEL_IMAGETYPE}-initramfs-${MACHINE}.bin \
	am654-mba65xx-p1.dtb \
	am654-mba65xx-p2.dtb \
	am654-mba65xx-eth-prg0.dtbo \
	am654-mba65xx-eth-prg1.dtbo \
	am654-mba65xx-audio.dtbo \
	am654-mba65xx-lvds-display.dtbo \
	am654-mba65xx-dmb-dc44.dtbo \
	am654-mba65xx-dmb-fc21.dtbo \
"

SERIAL_CONSOLES ?= "115200;ttyS2"

IMAGE_FSTYPES ?= "tar.gz ext4 wic"

# Do not update fstab file when using wic images
WIC_CREATE_EXTRA_ARGS ?= "--no-fstab-update"

WKS_FILE_DEPENDS = "\
	mtools-native \
	dosfstools-native \
	parted-native \
	virtual/kernel \
	virtual/bootloader \
	"

WKS_FILE ?= "tqma57xx-sdimg.wks"
```

## conf/machine/include/tqma65xx-pru.inc
```bitbake
MACHINE_EXTRA_RRECOMMENDS += "\
    prueth-fw-am65x \
    prueth-fw-am65x-sr2 \
    pru-icss \
"
```

## conf/machine/include/tqma65xx-prueth.inc
```bitbake
IMAGE_INSTALL_append = "\
	${@bb.utils.contains('BBFILE_COLLECTIONS', 'meta-ti', ' prueth-fw', '', d)} \
"
```

## conf/machine/include/tqma65xx.inc
```bitbake
# Common definitions for TQ-Systems GmbH TQMa65xx modules

# needed for easier compatible / preferred_provider
MACHINEOVERRIDES =. "tqma65xx:"

# Default providers, may need to override for specific machines
# needs to be set before inclusion of am65xx.inc
PREFERRED_PROVIDER_virtual/kernel ?= "linux-ti-tq"
PREFERRED_PROVIDER_u-boot ?= "u-boot-ti-tq"
PREFERRED_PROVIDER_virtual/bootloader ?= "u-boot-ti-tq"

# From meta-ti-bsp: PREFERRED_PROVIDER and tuning
require conf/machine/include/am65xx.inc

# Machine specific options
#
MACHINE_EXTRA_RRECOMMENDS += "\
    kernel-devicetree \
    kernel-modules \
"

# TQ u-boot and kernel
#
require conf/machine/include/tqmxx.inc
KERNEL_IMAGETYPE = "Image"

UBOOT_ARCH = "arm"
UBOOT_ENTRYPOINT = "0x80008000"
UBOOT_LOADADDRESS = "0x80008000"
SPL_BINARY = "tispl.bin"
UBOOT_SUFFIX = "img"

# we still need this, since meta-ti sets KERNEL_IMAGETYPES to contain uImage
# and forces building this ancient image which forces us to provide this var
KERNEL_EXTRA_ARGS:prepend = "LOADADDR=${UBOOT_ENTRYPOINT} "

# Image Options
#
EXTRA_IMAGEDEPENDS += "virtual/bootloader"

# Verified values to generate UBI image:
# UBIFS_PEB_SIZE="65536"
# UBIFS_MINIMUM_IO_UNIT_SIZE="1"
# UBIFS_SUB_PAGE_SIZE="1"
# UBIFS_VID_HEADER_OFFSET="64"
# UBIFS_LEB_SIZE="65408"

MKUBIFS_ARGS = " -m 1 -e 65408 -c 896 "
UBINIZE_ARGS = " -p 65536 -m 1 -s 1 "
# needs to be set to have it consistent for kernel command line
# Use the expected value of the ubifs filesystem's volume name in the kernel
# and u-boot.
UBI_VOLNAME = "rootfs"

# List common SoC features
MACHINE_FEATURES += "\
    alsa \
    apm \
    can \
    dsp \
    ethernet \
    ext2 \
    gpu \
    kernel26 \
    mmip \
    pci \
    screen \
    sgx \
    ubi \
    usbgadget \
    usbhost \
    vfat \
"
```

## conf/machine/include/tqma6dl-mba6x.inc
```bitbake
# Common definitions for TQ-Systems GmbH TQMa6[S,DL] modules on MBa6x

# Common device trees used in linux-imx-qt and linux-tq
KERNEL_DEVICETREE = "\
    imx6dl-mba6a.dtb \
    imx6dl-mba6a-duallvds-tm070jvhg33.dtb \
    imx6dl-mba6a-hdmi.dtb \
    imx6dl-mba6a-lvds-tm070jvhg33.dtb \
        \
    imx6dl-mba6b.dtb \
    imx6dl-mba6b-duallvds-tm070jvhg33.dtb \
    imx6dl-mba6b-hdmi.dtb \
    imx6dl-mba6b-lvds-tm070jvhg33.dtb \
"

KERNEL_DEVICETREE_linux-imx-tq = "\
    imx6dl-mba6a-usb-peripheral.dtb \
    imx6dl-mba6b-usb-peripheral.dtb \
"

KERNEL_DEVICETREE_linux-tq = "\
    imx6dl-mba6a-cdtech-dc44.dtb \
    imx6dl-mba6a-cdtech-fc21.dtb \
    imx6dl-mba6a-multi.dtb \
    \
    imx6dl-mba6b-cdtech-dc44.dtb \
    imx6dl-mba6b-cdtech-fc21.dtb \
    imx6dl-mba6b-multi.dtb \
"

KERNEL_DEVICETREE_append = " ${@kernel_provider_dtbs(d)} "

# Files are needed in IMAGE_BOOT_FILES because /boot is on an extra partition.
# If those files should be installed under /boot inside the rootfs, you can
# achieve this in your BSP layer adding them via
# IMAGE_INSTALL_append = " kernel-devicetree kernel-image-zimage"
#
IMAGE_BOOT_FILES = "\
    ${KERNEL_IMAGETYPE};linuximage \
    ${KERNEL_DEVICETREE} \
"
```

## conf/machine/include/tqma6dl.inc
```bitbake
# Common definitions for TQ-Systems GmbH TQMa6[S,DL] modules

MACHINEOVERRIDES =. "mx6:mx6dl:"

require conf/machine/include/tqma6x.inc
```

## conf/machine/include/tqma6q-mba6x.inc
```bitbake
# Common definitions for TQ-Systems GmbH TQMa6[Q,D] modules on MBa6

KERNEL_DEVICETREE = " \
	imx6q-mba6a.dtb \
	imx6q-mba6a-duallvds-tm070jvhg33.dtb \
	imx6q-mba6a-lvds-tm070jvhg33.dtb \
	imx6q-mba6a-hdmi.dtb \
	imx6q-mba6a-usb-peripheral.dtb \
	\
	imx6q-mba6b.dtb \
	imx6q-mba6b-duallvds-tm070jvhg33.dtb \
	imx6q-mba6b-lvds-tm070jvhg33.dtb \
	imx6q-mba6b-hdmi.dtb \
	imx6q-mba6b-usb-peripheral.dtb \
"

KERNEL_DEVICETREE_append_use-mainline-bsp = " \
	imx6q-mba6a-dmb-ct21.dtb \
	imx6q-mba6a-dmb-ct44.dtb \
	imx6q-mba6a-glyn-etm0700g0edh6.dtb \
	imx6q-mba6a-multi.dtb \
	\
	imx6q-mba6b-dmb-ct21.dtb \
	imx6q-mba6b-dmb-ct44.dtb \
	imx6q-mba6b-glyn-etm0700g0edh6.dtb \
	imx6q-mba6b-multi.dtb \
"

# Files are needed in IMAGE_BOOT_FILES because /boot is on an extra partition.
# If those files should be installed under /boot inside the rootfs, you can
# achieve this in your BSP layer adding them via
# IMAGE_INSTALL_append = " kernel-devicetree kernel-image-zimage"
#
IMAGE_BOOT_FILES = "\
	${KERNEL_IMAGETYPE};linuximage \
	${KERNEL_DEVICETREE} \
"
```

## conf/machine/include/tqma6q.inc
```bitbake
# Common definitions for TQ-Systems GmbH TQMa6[Q,D,QP,DP] modules

MACHINEOVERRIDES =. "mx6:mx6q:"

require conf/machine/include/tqma6x.inc
```

## conf/machine/include/tqma6qdl-mba6x.inc
```bitbake
# Common definitions for TQ-Systems GmbH TQMa6x modules on MBa6x

SERIAL_CONSOLES = "115200;ttymxc1"

# disable virtual console support for this board and limit getty to SERIAL_CONSOLES only
USE_VT = "0"

UBOOT_CONFIG ??= "sd spinor"

WKS_FILE = "tqmaxx-sdimg.wks"

MACHINE_FEATURES_append = " wifi"
MACHINE_EXTRA_RRECOMMENDS += "linux-firmware-ath10k"
```

## conf/machine/include/tqma6s.inc
```bitbake
# Common definitions for TQ-Group TQMa6S modules

MACHINEOVERRIDES =. "mx6:mx6dl:"

require conf/machine/include/tqma6x.inc
```
