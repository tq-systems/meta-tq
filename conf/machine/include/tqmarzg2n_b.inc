## conf/machine/include/tqmt1022-stkt104x.inc
```bitbake
# Common definitions for TQ-Group TQMT1042 modules on STKT104x

MACHINEOVERRIDES =. "t1:t1042:"

PREFERRED_VERSION_openssl = ""

## TQ u-boot and kernel
#

#use u-boot config of tqmt1042
UBOOT_CONFIG ??= "sdcard nor"
UBOOT_CONFIG[nor] ?= "TQMT1022_defconfig"
UBOOT_CONFIG[sdcard] ?= "TQMT1022_SDCARD_defconfig"

FSL_RCW ?= "TQMT1042_SERDES86"

KERNEL_DEVICETREE ?= " \
	fsl/tqmt1022-stkt104x.dtb \
"

IMAGE_BOOT_FILES ?= "\
    ${KERNEL_IMAGETYPE};linuximage \
    tqmt1022-stkt104x.dtb\
    "
```

## conf/machine/include/tqmt1040-stkt104x.inc
```bitbake
# Common definitions for TQ-Group TQMT1040 modules on STKT104x

MACHINEOVERRIDES =. "t1:t1040:"

PREFERRED_VERSION_openssl = ""

## TQ u-boot and kernel
#

UBOOT_CONFIG ??= "sdcard nor"
UBOOT_CONFIG[nor] ?= "TQMT1040_defconfig"
UBOOT_CONFIG[sdcard] ?= "TQMT1040_SDCARD_defconfig"

FSL_RCW ?= "TQMT1040_SERDES66"

KERNEL_DEVICETREE ?= " \
	fsl/tqmt1040-stkt104x.dtb \
"

IMAGE_BOOT_FILES ?= "\
    ${KERNEL_IMAGETYPE};linuximage \
    tqmt1040-stkt104x.dtb\
    "
```

## conf/machine/include/tqmt1042-stkt104x.inc
```bitbake
# Common definitions for TQ-Group TQMT1042 modules on STKT104x

MACHINEOVERRIDES =. "t1:t1042:"

PREFERRED_VERSION_openssl = ""

## TQ u-boot and kernel
#

UBOOT_CONFIG ??= "sdcard nor"
UBOOT_CONFIG[nor] = "TQMT1042_defconfig"
UBOOT_CONFIG[sdcard] = "TQMT1042_SDCARD_defconfig"

FSL_RCW ?= "TQMT1042_SERDES86"

KERNEL_DEVICETREE ?= " \
	fsl/tqmt1042-stkt104x.dtb \
"

# Files are needed in IMAGE_BOOT_FILES because /boot is on an extra partition.
# If those files should be installed under /boot inside the rootfs, you can
# achieve this in your BSP layer adding them via
# IMAGE_INSTALL_append = " kernel-devicetree kernel-image-zimage"
#
IMAGE_BOOT_FILES ?= "\
    ${KERNEL_IMAGETYPE};tqmt1042-linuximage \
    tqmt1042-stkt104x.dtb\
    "
```

## conf/machine/include/tqmt104x-64bit-stkt104x.inc
```bitbake
# Common definitions for TQ-Group TQMT104x modules on STKT104x

MACHINEOVERRIDES =. "tqmt104x-64bit:"

TARGET_FPU = "hard"
DEFAULTTUNE ?= "ppc64e5500"

require conf/machine/include/tune-ppce5500.inc

MACHINEOVERRIDES =. "e5500-64b:"

require conf/multilib.conf
MULTILIBS ?= "multilib:lib32"
DEFAULTTUNE_virtclass-multilib-lib32 ?= "ppce5500"
```

## conf/machine/include/tqmt104x-stkt104x.inc
```bitbake
# Common definitions for TQ-Group TQMT104x modules on STKT104x

MACHINEOVERRIDES =. "tqmt104x:stkt104x:"

## TQ u-boot and kernel
#
require conf/machine/include/tqmxx.inc

PREFERRED_PROVIDER_u-boot_tqmt104x ?= "u-boot-tqmt"
PREFERRED_PROVIDER_virtual/bootloader_tqmt104x ?= "u-boot-tqmt"

PREFERRED_PROVIDER_virtual/kernel_tqmt104x ?= "linux-tqmt"

PREFERRED_VERSION_openssl = ""

## TQ BSP default settings
#
SDCARD_ROOTFS ?= "${DEPLOY_DIR_IMAGE}/${IMAGE_NAME}.rootfs.ext4"
NOR_ROOTFS ?= "${DEPLOY_DIR_IMAGE}/${IMAGE_NAME}.rootfs.jffs2"

JFFS2_ERASEBLOCK ?= "0x20000"

# Do not update fstab file when using wic images
WIC_CREATE_EXTRA_ARGS ?= "--no-fstab-update"

WKS_FILE_DEPENDS = "\
	mtools-native \
	dosfstools-native \
	parted-native \
	virtual/kernel \
	virtual/bootloader \
	"

WKS_FILE ?= "tqmt104x-sdimg.wks"

# fman_ucode is hardcoded in tqmt104x-sdimg.wks
FSL_FMAN_UCODE ?= "fsl_fman_ucode_t1040_r1.1_107_4_2.bin"

# Image Options
#
EXTRA_IMAGEDEPENDS += "virtual/bootloader fm-ucode"
IMAGE_FSTYPES_append = " tar.gz ext4 wic jffs2"

KERNEL_IMAGETYPE = "uImage"
SERIAL_CONSOLES ?= "115200;ttyS0 115200;ttyS1 115200;ttyEHV0"
SERIAL_CONSOLES_CHECK ?= "${SERIAL_CONSOLES}"
MACHINEOVERRIDES =. "qoriq-ppc:qoriq:"

SOC_DEFAULT_IMAGE_FSTYPES = "tar.gz ext4"
IMAGE_FSTYPES ?= "${SOC_DEFAULT_IMAGE_FSTYPES}"

MACHINE_FEATURES ?= "pci ext4 serial"
MACHINE_EXTRA_RRECOMMENDS += "udev-extraconf kernel-modules"

# Sub-architecture support
MACHINE_SOCARCH_SUFFIX ?= ""
MACHINE_SOCARCH_SUFFIX_qoriq = "-qoriq"

MACHINE_ARCH_FILTER = "virtual/kernel"
```

## conf/machine/include/tqmxx.inc
```bitbake
# Common definitions for TQ-Systems GmbH ARM modules

# these are used for linux-tq and u-boot-tq
TQ_GIT_BASEURL ?= "git://github.com/tq-systems"
TQ_GIT_PROTOCOL ?= "https"

# target not supported in older U-Boot
UBOOT_INITIAL_ENV ?= ""

PREFERRED_PROVIDER_ptpd:imx = "ptpd"
PREFERRED_PROVIDER_ptpd:qoriq = "${@bb.utils.contains('BBFILE_COLLECTIONS', 'freescale-layer', 'ptpd-qoriq', 'ptpd', d)}"
PREFERRED_PROVIDER_ptpd ?= "ptpd"

DEFAULT_KERNEL:imx ??= "linux-imx-tq"
DEFAULT_KERNEL:imx:use-mainline-bsp ??= "linux-tq"
PREFERRED_PROVIDER_virtual/kernel ??= "${DEFAULT_KERNEL}"

# Return a list of device tree files depending on the virtual/kernel
# provider. The (optional) list is named KERNEL_DEVICETREE_<provider>
def kernel_provider_dtbs(d):
    # They share a common kernel, so they can be copied
    mainline_list = d.getVar('KERNEL_DEVICETREE_linux-tq')
    d.setVar('KERNEL_DEVICETREE_linux-rt-tq', mainline_list)

    kernel_provider = d.getVar('PREFERRED_PROVIDER_virtual/kernel')
    return d.getVar('KERNEL_DEVICETREE_' + kernel_provider)
```

## conf/machine/tqma335x_512mb-mba335x.conf
```bitbake
#@TYPE: Machine
#@NAME: TQ-Systems GmbH TQMa335x module with 512 MiB RAM on MBa335x Baseboard
#@SOC: AM335x
#@DESCRIPTION: Machine configuration for TQMa335x
#@MAINTAINER: Michael Krummsdorf <michael.krummsdorf@tq-group.com>
#
# By default, this machine will build for the full featured option
# with SD / eMMC boot
#

require conf/machine/include/tqma335x.inc
require conf/machine/include/tqma335x-mba335x.inc

UBOOT_BINARY = "u-boot-dtb.img"
UBOOT_MACHINE = "am335x_mba335x_512M_defconfig"
```

## conf/machine/tqma571x-mba57xx.conf
```bitbake
#@TYPE: Machine
#@NAME: TQ-Group TQMa571x Module on MBa57x Baseboard
#@SOC: AM571x
#@DESCRIPTION: Machine configuration for TQ-Group TQMa571x
#@MAINTAINER: Stefan Lange <s.lange@gateware.de>

require conf/machine/include/tqma57xx-mba57xx.inc
require conf/machine/include/tqma57xx.inc
require conf/machine/include/tqma57xx-prueth.inc

UBOOT_MACHINE = "tqma571x_mba57xx_config"

WKS_FILE ?= "tqma57xx-sdimg.wks"
```

## conf/machine/tqma572x-mba57xx.conf
```bitbake
#@TYPE: Machine
#@NAME: TQ-Group TQMa572x Module on MBa57x Baseboard
#@SOC: AM572x
#@DESCRIPTION: Machine configuration for TQ-Group TQMa572x
#@MAINTAINER: Stefan Lange <s.lange@gateware.de>

require conf/machine/include/tqma57xx-mba57xx.inc
require conf/machine/include/tqma57xx.inc

UBOOT_MACHINE = "tqma572x_mba57xx_config"

WKS_FILE ?= "tqma57xx-sdimg.wks"
```

## conf/machine/tqma574x-mba57xx.conf
```bitbake
#@TYPE: Machine
#@NAME: TQ-Group TQMa574x Module on MBa57x Baseboard
#@SOC: AM574x
#@DESCRIPTION: Machine configuration for TQ-Group TQMa574x
#@MAINTAINER: Stefan Lange <s.lange@gateware.de>

require conf/machine/include/tqma57xx-mba57xx.inc
require conf/machine/include/tqma57xx.inc
require conf/machine/include/tqma57xx-prueth.inc

UBOOT_MACHINE = "tqma574x_mba57xx_config"
```
