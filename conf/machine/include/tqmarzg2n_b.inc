## conf/machine/include/tqmarzg2n_b.inc
```bitbake
require conf/machine/include/tqmarzg2x.inc

SOC_FAMILY = "r8a774b1"
MACHINEOVERRIDES =. "r8a774b1:tqmarzg2n_b:"

DEFAULTTUNE ?= "cortexa57"
TUNE_CONF ?= "conf/machine/include/tune-cortexa57.inc"
require conf/machine/include/${SOC_FAMILY}.inc
require ${TUNE_CONF}
```

## conf/machine/include/tqmarzg2x-mbarzg2x.inc
```bitbake
# Common definitions for TQ-Systems GmbH TQMaRZG2x modules on MBaRZG2x

SERIAL_CONSOLE = "115200 ttySC0"

BOOTTYPE ?= "emmc"

WKS_FILE ?= "tqmarzg2x-sdimg.wks"

EXTRA_IMAGEDEPENDS_remove = "optee-os"
```

## conf/machine/include/tqmarzg2x.inc
```bitbake
# Common definitions for TQ-Systems GmbH TQMaRZG2x modules

MACHINEOVERRIDES =. "tqmarzg2x:"

require conf/machine/include/cip-core.inc
require conf/machine/include/rzg2h-common.inc

EXT_GFX_BACKEND = "${@oe.utils.ifelse((d.getVar('RZ_FEATURE') == 'True') and (d.getVar('USE_RENESAS_GLES') == '1'), '1', '0')}"

# 32BIT package install (default is disable)
# This variables can be used only in multilib.
USE_32BIT_PKGS ?= "0"
USE_32BIT_WAYLAND ?= "0"
USE_32BIT_MMP ?= "0"

# Machine specific options
#
MACHINE_FEATURES = "ext2 pci rtc serial usb3 usbhost vfat can"

require conf/machine/include/tqmxx.inc

# Configuration for kernel
PREFERRED_PROVIDER_virtual/kernel = "linux-renesas"
KERNEL_IMAGETYPE = "Image"

# u-boot
PREFERRED_VERSION_u-boot = "2021.10"
PREFERRED_PROVIDER_u-boot_tqmarzg2x ?= "u-boot-renesas-tq"
PREFERRED_PROVIDER_virtual/bootloader_tqmarzg2x ?= "u-boot-renesas-tq"

# Image Options
#
EXTRA_IMAGEDEPENDS += "virtual/bootloader"

IMAGE_FSTYPES_append = " tar.bz2 ext4 wic"
IMAGE_FSTYPES_remove = " wic.gz"

# Add variable to Build Configuration in build log
BUILDCFG_VARS += "SOC_FAMILY"

# Command using to build kernel-module-gles
HOSTTOOLS += "sync"

# flash writer
EXTRA_IMAGEDEPENDS += "flash-writer"

# need to have the kernel modules in rootfs
MACHINE_EXTRA_RRECOMMENDS_append = " kernel-modules"

# provide dt name handling to prevent a lot of copy and paste
# in kernel prefix where to find dtb
KERNEL_DEVICETREE_PATH_PREFIX = "renesas/"

python () {
    dt_list = d.getVar("BOARD_DEVICETREE_FILES").split()
    dt_prefix = d.getVar("KERNEL_DEVICETREE_PATH_PREFIX")
    dt_prefix += "% s"
    dt_list =  [dt_prefix % i for i in dt_list]
    d.setVar("KERNEL_DEVICETREE", ' '.join(dt_list))
}

# Do not update fstab file when using wic images
WIC_CREATE_EXTRA_ARGS ?= "--no-fstab-update"

WKS_FILE_DEPENDS = "\
	mtools-native \
	dosfstools-native \
	parted-native \
	virtual/kernel \
	virtual/bootloader \
"

#
# Options below this line are imported from meta-rzg2/docs/sample/conf/*/poky-gcc/local.conf
# and not modified.
#

MACHINE_FEATURES += "gsx multimedia usb3"
MULTI_PROVIDER_WHITELIST += "virtual/libgl virtual/egl virtual/libgles1 virtual/libgles2"

#
# End of imported options
#
```

## conf/machine/include/tqmls1012al-1gb.inc
```bitbake
# Common definitions for TQ-Systems GmbH TQMLS1012AL modules (1GB RAM version)

MACHINEOVERRIDES =. "tqmls1012al-1gb:"

require conf/machine/include/tqmls1012al.inc
```

## conf/machine/include/tqmls1012al-mbls1012al.inc
```bitbake
# Common definitions for TQ-Group TQMLS1012AL modules on MBLS1012AL

SERIAL_CONSOLES = "115200;ttyS0"
SERIAL_CONSOLES_CHECK = "${SERIAL_CONSOLES}"
# no virtual terminal needed
USE_VT = "0"

KERNEL_DEVICETREE ?= " \
  freescale/fsl-ls1012a-mbls1012al.dtb \
"

# Files are needed in IMAGE_BOOT_FILES because /boot is on an extra partition.
# If those files should be installed under /boot inside the rootfs, you can
# achieve this in your BSP layer adding them via
# IMAGE_INSTALL_append = " kernel-devicetree kernel-image"
#
IMAGE_BOOT_FILES ?= "\
	${KERNEL_IMAGETYPE} \
	fsl-ls1012a-mbls1012al.dtb \
"

UBOOT_CONFIG ?= "tfa"
UBOOT_CONFIG[tfa] = "tqmls1012al_mbls1012al_tfa_defconfig"
```

## conf/machine/include/tqmls1012al.inc
```bitbake
# Common definitions for TQ-Systems GmbH TQMLS1012AL modules

require conf/machine/include/soc-family.inc

# source the machine specific features for RCW, multimedia etc. from
# meta-freescale

MACHINEOVERRIDES =. "fsl-lsch2:ls1012a:tqmls1012al:"

# TQ-Systems U-Boot and kernel has to be set before qoriq-arm64.inc
# to allow weak settings
#

require conf/machine/include/tqmxx.inc

PREFERRED_PROVIDER_u-boot:tqmls1012al ?= "u-boot-lsdk-tq"
PREFERRED_PROVIDER_virtual/bootloader:tqmls1012al ?= "u-boot-lsdk-tq"
PREFERRED_PROVIDER_virtual/kernel ??= "linux-imx-tq"

require conf/machine/include/qoriq-arm64.inc

require conf/machine/include/arm/armv8a/tune-cortexa53.inc

# Define the default image type, overwrite default from qoriq-arm64.inc
KERNEL_IMAGETYPE = "Image.gz"

UBOOT_ENTRYPOINT:ls1012a = "0x80008000"

# Machine specific options
#

MACHINE_EXTRA_RRECOMMENDS += "\
    kernel-devicetree \
    kernel-modules \
    ppfe-firmware \
    udev-extraconf \
"

# provide info about machine's capabilities
# OP-TEE is currently untested, so we don't enable the feature for now
MACHINE_FEATURES:append = "\
    ext2 \
    pci \
    rtc \
    serial \
    ubi \
    usbhost \
    vfat \
"

# Image Options
#
EXTRA_IMAGEDEPENDS += "\
    ppfe-firmware \
    qoriq-atf \
    rcw \
    virtual/bootloader \
"

# Image Options
#
MKUBIFS_ARGS = " -m 1 -e 65408 -c 896 "
UBINIZE_ARGS = " -p 65536 -m 1 -s 1 "

# needs to be set to have it consistent for kernel command line
UBI_VOLNAME = "root"

# Do not update fstab file when using wic images
WIC_CREATE_EXTRA_ARGS ?= "--no-fstab-update"

# default RCW with 1 GHz core frequency
RCWQSPI ?= "default/rcw_1000_sd"
```

## conf/machine/include/tqmls1028a.inc
```bitbake
# Common definitions for TQ-Systems GmbH TQMLS1028a modules

require conf/machine/include/soc-family.inc

MACHINEOVERRIDES =. "fsl-lsch3:ls1028a:tqmls1028a:"

# TQ-Systems U-Boot and kernel has to be set before qoriq-arm64.inc
# to allow weak settings
#
require conf/machine/include/tqmxx.inc

PREFERRED_PROVIDER_u-boot:tqmls1028a ?= "u-boot-lsdk-tq"
PREFERRED_PROVIDER_virtual/bootloader:tqmls1028a ?= "u-boot-lsdk-tq"
PREFERRED_PROVIDER_virtual/kernel ??= "linux-imx-tq"

require conf/machine/include/qoriq-arm64.inc

require conf/machine/include/arm/armv8a/tune-cortexa72.inc

# Define the default image type, overwrite default from qoriq-arm64.inc
KERNEL_IMAGETYPE = "Image.gz"

UBOOT_ENTRYPOINT:ls1028a = "0x80008000"

# Machine specific options
#

MACHINE_EXTRA_RRECOMMENDS += "\
    kernel-devicetree \
    kernel-modules \
    udev-extraconf \
"

# provide info about machine's capabilities
# OP-TEE is currently untested, so we don't enable the feature for now
MACHINE_FEATURES:append = "\
    alsa \
    can \
    ext2 \
    pci \
    rtc \
    serial \
    ubi \
    usbhost \
    vfat \
"

# Image Options
#
EXTRA_IMAGEDEPENDS += "virtual/bootloader"
EXTRA_IMAGEDEPENDS += "rcw qoriq-atf dp-firmware-cadence"

# Image Options
#
MKUBIFS_ARGS = " -m 1 -e 65408 -c 896 "
UBINIZE_ARGS = " -p 65536 -m 1 -s 1 "

# needs to be set to have it consistent for kernel command line
UBI_VOLNAME = "root"

# For the 4GB variant set BL2_IMAGE to 'bl2_sd_tqmls1028a_4gb.pbl'
# and BL3_IMAGE to 'fip_uboot_tqmls1028a_4gb.bin'
BL2_IMAGE ?= "bl2_sd.pbl"
BL3_IMAGE ?= "fip_uboot.bin"

# Do not update fstab file when using wic images
WIC_CREATE_EXTRA_ARGS ?= "--no-fstab-update"

ATF_RCW_VARIANTS ?= " \
    default/rcw_800_sd.bin \
    default/rcw_1000_sd.bin \
    default/rcw_1000_spi_nor.bin \
    default/rcw_1300_sd.bin \
    default/rcw_1300_spi_nor.bin \
"
RCWSD ?= "default/rcw_1300_sd"
RCWXSPI ?= "default/rcw_1300_spi_nor"
```

## conf/machine/include/tqmls102xa.inc
```bitbake
# Common definitions for TQ-Group TQMLS102xa modules

require conf/machine/include/soc-family.inc

MACHINEOVERRIDES =. "ls102xa:tqmls102xa:"

DEFAULTTUNE ?= "cortexa7thf-neon"
require conf/machine/include/tune-cortexa7.inc

# TQ u-boot and kernel
#
require conf/machine/include/tqmxx.inc

PREFERRED_PROVIDER_u-boot_ls102xa ?= "u-boot-tq"
PREFERRED_PROVIDER_virtual/bootloader_ls102xa ?= "u-boot-tq"
PREFERRED_PROVIDER_virtual/kernel_ls102xa ?= "linux-tq"

# Define the default image type
KERNEL_IMAGETYPE ?= "zImage"

UBOOT_ENTRYPOINT_ls102xa = "0x80008000"

# Machine specific options
#

MACHINE_EXTRA_RRECOMMENDS = " kernel-modules kernel-devicetree udev-extraconf"

# provide info about machine's capabilities
MACHINE_FEATURES_append = " alsa ext2 pci rtc serial usbhost vfat"

# Image Options
#
EXTRA_IMAGEDEPENDS += "u-boot"
IMAGE_FSTYPES ?= "tar.gz ext4 wic ubi"

DISTRO_FEATURES_remove += "${@bb.utils.contains('IMAGE_FSTYPES', 'ubi', 'wayland weston x11', '', d)}"

# needed for Rootfs on QSPI
IMAGE_INSTALL_append = " mtd-utils-jffs2 mtd-utils-ubifs mtd-utils-misc"
IMAGE_INSTALL_append = " kernel-modules"

# from PTXdist BSP:
# PTXCONF_IMAGE_ROOT_UBIFS_PEB_SIZE="65536"
# PTXCONF_IMAGE_ROOT_UBIFS_MINIMUM_IO_UNIT_SIZE="1"
# PTXCONF_IMAGE_ROOT_UBIFS_SUB_PAGE_SIZE="1"
# PTXCONF_IMAGE_ROOT_UBIFS_VID_HEADER_OFFSET="64"
# PTXCONF_IMAGE_ROOT_UBIFS_LEB_SIZE="65408"

MKUBIFS_ARGS = " -m 1 -e 65408 -c 896 "
UBINIZE_ARGS = " -p 65536 -m 1 -s 1 "
# needs to be set to have it consistent for kernel command line
UBI_VOLNAME = "root"

WKS_FILE ?= "tqmls102xa-sdimg.wks"

WKS_FILE_DEPENDS = "\
	mtools-native \
	dosfstools-native \
	parted-native \
	virtual/kernel \
	u-boot \
	"
```

## conf/machine/include/tqmls1043a.inc
```bitbake
# Common definitions for TQ-Systems GmbH TQMLS1043A modules

MACHINEOVERRIDES =. "fsl-lsch2:ls1043a:tqmls10xxa:"

require conf/machine/include/tqmls10xxa.inc

# TQ u-boot and kernel
#
require conf/machine/include/tqmxx.inc

UBOOT_ENTRYPOINT_ls1043a = "0x80008000"

# Image Options
#
MKUBIFS_ARGS = " -m 1 -e 65408 -c 640 "
UBINIZE_ARGS = " -p 65536 -m 1 -s 1 "
# needs to be set to have it consistent for kernel command line
UBI_VOLNAME = "root"

IMAGE_OFFSET_FMAN_UCODE ?= "9216"
FMAN_UCODE ?= "fsl_fman_ucode_ls1043_r1.1_106_4_18.bin"
```

## conf/machine/include/tqmls1046a-mbls10xxa.inc
```bitbake
# Common definitions for TQ-Systems GmbH TQMLS1046A modules on MBLS10xxA

require conf/machine/include/tqmls1046a.inc

# no default assignment here, since we overwrite defaults from qoriq-arm64.inc
SERIAL_CONSOLES = "115200;ttyS1"
SERIAL_CONSOLES_CHECK = "${SERIAL_CONSOLES}"
# disable virtual console support for this board and limit getty to SERIAL_CONSOLES only
USE_VT = "0"

KERNEL_DEVICETREE ?= " \
    freescale/fsl-tqmls1046a-mbls10xxa.dtb \
"

# Files are needed in IMAGE_BOOT_FILES because /boot is on an extra partition.
# If those files should be installed under /boot inside the rootfs, you can
# achieve this in your BSP layer adding them via
# IMAGE_INSTALL_append = " kernel-devicetree kernel-image-zimage"
#
IMAGE_BOOT_FILES = "\
    ${KERNEL_IMAGETYPE};linuximage \
    fsl-tqmls1046a-mbls10xxa.dtb \
"

UBOOT_RCW_CONFIG ??= ""
```

## conf/machine/include/tqmls1046a.inc
```bitbake
# Common definitions for TQ-Systems GmbH TQMLS1046A modules

MACHINEOVERRIDES =. "fsl-lsch2:ls1046a:tqmls10xxa:"

require conf/machine/include/tqmls10xxa.inc

# TQ u-boot and kernel
#
require conf/machine/include/tqmxx.inc

UBOOT_ENTRYPOINT:ls1046a = "0x80008000"

# Image Options
#
MKUBIFS_ARGS = " -m 1 -e 65408 -c 640 "
UBINIZE_ARGS = " -p 65536 -m 1 -s 1 "
# needs to be set to have it consistent for kernel command line
UBI_VOLNAME = "root"

IMAGE_OFFSET_FMAN_UCODE ?= "9216"
FMAN_UCODE ?= "fsl_fman_ucode_ls1046_r1.0_106_4_18.bin"
```

## conf/machine/include/tqmls104xa-mbls10xxa.inc
```bitbake
# shared settings for TQMLS104[3,6]A on MBLS10xxA

# no default assignment here, since we overwrite defaults from qoriq-arm64.inc
SERIAL_CONSOLES = "115200;ttyS1"
SERIAL_CONSOLES_CHECK = "${SERIAL_CONSOLES}"
# disable virtual console support for this board and limit getty to
# SERIAL_CONSOLES only
USE_VT = "0"

# These things are also still in IMAGE_BOOT_FILES because /boot is on an extra
# partition. We will use them in future also under /boot inside the rootfs, so
# we enable this also:
IMAGE_INSTALL:append += "\
	kernel-devicetree \
	kernel-image \
"

UBOOT_RCW_CONFIG ??= ""

# direct assignment to override empty default from meta-freescale
WKS_FILE = "tqmls10xxa-sdimg.wks.in"

WKS_FILE_DEPENDS = "\
    mtools-native \
    dosfstools-native \
    parted-native \
    virtual/kernel \
    virtual/bootloader \
"
```

## conf/machine/include/tqmls1088a.inc
```bitbake
# Common definitions for TQ-Systems GmbH TQMLS1088A modules

MACHINEOVERRIDES =. "fsl-lsch3:ls1088a:tqmls10xxa:tqmls1088a:"

# TQ-Systems U-Boot and kernel has to be set before qoriq-arm64.inc
# to allow weak settings
#
PREFERRED_PROVIDER_u-boot ?= "u-boot-tq"
PREFERRED_PROVIDER_virtual/bootloader ?= "u-boot-tq"
PREFERRED_PROVIDER_virtual/kernel ?= "linux-lsdk-tq"

require conf/machine/include/tqmls10xxa.inc

UBOOT_ENTRYPOINT:ls1088a = "0x80008000"

# Image Options
#
MKUBIFS_ARGS = " -m 1 -e 65408 -c 640 "
UBINIZE_ARGS = " -p 65536 -m 1 -s 1 "

# DPAA2 manament utility
MACHINE_EXTRA_RRECOMMENDS += "restool"

# needs to be set to have it consistent for kernel command line
UBI_VOLNAME = "root"
```

## conf/machine/include/tqmls10xxa.inc
```bitbake
# Common definitions for TQ-Systems GmbH TQMLS10xxA modules

require conf/machine/include/arm/arch-arm64.inc

# source the machine specific features for RCW, MC, multimedia etc. from
# meta-freescale
require conf/machine/include/qoriq-arm64.inc

# Define the default image type
KERNEL_IMAGETYPE ?= "Image"

PREFERRED_PROVIDER_u-boot:tqmls10xxa ?= "u-boot-tq"
PREFERRED_PROVIDER_virtual/bootloader:tqmls10xxa ?= "u-boot-tq"
PREFERRED_PROVIDER_virtual/kernel ??= "linux-tq"

# Machine specific options
#
MACHINE_EXTRA_RRECOMMENDS += "\
    kernel-devicetree \
    kernel-modules \
    udev-extraconf \
"

# provide info about machine's capabilities
MACHINE_FEATURES:append = "\
    ext2 \
    pci \
    rtc \
    serial \
    ubi \
    usbhost \
    vfat \
"

# Image Options
#
EXTRA_IMAGEDEPENDS += "virtual/bootloader"
EXTRA_IMAGEDEPENDS:append:fsl-lsch2 = " fm-ucode"
EXTRA_IMAGEDEPENDS:append:fsl-lsch3 = "\
    management-complex \
    mc-utils \
    rcw \
"

# Do not update fstab file when using wic images
WIC_CREATE_EXTRA_ARGS ?= "--no-fstab-update"

# Different RCW files for booting CPU from SD card and eMMC require
# setting the correct BOOTMODE:
# sd -> to boot from SD-Card
# emmc -> to boot from eMMC
BOOTMODE ?= "sd"
```

## conf/machine/include/tqmlx2160a.inc
```bitbake
# Common definitions for TQ-Systems GmbH TQMLX2160A modules

require conf/machine/include/soc-family.inc

MACHINEOVERRIDES =. "fsl-lsch3:lx2160a:tqmlx2160a:"

# TQ-Systems U-Boot and kernel has to be set before qoriq-arm64.inc
# to allow weak settings
#
require conf/machine/include/tqmxx.inc

PREFERRED_PROVIDER_u-boot ?= "u-boot-lsdk-tq"
PREFERRED_PROVIDER_virtual/bootloader ?= "u-boot-lsdk-tq"
PREFERRED_PROVIDER_virtual/kernel ?= "linux-lsdk-tq"

# source the machine specific features for RCW, multimedia etc. from
# meta-freescale
require conf/machine/include/qoriq-arm64.inc

require conf/machine/include/arm/armv8a/tune-cortexa72.inc

# Define the default image type
KERNEL_IMAGETYPE ?= "Image"

# Machine specific options

MACHINE_EXTRA_RRECOMMENDS += "\
    kernel-devicetree \
    kernel-modules \
    udev-extraconf \
"

# provide info about machine's capabilities
MACHINE_FEATURES:append = "\
    can \
    ext2 \
    pci \
    rtc \
    serial \
    ubi \
    usbhost \
    vfat \
"

# Image Options
#
EXTRA_IMAGEDEPENDS += "\
    management-complex \
    mc-utils \
    qoriq-atf \
    rcw \
    virtual/bootloader \
"

# DPAA2 manament utility
IMAGE_INSTALL:append = " restool"

# Image Options
#
MKUBIFS_ARGS = " -m 1 -e 65408 -c 1280 "
UBINIZE_ARGS = " -p 65536 -m 1 -s 1 "

# needs to be set to have it consistent for kernel command line
UBI_VOLNAME = "root"

WICVARS:append = " BL2_IMAGE"

BL2_IMAGE ?= "bl2_sd.pbl"
```
