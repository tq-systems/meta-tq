## conf/machine/tqma57xx-ecc-mba57xx.conf
```bitbake
#@TYPE: Machine
#@NAME: TQ-Group TQMa574x Module with ECC RAM on MBa57x Baseboard
#@SOC: AM574x
#@DESCRIPTION: Machine configuration for TQ-Group TQMa574x with ECC
#
# By default, this machine will build for the full featured option
# with SD / eMMC boot
#
# To build U-Boot for other CPU or memory combinations, you can set
# the UBOOT_MACHINE variable in your local.conf according to the
# following table:
#
# Processor           Memory             Boot device    Configuration
# --------------      ---------------    -----------    -----------------------------
# AM5748              with ECC           SD / e-MMC     tqma57xx_mba57xx_ecc_config
#

require conf/machine/include/tqma57xx-mba57xx.inc
require conf/machine/include/tqma57xx.inc
require conf/machine/include/tqma57xx-prueth.inc

UBOOT_CONFIG ?= "sd"
UBOOT_CONFIG[sd] = "tqma57xx_mba57xx_ecc_config,wic"
## TODO: qspi boot missing
```

## conf/machine/tqma57xx-mba57xx.conf
```bitbake
#@TYPE: Machine
#@NAME: TQ-Group TQMa57[1,2,4]x Module on MBa57xx Baseboard
#@SOC: AM57[1,2,4]x
#@DESCRIPTION: Machine configuration for TQ-Group TQMa57[1,2,4]x
#@MAINTAINER: Markus Niebel <Markus.Niebel@tq-group.com>
#
# By default, this machine will build for the full featured option
# with SD / eMMC boot
#
# To build U-Boot for other CPU or memory combinations, you can set
# the UBOOT_MACHINE variable in your local.conf according to the
# following table:
#
# Processor           Memory             Boot device    Configuration
# --------------      ---------------    -----------    -----------------------------
# AM5718              1 GiB              SD / e-MMC     tqma574x_mba57xx_ecc_config
# AM5728              2 GiB              SD / e-MMC     tqma574x_mba57xx_ecc_config
# AM5748              2 GiB              SD / e-MMC     tqma574x_mba57xx_ecc_config
#

require conf/machine/include/tqma57xx-mba57xx.inc
require conf/machine/include/tqma57xx.inc
require conf/machine/include/tqma57xx-prueth.inc

UBOOT_CONFIG = "sd"
UBOOT_CONFIG[sd] = "tqma572x_mba57xx_defconfig,wic"
## TODO: qspi boot missing
```

## conf/machine/tqma65xx-2gb-mba65xx-k3r5-sr2.conf
```bitbake
#@TYPE: Machine
#@NAME: TQ-Group TQMa654x Module on MBa65xx Baseboard
#@SOC: AM654x
#@DESCRIPTION: Machine configuration for TQ-Group TQMa654x
#
# By default, this machine will build for the full featured option
# with SD / eMMC boot
#
# To build U-Boot for other CPU or memory combinations, you can set
# the UBOOT_MACHINE variable in your local.conf according to the
# following table:
#
# Processor           Memory             Boot device    Configuration
# --------------      ---------------    -----------    -----------------------------
# AM6548              2 GiB              SD/eMMC/OSPI   tqma65xx_2gb_mba65xx_r5_defconfig
# AM6548              4 GiB              SD/eMMC/OSPI   tqma65xx_4gb_mba65xx_r5_defconfig
#

require conf/machine/tqma65xx-2gb-mba65xx-k3r5.conf
SOC_FAMILY_append = ":k3r5-sr2"

SYSFW_SOC = "am65x_sr2"
SYSFW_SYMLINK = "sysfw.itb"
```

## conf/machine/tqma65xx-2gb-mba65xx.conf
```bitbake
#@TYPE: Machine
#@NAME: TQ-Group TQMa654x Module on MBa65xx Baseboard
#@SOC: AM654x
#@DESCRIPTION: Machine configuration for TQ-Group TQMa654x
#
# By default, this machine will build for the full featured option
# with SD / eMMC boot
#
# To build U-Boot for other CPU or memory combinations, you can set
# the UBOOT_MACHINE variable in your local.conf according to the
# following table:
#
# Processor           Memory             Boot device    Configuration
# --------------      ---------------    -----------    -----------------------------
# AM6548              2 GiB              SD/eMMC/OSPI   tqma65xx_2gb_mba65xx_a53_defconfig
# AM6548              4 GiB              SD/eMMC/OSPI   tqma65xx_4gb_mba65xx_a53_defconfig
#

require conf/machine/include/tqma65xx.inc
require conf/machine/include/tqma65xx-mba65xx.inc
require conf/machine/include/tqma65xx-pru.inc

UBOOT_MACHINE = "tqma65xx_2gb_mba65xx_a53_defconfig"
```

## conf/machine/tqma65xx-4gb-mba65xx-k3r5.conf
```bitbake
#@TYPE: Machine
#@NAME: TQ-Group TQMa654x Module on MBa65xx Baseboard
#@SOC: AM654x
#@DESCRIPTION: Machine configuration for TQ-Group TQMa654x
#
# By default, this machine will build for the full featured option
# with SD / eMMC boot
#
# To build U-Boot for other CPU or memory combinations, you can set
# the UBOOT_MACHINE variable in your local.conf according to the
# following table:
#
# Processor           Memory             Boot device    Configuration
# --------------      ---------------    -----------    -----------------------------
# AM6548              2 GiB              SD/eMMC/OSPI   tqma65xx_2gb_mba65xx_r5_defconfig
# AM6548              4 GiB              SD/eMMC/OSPI   tqma65xx_4gb_mba65xx_r5_defconfig
#

require conf/machine/include/tqma65xx-k3r5.inc

UBOOT_MACHINE = "tqma65xx_4gb_mba65xx_r5_defconfig"
```

## conf/machine/tqma65xx-mba65xx-emmc-uda.conf
```bitbake
#@TYPE: Machine
#@NAME: TQ-Group TQMa654x Module on MBa65xx Baseboard
#@SOC: AM654x
#@DESCRIPTION: Machine configuration for TQ-Group TQMa654x
#
# By default, this machine will build for the full featured option
# with SD / eMMC boot
#
# To build U-Boot for other CPU or memory combinations, you can set
# the UBOOT_MACHINE variable in your local.conf according to the
# following table:
#
# Processor           Memory             Boot device    Configuration
# --------------      ---------------    -----------    -----------------------------
# AM6548              2 GiB              SD             tqma65xx_mba65xx_a53_p2_defconfig
# AM6548              4 GiB              SD             tqma65xx_mba65xx_a53_defconfig
# AM6548              2 GiB              eMMC boot0     tqma65xx_mba65xx_a53_emmc_p2_defconfig
# AM6548              4 GiB              eMMC boot0     tqma65xx_mba65xx_a53_emmc_defconfig
# AM6548              2 GiB              eMMC UDA       tqma65xx_mba65xx_a53_emmc_uda_p2_defconfig
# AM6548              4 GiB              eMMC UDA       tqma65xx_mba65xx_a53_emmc_uda_defconfig
#

require conf/machine/include/tqma65xx-mba65xx.inc
require conf/machine/include/tqma65xx.inc
require conf/machine/include/tqma65xx-pru.inc

BBMULTICONFIG += "k3r5"

UBOOT_MACHINE = "tqma65xx_mba65xx_a53_emmc_uda_defconfig"

IMAGE_BOOT_FILES += "sysfw-am65x-evm.itb"
do_image_tar[mcdepends] += "mc::k3r5:ti-sci-fw:do_deploy"
do_image_wic[noexec] = "1"
```

## conf/machine/tqma65xx-mba65xx-p2-k3r5.conf
```bitbake
#@TYPE: Machine
#@NAME: TQ-Group TQMa654x Module on MBa65xx Baseboard
#@SOC: AM654x
#@DESCRIPTION: Machine configuration for TQ-Group TQMa654x
#
# By default, this machine will build for the full featured option
# with SD / eMMC boot
#
# To build U-Boot for other CPU or memory combinations, you can set
# the UBOOT_MACHINE variable in your local.conf according to the
# following table:
#
# Processor           Memory             Boot device    Configuration
# --------------      ---------------    -----------    -----------------------------
# AM6548              2 GiB              SD             tqma65xx_mba65xx_r5_p2_defconfig
# AM6548              4 GiB              SD             tqma65xx_mba65xx_r5_defconfig
# AM6548              2 GiB              eMMC boot0     tqma65xx_mba65xx_r5_emmc_p2_defconfig
# AM6548              4 GiB              eMMC boot0     tqma65xx_mba65xx_r5_emmc_defconfig
# AM6548              2 GiB              eMMC UDA       tqma65xx_mba65xx_r5_emmc_uda_p2_defconfig
# AM6548              4 GiB              eMMC UDA       tqma65xx_mba65xx_r5_emmc_uda_defconfig

#

require conf/machine/include/k3r5.inc

SOC_FAMILY_append = ":k3r5"

SYSFW_SOC = "am65x_sr2"
SYSFW_CONFIG = "evm"
SYSFW_SUFFIX = "gp"
SYSFW_SYMLINK = "sysfw.itb"

UBOOT_MACHINE = "tqma65xx_mba65xx_r5_p2_defconfig"
```

## conf/machine/tqma65xx-mba65xx.conf
```bitbake
#@TYPE: Machine
#@NAME: TQ-Group TQMa654x Module on MBa65xx Baseboard
#@SOC: AM654x
#@DESCRIPTION: Machine configuration for TQ-Group TQMa654x
#
# By default, this machine will build for the full featured option
# with SD / eMMC boot
#
# To build U-Boot for other CPU or memory combinations, you can set
# the UBOOT_MACHINE variable in your local.conf according to the
# following table:
#
# Processor           Memory             Boot device    Configuration
# --------------      ---------------    -----------    -----------------------------
# AM6548              2 GiB              SD / eMMC      tqma65xx_mba65xx_a53_p2_defconfig
# AM6548              4 GiB              SD / eMMC      tqma65xx_mba65xx_a53_defconfig
#

require conf/machine/include/tqma65xx-mba65xx.inc
require conf/machine/include/tqma65xx.inc
require conf/machine/include/tqma65xx-pru.inc

BBMULTICONFIG += "k3r5"

UBOOT_MACHINE = "tqma65xx_mba65xx_a53_defconfig"

do_image_wic[mcdepends] += "mc::k3r5:ti-sci-fw:do_deploy"
```

## conf/machine/tqma6dl-mba6x.conf
```bitbake
#@TYPE: Machine
#@NAME: TQ-Group TQMa6DL Module on MBa6x Baseboard
#@SOC: i.MX6DL
#@DESCRIPTION: Machine configuration for TQ-Group TQMa6 DualLight
#@MAINTAINER: Markus Niebel <Markus.Niebel@tq-group.com>
#
#
# Processor           Memory    Configuration
# --------------      ------    --------------------
# i.MX6Dual-Lite        1GB     tqma6dl_mba6_mmc_defconfig
# i.MX6Dual-Lite        1GB     tqma6dl_mba6_spi_defconfig
#

require conf/machine/include/tqma6dl.inc
require conf/machine/include/tqma6qdl-mba6x.inc
require conf/machine/include/tqma6dl-mba6x.inc

UBOOT_CONFIG ?= "sd spinor"
UBOOT_CONFIG[sd] = "tqma6dl_mba6_mmc_defconfig,wic"
UBOOT_CONFIG[spinor] = "tqma6dl_mba6_spi_defconfig"
```

## conf/machine/tqma6q-2gb-mba6x.conf
```bitbake
#@TYPE: Machine
#@NAME: TQ-Systems GmbH TQMa6[Q,D] Module with 2GB RAM on MBa6x Baseboard
#@SOC: i.MX6Q
#@DESCRIPTION: Machine configuration for TQ-Systems GmbH TQMa6 Quad / Dual
#@MAINTAINER: Markus Niebel <Markus.Niebel@tq-group.com>
#
# Processor           Memory    Configuration
# --------------      ------    --------------------
# i.MX6Quad/Dual        2GB     tqma6q_2gb_mba6_mmc_defconfig
#

require conf/machine/include/tqma6q.inc
require conf/machine/include/tqma6q-mba6x.inc
require conf/machine/include/mba6x-common.inc

UBOOT_CONFIG ?= "sd"
UBOOT_CONFIG[sd] = "tqma6q_2gb_mba6_mmc_defconfig,wic"
```

## conf/machine/tqma6q-mba6x.conf
```bitbake
#@TYPE: Machine
#@NAME: TQ-Systems GmbH TQMa6[Q,D] Module on MBa6x Baseboard
#@SOC: i.MX6Q
#@DESCRIPTION: Machine configuration for TQ-Systems GmbH TQMa6 Quad / Dual
#@MAINTAINER: Markus Niebel <Markus.Niebel@tq-group.com>
#
# Processor           Memory    Configuration
# --------------      ------    --------------------
# i.MX6Quad/Dual        1GB     tqma6q_mba6_mmc_defconfig
# i.MX6Quad/Dual        1GB     tqma6q_mba6_spi_defconfig
#

require conf/machine/include/tqma6q.inc
require conf/machine/include/tqma6q-mba6x.inc
require conf/machine/include/mba6x-common.inc

UBOOT_CONFIG ?= "\
    spinor \
    sd \
"

UBOOT_CONFIG[sd] = "tqma6q_mba6_mmc_defconfig,wic"
UBOOT_CONFIG[spinor] = "tqma6q_mba6_spi_defconfig"
```

## conf/machine/tqma6q-nav.conf
```bitbake
#@TYPE: Machine
#@NAME: TQ-Group TQMa6[Q,D] Module on NAV Baseboard
#@SOC: i.MX6Q
#@DESCRIPTION: Machine configuration for TQ-Group TQMa6 Quad / Dual
#@MAINTAINER: Markus Niebel <Markus.Niebel@tq-group.com>
#
# Processor           Memory    Configuration
# --------------      ------    --------------------
# i.MX6Quad/Dual        1GB     tqma6q_nav_mmc_defconfig
#

require conf/machine/include/tqma6q.inc

WKS_FILE = "nav-sdimg.wks"

SERIAL_CONSOLES = "115200;ttymxc1"

KERNEL_DEVICETREE = "\
	imx6q-nav.dtb \
	imx6q-nav-hdmi.dtb \
	imx6q-nav-hdcp.dtb \
"

# TODO: needed with MACHINE_ESSENTIAL_EXTRA_RDEPENDS
MACHINE_EXTRA_RRECOMMENDS_append = " kernel-devicetree kernel-image-zimage"

MACHINE_ESSENTIAL_EXTRA_RDEPENDS += " \
	kernel-image \
	kernel-devicetree \
"

UBOOT_CONFIG = "sd secure"
UBOOT_CONFIG[sd] = "tqma6q_nav_mmc_defconfig,wic"
UBOOT_CONFIG[secure] = "tqma6q_nav_mmc_secure_defconfig,wic"
UBOOT_CONFIG[mender] = "tqma6q_nav_mender_defconfig,wic"
# not supported in this version:
# UBOOT_CONFIG[mfgtool] = "tqma6q_nav_mmc_defconfig"
```

## conf/machine/tqma6qp-mba6x.conf
```bitbake
#@TYPE: Machine
#@NAME: TQ-Systems GmbH TQMa6[QP,DP] Module on MBa6x Baseboard
#@SOC: i.MX6QP
#@DESCRIPTION: Machine configuration for TQ-Systems GmbH TQMa6 QuadPlus / DualPlus
#@MAINTAINER: Markus Niebel <Markus.Niebel@tq-group.com>
#
# Processor                     Memory    Configuration
# --------------                ------    --------------------------
# i.MX6QuadPLus/DualPlus        1GB       tqma6qp_mba6_mmc_defconfig
# i.MX6QuadPLus/DualPlus        1GB       tqma6qp_mba6_spi_defconfig
#

require conf/machine/include/tqma6q.inc
require conf/machine/include/tqma6qdl-mba6x.inc

KERNEL_DEVICETREE = "\
    imx6qp-mba6b.dtb \
    imx6qp-mba6b-duallvds-tm070jvhg33.dtb \
    imx6qp-mba6b-hdmi.dtb \
    imx6qp-mba6b-lvds-tm070jvhg33.dtb \
"

KERNEL_DEVICETREE_linux-imx-tq = "\
    imx6qp-mba6b-usb-peripheral.dtb \
"

KERNEL_DEVICETREE_linux-tq = "\
    imx6qp-mba6b-cdtech-dc44.dtb \
    imx6qp-mba6b-cdtech-fc21.dtb \
    imx6qp-mba6b-multi.dtb \
"

KERNEL_DEVICETREE_append = " ${@kernel_provider_dtbs(d)} "

# Files are needed in IMAGE_BOOT_FILES because /boot is on an extra partition.
# If those files should be installed under /boot inside the rootfs, you can
# achieve this in your BSP layer adding them via
# IMAGE_INSTALL_append = " kernel-devicetree kernel-image-zimage"
#
IMAGE_BOOT_FILES = "\
    ${KERNEL_IMAGETYPE};linuximage \
    ${KERNEL_DEVICETREE} \
"

UBOOT_CONFIG ?= "sd spinor"
UBOOT_CONFIG[sd] = "tqma6qp_mba6_mmc_defconfig,wic"
UBOOT_CONFIG[spinor] = "tqma6qp_mba6_spi_defconfig,ubi"
```

## conf/machine/tqma6s-mba6x.conf
```bitbake
#@TYPE: Machine
#@NAME: TQ-Group TQMa6S Module on MBa6x Baseboard
#@SOC: i.MX6S
#@DESCRIPTION: Machine configuration for TQ-Group TQMa6 Quad / Dual
#@MAINTAINER: Markus Niebel <Markus.Niebel@tq-group.com>
#
# Processor           Memory    Configuration
# --------------      ------    --------------------
# i.MX6Solo           512MB     tqma6s_mba6_mmc_defconfig
# i.MX6Solo           512MB     tqma6s_mba6_spi_defconfig#
#

require conf/machine/include/tqma6s.inc
require conf/machine/include/tqma6qdl-mba6x.inc
require conf/machine/include/tqma6dl-mba6x.inc

UBOOT_CONFIG ??= "sd"
UBOOT_CONFIG[sd] = "tqma6s_mba6_mmc_defconfig"
UBOOT_CONFIG[spinor] = "tqma6s_mba6_spi_defconfig"
```
