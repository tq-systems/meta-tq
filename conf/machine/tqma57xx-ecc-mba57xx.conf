## conf/machine/tqma6ul-mba6ul.conf
```bitbake
#@TYPE: Machine
#@NAME: TQ-Group TQMa6UL Module on MBa6UL Baseboard
#@SOC: i.MX6UL
#@DESCRIPTION: Machine configuration for TQ-Group TQMaUL
#@MAINTAINER: Markus Niebel <Markus.Niebel@tq-group.com>
#
# By default, this machine will build for the full featured option
# with SD / eMMC boot
#
# To build U-Boot for other CPU or memory combinations, you can set
# the UBOOT_MACHINE variable in your local.conf according to the
# following table:
#
# Processor           Memory    Configuration
# --------------      ------    --------------------
# i.MX6UL		      256MiB    tqma6ul_mba6ul_mmc_defconfig
# i.MX6UL		      265MiB    tqma6ul_mba6ul_qspi_defconfig
#

include conf/machine/include/tqma6ul.inc

SERIAL_CONSOLE = "115200 ttymxc0"

KERNEL_DEVICETREE ?= " \
                        imx6ul-mba6ul.dtb imx6ul-mba6ul-pd.dtb \
                        imx6ul-mba6ul-lvds.dtb \
"

# Files are needed in IMAGE_BOOT_FILES because /boot is on an extra partition.
# If those files should be installed under /boot inside the rootfs, you can
# achieve this in your BSP layer adding them via
# IMAGE_INSTALL_append = " kernel-devicetree kernel-image-zimage"
#
IMAGE_BOOT_FILES ?= "\
	${KERNEL_IMAGETYPE};linuximage \
	${KERNEL_IMAGETYPE}-imx6ul-mba6ul.dtb;imx6ul-mba6ul.dtb \
	${KERNEL_IMAGETYPE}-imx6ul-mba6ul-pd.dtb;imx6ul-mba6ul-pd.dtb \
	${KERNEL_IMAGETYPE}-imx6ul-mba6ul-lvds.dtb;imx6ul-mba6ul-lvds.dtb \
	"

WKS_FILE ?= "tqmaxx-sdimg.wks"

UBOOT_CONFIG ??= "sd"
UBOOT_CONFIG[sd] = "tqma6ul_mba6ul_mmc_defconfig"
# TODO:
#UBOOT_CONFIG[qspi] = "tqma6ul_mba6ul_qspi_defconfig"
```

## conf/machine/tqma6ullx-512mb-lga-mba6ulx.conf
```bitbake
#@TYPE: Machine
#@NAME: TQ-Systems GmbH TQMa6ULLxL SOM with 512 MB RAM on MBa6ULx baseboard
#@SOC: i.MX6ULL
#@DESCRIPTION: Machine configuration for TQ-Systems GmbH TQMaULLxL
#@MAINTAINER: Markus Niebel <Markus.Niebel@tq-group.com>
#
# By default, this machine will be built for the full featured option
# with SD / eMMC boot
#
# To build U-Boot for other CPU or memory combinations, you can set
# the UBOOT_MACHINE variable in your local.conf according to the
# following table:
#
# Processor     Memory     Boot device     Configuration
# ----------    -------    ------------    ------------------------------------
# i.MX6ULL      512MiB     SD / e-MMC      tqma6ullxl_512mb_mba6ul_mmc_defconfig
# i.MX6ULL      512MiB     QSPI-NOR        tqma6ullxl_512mb_mba6ul_qspi_defconfig
#

include conf/machine/include/tqma6ull.inc
include conf/machine/include/tqma6ullxl-mba6ulx.inc

UBOOT_CONFIG ??= "sd qspi"
UBOOT_CONFIG[sd] = "tqma6ullxl_512mb_mba6ul_mmc_defconfig,wic"
# missing QSPI-NOR bootstream generation
UBOOT_CONFIG[qspi] = "tqma6ullxl_512mb_mba6ul_qspi_defconfig,ubi"
```

## conf/machine/tqma6ullx-512mb-mba6ulx.conf
```bitbake
#@TYPE: Machine
#@NAME: TQ-Group TQMa6ULLx module with 512 MB RAM on MBa6ULx baseboard
#@SOC: i.MX6ULL
#@DESCRIPTION: Machine configuration for TQ-Group TQMaULLx
#@MAINTAINER: Markus Niebel <Markus.Niebel@tq-group.com>
#
# By default, this machine will build for the full featured option
# with SD / eMMC boot
#
# To build U-Boot for other CPU or memory combinations, you can set
# the UBOOT_MACHINE variable in your local.conf according to the
# following table:
#
# Processor           Memory    Configuration
# --------------      ------    --------------------
# i.MX6ULL	      512MiB    tqma6ullx_512mb_mba6ul_mmc_defconfig
# i.MX6ULL	      512MiB    tqma6ullx_512mb_mba6ul_qspi_defconfig
#

include conf/machine/include/tqma6ull.inc
include conf/machine/include/tqma6ullx-mba6ulx.inc

UBOOT_CONFIG ??= "sd qspi"
UBOOT_CONFIG[sd] = "tqma6ullx_512mb_mba6ul_mmc_defconfig,wic"
UBOOT_CONFIG[qspi] = "tqma6ullx_512mb_mba6ul_qspi_defconfig,ubi"
```

## conf/machine/tqma6ullx-lga-mba6ulx.conf
```bitbake
#@TYPE: Machine
#@NAME: TQ-Systems GmbH TQMa6ULLxL Module on MBa6UL Baseboard
#@SOC: i.MX6ULL
#@DESCRIPTION: Machine configuration for TQ-Systems GmbH TQMaULLxL
#@MAINTAINER: Markus Niebel <Markus.Niebel@tq-group.com>
#
# By default, this machine be will build for the full featured option
# with SD / eMMC boot
#
# To build U-Boot for other CPU or memory combinations, you can set
# the UBOOT_MACHINE variable in your local.conf according to the
# following table:
#
# Processor     Memory     Boot device     Configuration
# ----------    -------    ------------    ---------------------------------
# i.MX6ULL      256MiB     SD / e-MMC      tqma6ullxl_mba6ul_mmc_defconfig
# i.MX6ULL      265MiB     QSPI-NOR        tqma6ullxl_mba6ul_qspi_defconfig
#

include conf/machine/include/tqma6ull.inc

SERIAL_CONSOLES = "115200;ttymxc0"

KERNEL_DEVICETREE_linux-imx-tq = "\
    imx6ull-mba6ulx-lga.dtb \
    imx6ull-mba6ulx-lga-lvds.dtb \
    imx6ull-mba6ulx-lga-dmb-ct21.dtb \
    imx6ull-mba6ulx-lga-dmb-ct44.dtb \
    imx6ull-mba6ulx-lga-glyn-etm0700g0edh6.dtb \
"

KERNEL_DEVICETREE_linux-tq = "\
    imx6ull-tqma6ull2l-mba6ulx-lga.dtb \
    imx6ull-tqma6ull2l-mba6ulx-lga-lvds.dtb \
    imx6ull-tqma6ull2l-mba6ulx-lga-cdtech-dc44.dtb \
    imx6ull-tqma6ull2l-mba6ulx-lga-cdtech-fc21.dtb \
"

KERNEL_DEVICETREE_append = " ${@kernel_provider_dtbs(d)} "

# Files are needed in IMAGE_BOOT_FILES because /boot is on an extra partition.
# If those files should be installed under /boot inside the rootfs, you can
# achieve this in your BSP layer adding them via
# IMAGE_INSTALL_append = " kernel-devicetree kernel-image-zimage"
#
IMAGE_BOOT_FILES = "\
    ${KERNEL_IMAGETYPE};linuximage \
    ${KERNEL_DEVICETREE} \
"

WKS_FILE = "tqmaxx-sdimg.wks"

UBOOT_CONFIG ??= "sd"
UBOOT_CONFIG[sd] = "tqma6ullxl_mba6ul_mmc_defconfig,wic"
# missing QSPI-NOR bootstream generation
UBOOT_CONFIG[qspi] = "tqma6ullxl_mba6ul_qspi_defconfig,ubi"
```

## conf/machine/tqma6ullx-mba6ulx.conf
```bitbake
#@TYPE: Machine
#@NAME: TQ-Systems GmbH TQMa6ULLx Module on MBa6ULx Baseboard
#@SOC: i.MX6ULL
#@DESCRIPTION: Machine configuration for TQ-Systems GmbH TQMaULLx
#@MAINTAINER: Markus Niebel <Markus.Niebel@tq-group.com>
#
# By default, this machine will build for the full featured option
# with SD / eMMC boot
#
# To build U-Boot for other CPU or memory combinations, you can set
# the UBOOT_MACHINE variable in your local.conf according to the
# following table:
#
# Processor     Memory     Boot device     Configuration
# ----------    -------    ------------    --------------------------------
# i.MX6ULL      256MiB     SD / e-MMC      tqma6ullx_mba6ul_mmc_defconfig
# i.MX6ULL      265MiB     QSPI-NOR        tqma6ullx_mba6ul_qspi_defconfig
#

include conf/machine/include/tqma6ull.inc
include conf/machine/include/tqma6ullx-mba6ulx.inc

UBOOT_CONFIG ??= "sd qspi"
UBOOT_CONFIG[sd] = "tqma6ullx_mba6ul_mmc_defconfig,wic"
# missing QSPI-NOR bootstream generation
UBOOT_CONFIG[qspi] = "tqma6ullx_mba6ul_qspi_defconfig,ubi"
```

## conf/machine/tqma6ulx-512mb-lga-mba6ulx.conf
```bitbake
#@TYPE: Machine
#@NAME: TQ-Systems GmbH TQMa6ULxL SOM with 512 MB RAM on MBa6ULx baseboard
#@SOC: i.MX6UL
#@DESCRIPTION: Machine configuration for TQ-Systems GmbH TQMaULxL
#@MAINTAINER: Markus Niebel <Markus.Niebel@tq-group.com>
#
# By default, this machine be will build for the full featured option
# with SD / eMMC boot
#
# To build U-Boot for other CPU or memory combinations, you can set
# the UBOOT_MACHINE variable in your local.conf according to the
# following table:
#
# Processor     Memory     Boot device     Configuration
# ----------    -------    ------------    --------------------
# i.MX6UL       512MiB     SD / e-MMC      tqma6ulxl_512mb_mba6ul_mmc_defconfig
# i.MX6UL       512MiB     QSPI-NOR        tqma6ulxl_512mb_mba6ul_qspi_defconfig
#

include conf/machine/include/tqma6ul.inc
include conf/machine/include/tqma6ulxl-mba6ulx.inc

UBOOT_CONFIG ??= "sd"
UBOOT_CONFIG[sd] = "tqma6ulxl_512mb_mba6ul_mmc_defconfig,wic"
UBOOT_CONFIG[qspi] = "tqma6ulxl_512mb_mba6ul_qspi_defconfig,ubi"
# not supported in this version:
# UBOOT_CONFIG[mfgtool] = "tqma6ulxl_512mb_mba6ul_mmc_defconfig"
```

## conf/machine/tqma6ulx-512mb-mba6ulx.conf
```bitbake
#@TYPE: Machine
#@NAME: TQ-Group TQMa6ULx module with 512 MB RAM on MBa6ULx baseboard
#@SOC: i.MX6UL
#@DESCRIPTION: Machine configuration for TQ-Group TQMaULx
#@MAINTAINER: Markus Niebel <Markus.Niebel@tq-group.com>
#
# By default, this machine be will build for the full featured option
# with SD / eMMC boot
#
# To build U-Boot for other CPU or memory combinations, you can set
# the UBOOT_MACHINE variable in your local.conf according to the
# following table:
#
# Processor           Memory    Configuration
# --------------      ------    --------------------
# i.MX6UL	      512MiB    tqma6ulx_512mb_mba6ul_mmc_defconfig
# i.MX6UL	      512MiB    tqma6ulx_512mb_mba6ul_qspi_defconfig
#

include conf/machine/include/tqma6ul.inc
include conf/machine/include/tqma6ulx-mba6ulx.inc

UBOOT_CONFIG ??= "sd"
UBOOT_CONFIG[sd] = "tqma6ulx_512mb_mba6ul_mmc_defconfig,wic"
UBOOT_CONFIG[qspi] = "tqma6ulx_512mb_mba6ul_qspi_defconfig,ubi"
```

## conf/machine/tqma6ulx-lga-mba6ulx.conf
```bitbake
#@TYPE: Machine
#@NAME: TQ-Systems GmbH TQMa6ULxL SOM with 256 MB RAM on MBa6ULx baseboard
#@SOC: i.MX6UL
#@DESCRIPTION: Machine configuration for TQ-Systems GmbH TQMaULxL
#@MAINTAINER: Markus Niebel <Markus.Niebel@tq-group.com>
#
# By default, this machine be will build for the full featured option
# with SD / eMMC boot
#
# To build U-Boot for other CPU or memory combinations, you can set
# the UBOOT_MACHINE variable in your local.conf according to the
# following table:
#
# Processor     Memory     Boot device     Configuration
# ----------    -------    ------------    --------------------
# i.MX6UL       256MiB     SD / e-MMC      tqma6ulxl_mba6ul_mmc_defconfig
# i.MX6UL       265MiB     QSPI-NOR        tqma6ulxl_mba6ul_qspi_defconfig
#

include conf/machine/include/tqma6ul.inc
include conf/machine/include/tqma6ulxl-mba6ulx.inc
include conf/machine/include/mba6ulx-common.inc


UBOOT_CONFIG ?= "\
    qspi \
    sd \
"

UBOOT_CONFIG[sd] = "tqma6ulxl_mba6ul_mmc_defconfig,wic"
UBOOT_CONFIG[qspi] = "tqma6ulxl_mba6ul_qspi_defconfig,ubi"
```

## conf/machine/tqma6ulx-lga-mba6ulxl.conf
```bitbake
#@TYPE: Machine
#@NAME: TQ-Systems GmbH TQMa6ULxL SOM on MBa6ULxL baseboard
#@SOC: i.MX6UL
#@DESCRIPTION: Machine configuration for TQ-Systems GmbH TQMaULxL on MBa6ULxL
#@MAINTAINER: Markus Niebel <Markus.Niebel@tq-group.com>
#
# By default, this machine be will build for the full featured option
# with SD / eMMC boot
#
# To build U-Boot for other CPU or memory combinations, you can set
# the UBOOT_MACHINE variable in your local.conf according to the
# following table:
#
# Processor     Memory     Boot device     Configuration
# ----------    -------    ------------    ---------------------------------
# i.MX6UL       256MiB     SD / e-MMC      tqma6ulxl_mba6ulxl_mmc_defconfig
#

include conf/machine/include/tqma6ul.inc

# no sound on MBa6ULxL
MACHINE_FEATURES_remove = "alsa"

SERIAL_CONSOLES = "115200;ttymxc0"

KERNEL_DEVICETREE_linux-imx-tq = "\
    imx6ul-mba6ulxl.dtb \
    imx6ul-mba6ulxl-glyn-etm0700g0edh6.dtb \
"

KERNEL_DEVICETREE_linux-tq = "\
    imx6ul-tqma6ul2l-mba6ulxl.dtb \
    imx6ul-tqma6ul2l-mba6ulxl-glyn-etm0700g0edh6.dtb \
"

KERNEL_DEVICETREE_append = " ${@kernel_provider_dtbs(d)} "

# Files are needed in IMAGE_BOOT_FILES because /boot is on an extra partition.
# If those files should be installed under /boot inside the rootfs, you can
# achieve this in your BSP layer adding them via
# IMAGE_INSTALL_append = " kernel-devicetree kernel-image-zimage"
#
IMAGE_BOOT_FILES = "\
    ${KERNEL_IMAGETYPE};linuximage \
    ${KERNEL_DEVICETREE} \
"

MACHINE_FEATURES_append = "\
    bluetooth \
    wifi \
"

MACHINE_EXTRA_RRECOMMENDS_append = "\
    linux-firmware-ath10k \
    linux-firmware-qca \
"

WKS_FILE = "tqmaxx-sdimg.wks"

UBOOT_CONFIG ??= "sd"
UBOOT_CONFIG[sd] = "tqma6ulxl_mba6ulxl_mmc_defconfig,wic"
```

## conf/machine/tqma6ulx-mba6ulx.conf
```bitbake
#@TYPE: Machine
#@NAME: TQ-Group TQMa6ULx Module on MBa6ULx Baseboard
#@SOC: i.MX6UL
#@DESCRIPTION: Machine configuration for TQ-Group TQMaULx
#@MAINTAINER: Markus Niebel <Markus.Niebel@tq-group.com>
#
# By default, this machine will build for the full featured option
# with SD / eMMC boot
#
# To build U-Boot for other CPU or memory combinations, you can set
# the UBOOT_MACHINE variable in your local.conf according to the
# following table:
#
# Processor           Memory    Configuration
# --------------      ------    --------------------
# i.MX6UL	      256MiB    tqma6ulx_mba6ul_mmc_defconfig
# i.MX6UL	      265MiB    tqma6ulx_mba6ul_qspi_defconfig
#

include conf/machine/include/tqma6ul.inc
include conf/machine/include/tqma6ulx-mba6ulx.inc

UBOOT_CONFIG ??= "sd qspi"
UBOOT_CONFIG[sd] = "tqma6ulx_mba6ul_mmc_defconfig,wic"
UBOOT_CONFIG[qspi] = "tqma6ulx_mba6ul_qspi_defconfig,ubi"
# not supported in this version:
# UBOOT_CONFIG[mfgtool] = "tqma6ulx_mba6ul_mmc_defconfig"
```

## conf/machine/tqma7-mba7.conf
```bitbake
#@TYPE: Machine
#@NAME: TQ-Group TQMa7x Module on MBa7 Baseboard
#@SOC: i.MX7
#@DESCRIPTION: Machine configuration for TQ-Group TQMa7 SOLO / DUAL
#@MAINTAINER: Markus Niebel <Markus.Niebel@tq-group.com>
#
# By default, this machine will build for the full featured option
# with SD / eMMC boot
#
# To build U-Boot for other CPU or memory combinations, you can set
# the UBOOT_MACHINE variable in your local.conf according to the
# following table:
#
# Processor           Memory    Configuration
# --------------      ------    --------------------
# i.MX7 S/D	      512MiB    tqma7_mba7_mmc_defconfig
# i.MX7 S/D	      512MiB    tqma7_mba7_qspi_defconfig
#

include conf/machine/include/tqma7.inc

SERIAL_CONSOLE = "115200 ttymxc5"

KERNEL_DEVICETREE ?= " \
                        imx7d-mba7.dtb imx7d-mba7-pd.dtb \
                        imx7d-mba7-lvds.dtb imx7d-mba7-otg.dtb \
"

# Files are needed in IMAGE_BOOT_FILES because /boot is on an extra partition.
# If those files should be installed under /boot inside the rootfs, you can
# achieve this in your BSP layer adding them via
# IMAGE_INSTALL_append = " kernel-devicetree kernel-image-zimage"
#
IMAGE_BOOT_FILES ?= "\
	${KERNEL_IMAGETYPE};linuximage \
	${KERNEL_IMAGETYPE}-imx7d-mba7.dtb;imx7d-mba7.dtb \
	${KERNEL_IMAGETYPE}-imx7d-mba7-pd.dtb;imx7d-mba7-pd.dtb \
	${KERNEL_IMAGETYPE}-imx7d-mba7-lvds.dtb;imx7d-mba7-lvds.dtb \
	${KERNEL_IMAGETYPE}-imx7d-mba7-otg.dtb;imx7d-mba7-otg.dtb \
	"

WKS_FILE ?= "tqmaxx-sdimg.wks"

UBOOT_CONFIG ??= "sd"
UBOOT_CONFIG[sd] = "tqma7d_mba7_mmc_defconfig"
# TODO:
#UBOOT_CONFIG[qspi] = "tqma7d_mba7_qspi_defconfig"
```
