## conf/machine/tqma8xqp-mbpa8xx.conf
```bitbake
#@TYPE: Machine
#@NAME: i.MX 8QXP TQMa8XQP on MBpa8Xx
#@DESCRIPTION: i.MX 8QXP MBpa8Xx board
#@MAINTAINER: Markus Niebel <Markus.Niebel@tq-group.com>
#
# Processor                     Memory    Configuration
# --------------                ------    ------------------------------
# i.MX8QXP B0                   1GiB      tqma8xqp_mbpa8xx_mmc_defconfig

require conf/machine/include/tqma8xx.inc
require conf/machine/include/mba8xx-common.inc

BOARD_DEVICETREE_FILES = "\
	fsl-imx8qxp-tqma8xqp-mbpa8xx.dtb \
"

require conf/machine/include/tqma8-common.inc

# Files are needed in IMAGE_BOOT_FILES because /boot is on an extra partition.
# If those files should be installed under /boot inside the rootfs, you can
# achieve this in your BSP layer adding them via
# IMAGE_INSTALL_append = " kernel-devicetree kernel-image-zimage"
#
IMAGE_BOOT_FILES ?= "\
	${KERNEL_IMAGETYPE} \
	${BOARD_DEVICETREE_FILES} \
	"

UBOOT_CONFIG ??= "sd"
UBOOT_CONFIG[sd] = "tqma8xqp_mbpa8xx_mmc_defconfig"
```

## conf/machine/tqma8xqp4-mba8xx.conf
```bitbake
#@TYPE: Machine
#@NAME: i.MX 8QXP TQMa8XQP4 on MBa8Xx
#@DESCRIPTION: i.MX 8QXP MBa8Xx starter kit
#@MAINTAINER: Markus Niebel <Markus.Niebel@tq-group.com>
#
# Processor       Boot device              Memory    Configuration
# -----------     -----------              ------    -----------------------------
# i.MX8QXP C0     e-MMM / SD               2GiB      tqma8xqp_2gb_mba8xx_defconfig
# i.MX8QXP C0     FlexSPI                  2GiB      tqma8xqp_2gb_mba8xx_defconfig
# i.MX8QXP C0     Serial downloader        2GiB      tqma8xqp_2gb_mba8xx_defconfig

require conf/machine/include/tqma8xx.inc
require conf/machine/include/mba8xx-common.inc

BOARD_DEVICETREE_FILES = "\
	imx8qxp-tqma8xqp-mba8xx.dtb \
	imx8qxp-tqma8xqp-mba8xx-lvds0-tm070jvhg33.dtb \
	imx8qxp-tqma8xqp-mba8xx-lvds1-tm070jvhg33.dtb \
	imx8qxp-tqma8xqp-mba8xx-rpmsg.dtb \
"

require conf/machine/include/tqma8-common.inc

IMAGE_BOOT_FILES ?= "\
	${KERNEL_IMAGETYPE} \
	${BOARD_DEVICETREE_FILES} \
	"

UBOOT_CONFIG ??= "sd fspi mfgtool"
UBOOT_CONFIG[sd] = "tqma8xqp_2gb_mba8xx_defconfig,wic"
UBOOT_CONFIG[fspi] = "tqma8xqp_2gb_mba8xx_defconfig"
UBOOT_CONFIG[mfgtool] = "tqma8xqp_2gb_mba8xx_mfg_defconfig"
```

## conf/machine/tqma8xqps-mb-smarc-2-r0200.conf
```bitbake
#@TYPE: Machine
#@NAME: i.MX 8QXP TQMa8XQPS REV.0200 on MB-SMARC-2
#@DESCRIPTION: i.MX8QXP MB-SMARC-2 kit
#@MAINTAINER: Markus Niebel <Markus.Niebel@tq-group.com>
#
# Processor       Boot device              Memory    Configuration
# -----------     -----------              ------    -----------------------------
# i.MX8QXP C0     e-MMM / SD               2GiB      tqma8xqps_mb_smarc_2_r0200_defconfig
#                 FlexSPI                  2GiB      tqma8xqps_mb_smarc_2_r0200_defconfig

require conf/machine/include/tqma8xxs.inc
require conf/machine/include/mb-smarc-2-common.inc

# TODO:
BOARD_DEVICETREE_FILES = "\
	imx8qxp-mb-smarc-2-r0200.dtb \
	imx8qxp-mb-smarc-2-r0200-lvds-g133han01.dtb \
	imx8qxp-mb-smarc-2-r0200-lvds-tm070jvhg33.dtb \
"

require conf/machine/include/tqma8-common.inc

# Files are needed in IMAGE_BOOT_FILES because /boot is on an extra partition.
# If those files should be installed under /boot inside the rootfs, you can
# achieve this in your BSP layer adding them via
# IMAGE_INSTALL_append = " kernel-devicetree kernel-image-zimage"
#
IMAGE_BOOT_FILES ?= "\
	${KERNEL_IMAGETYPE} \
	${BOARD_DEVICETREE_FILES} \
	"

UBOOT_CONFIG ??= "sd"
UBOOT_CONFIG[sd] = "tqma8xqps_mb_smarc_2_r0200_defconfig,wic"
UBOOT_CONFIG[fspi] = "tqma8xqps_mb_smarc_2_r0200_defconfig"
UBOOT_CONFIG[mfgtool] = "tqma8xqps_mb_smarc_2_r0200_mfg_defconfig"

# TODO: handle optee as soon as supported
IMXBOOT_TARGETS ?= "flash_spl flash_spl_flexspi"
```

## conf/machine/tqma8xqps-mb-smarc-2.conf
```bitbake
#@TYPE: Machine
#@NAME: i.MX 8QXP TQMa8XQPS on MB-SMARC-2
#@DESCRIPTION: i.MX8QXP MB-SMARC-2 kit
#@MAINTAINER: Markus Niebel <Markus.Niebel@tq-group.com>
#
# Processor       Boot device              Memory    Configuration
# -----------     -----------              ------    -----------------------------
# i.MX8QXP C0     e-MMM / SD               2GiB      tqma8xqps_mb_smarc_2_defconfig
#                 FlexSPI                  2GiB      tqma8xqps_mb_smarc_2_defconfig

require conf/machine/include/tqma8xxs.inc
require conf/machine/include/mb-smarc-2-common.inc

BOARD_DEVICETREE_FILES = "\
    imx8qxp-tqma8xqps-mb-smarc-2.dtb \
    imx8qxp-tqma8xqps-mb-smarc-2-lvds0-tm070jvhg33.dtb \
    imx8qxp-tqma8xqps-mb-smarc-2-lvds1-tm070jvhg33.dtb \
    imx8qxp-tqma8xqps-mb-smarc-2-rpmsg.dtb \
"

#TODO:
#imx8qxp-tqma8xqps-mb-smarc-2-lvds0-g133han01.dtb

require conf/machine/include/tqma8-common.inc

IMAGE_BOOT_FILES = "\
    ${KERNEL_IMAGETYPE} \
    ${BOARD_DEVICETREE_FILES} \
"

UBOOT_CONFIG ??= "\
    fspi \
    mfgtool \
    sd \
"

UBOOT_CONFIG[sd] = "tqma8xqps_mb_smarc_2_defconfig,wic"
UBOOT_CONFIG[fspi] = "tqma8xqps_mb_smarc_2_defconfig"
UBOOT_CONFIG[mfgtool] = "tqma8xqps_mb_smarc_2_mfg_defconfig"
```

## conf/machine/tqmarzg2h-mbarzg2x.conf
```bitbake
#@TYPE: Machine
#@NAME: tqmarzg2h-mbarzg2x machine
#@DESCRIPTION: TQ-Group TQMaRZG2H Module (4GB) on MBaRZG2x Baseboard

require conf/machine/include/tqmarzg2h.inc
require conf/machine/include/tqmarzg2x-mbarzg2x.inc

BOARD_DEVICETREE_FILES = " \
	r8a774e1-tqmarzg2h-mbarzg2x.dtb \
	r8a774e1-tqmarzg2h-mbarzg2x-lvds-tm070jvhg33.dtb \
"

UBOOT_CONFIG ??= "tqmarzg2h-mbarzg2x"
UBOOT_CONFIG[tqmarzg2h-mbarzg2x] = "tqmarzg2h_mbarzg2x_defconfig"

# Files are needed in IMAGE_BOOT_FILES because /boot is on an extra partition.
# If those files should be installed under /boot inside the rootfs, you can
# achieve this in your BSP layer adding them via
# IMAGE_INSTALL_append = " kernel-devicetree kernel-image-zimage"
#
IMAGE_BOOT_FILES ?= "\
	${KERNEL_IMAGETYPE} \
	${BOARD_DEVICETREE_FILES} \
"
```

## conf/machine/tqmarzg2h_c-mbarzg2x.conf
```bitbake
#@TYPE: Machine
#@NAME: tqmarzg2h_c-mbarzg2x machine
#@SOC: RZ/G2H
#@DESCRIPTION: TQ-Group TQMaRZG2H Module (4GB) on MBaRZG2x Baseboard
#@MAINTAINER: Andreas Dumberger <andreas.dumberger@tq-group.com>

require conf/machine/include/tqmarzg2h_c.inc
require conf/machine/include/tqmarzg2x-mbarzg2x.inc

# Device tree for RZG2H
KERNEL_DEVICETREE = " \
	renesas/r8a774e1-tqmarzg2h_c-mbarzg2x.dtb \
	renesas/r8a774e1-tqmarzg2h_c-mbarzg2x-lvds-tm070jvhg33.dtb \
"

# RZG2M u-boot configure
UBOOT_CONFIG ??= "tqmarzg2h_c-mbarzg2x"
UBOOT_CONFIG[tqmarzg2h_c-mbarzg2x] = "tqmarzg2h_c-mbarzg2x_defconfig"

# Files are needed in IMAGE_BOOT_FILES because /boot is on an extra partition.
# If those files should be installed under /boot inside the rootfs, you can
# achieve this in your BSP layer adding them via
# IMAGE_INSTALL_append = " kernel-devicetree kernel-image-zimage"
#
IMAGE_BOOT_FILES ?= "\
	${KERNEL_IMAGETYPE} \
	r8a774e1-tqmarzg2h_c-mbarzg2x.dtb \
	r8a774e1-tqmarzg2h_c-mbarzg2x-lvds-tm070jvhg33.dtb \
"
```

## conf/machine/tqmarzg2m_aa-mbarzg2x.conf
```bitbake
#@TYPE: Machine
#@NAME: tqmarzg2m_aa-mbarzg2x machine
#@SOC: RZ/G2M
#@DESCRIPTION: TQ-Group TQMaRZG2M Module (2GB) on MBaRZG2x Baseboard
#@MAINTAINER: Andreas Dumberger <andreas.dumberger@tq-group.com>

SOC_FAMILY = "rzg2:r8a774a1"
MACHINEOVERRIDES =. "r8a774a1:tqmarzg2m_aa:"

require conf/machine/include/tqmarzg2x.inc
require conf/machine/include/tqmarzg2x-mbarzg2x.inc
require conf/machine/include/tqmarzg2m_aa-mbarzg2x.inc
```

## conf/machine/tqmarzg2m_e-mbarzg2x.conf
```bitbake
#@TYPE: Machine
#@NAME: tqmarzg2m_e-mbarzg2x machine
#@SOC: RZ/G2M
#@DESCRIPTION: TQ-Group TQMaRZG2M Module (8GB) on MBaRZG2x Baseboard
#@MAINTAINER: Andreas Dumberger <andreas.dumberger@tq-group.com>

require conf/machine/include/tqmarzg2m_e.inc
require conf/machine/include/tqmarzg2x-mbarzg2x.inc

# Device tree for RZG2M
BOARD_DEVICETREE_FILES = " \
	r8a774a1-tqmarzg2m_e-mbarzg2x.dtb \
	r8a774a1-tqmarzg2m_e-mbarzg2x-lvds-tm070jvhg33.dtb \
"

# RZG2M u-boot configure
UBOOT_CONFIG ??= "tqmarzg2m_e-mbarzg2x"
UBOOT_CONFIG[tqmarzg2m_e-mbarzg2x] = "tqmarzg2m_e-mbarzg2x_defconfig"

# Files are needed in IMAGE_BOOT_FILES because /boot is on an extra partition.
# If those files should be installed under /boot inside the rootfs, you can
# achieve this in your BSP layer adding them via
# IMAGE_INSTALL_append = " kernel-devicetree kernel-image-zimage"
#
IMAGE_BOOT_FILES ?= "\
	${KERNEL_IMAGETYPE} \
	${BOARD_DEVICETREE_FILES} \
"
```

## conf/machine/tqmarzg2n-mbarzg2x.conf
```bitbake
#@TYPE: Machine
#@NAME: tqmarzg2n-mbarzg2x machine
#@DESCRIPTION: TQ-Group TQMaRZG2N Module (2GB) on MBaRZG2x Baseboard

require conf/machine/include/tqmarzg2n.inc
require conf/machine/include/tqmarzg2x-mbarzg2x.inc

BOARD_DEVICETREE_FILES = " \
	r8a774b1-tqmarzg2n-mbarzg2x.dtb \
	r8a774b1-tqmarzg2n-mbarzg2x-lvds-tm070jvhg33.dtb \
"

UBOOT_CONFIG ??= "tqmarzg2n-mbarzg2x"
UBOOT_CONFIG[tqmarzg2n-mbarzg2x] = "tqmarzg2n_mbarzg2x_defconfig"

# Files are needed in IMAGE_BOOT_FILES because /boot is on an extra partition.
# If those files should be installed under /boot inside the rootfs, you can
# achieve this in your BSP layer adding them via
# IMAGE_INSTALL_append = " kernel-devicetree kernel-image-zimage"
#
IMAGE_BOOT_FILES ?= "\
	${KERNEL_IMAGETYPE} \
	${BOARD_DEVICETREE_FILES} \
"
```

## conf/machine/tqmarzg2n_b-mbarzg2x.conf
```bitbake
#@TYPE: Machine
#@NAME: tqmarzg2n_b-mbarzg2x machine
#@SOC: RZ/G2N
#@DESCRIPTION: TQ-Group TQMaRZG2N Module (2GB) on MBaRZG2x Baseboard
#@MAINTAINER: Andreas Dumberger <andreas.dumberger@tq-group.com>

require conf/machine/include/tqmarzg2n_b.inc
require conf/machine/include/tqmarzg2x-mbarzg2x.inc

# Device tree for RZG2N
KERNEL_DEVICETREE = " \
	renesas/r8a774b1-tqmarzg2n_b-mbarzg2x.dtb \
	renesas/r8a774b1-tqmarzg2n_b-mbarzg2x-lvds-tm070jvhg33.dtb \
"

# RZG2M u-boot configure
UBOOT_CONFIG ??= "tqmarzg2n_b-mbarzg2x"
UBOOT_CONFIG[tqmarzg2n_b-mbarzg2x] = "tqmarzg2n_b-mbarzg2x_defconfig"

# Files are needed in IMAGE_BOOT_FILES because /boot is on an extra partition.
# If those files should be installed under /boot inside the rootfs, you can
# achieve this in your BSP layer adding them via
# IMAGE_INSTALL_append = " kernel-devicetree kernel-image-zimage"
#
IMAGE_BOOT_FILES ?= "\
	${KERNEL_IMAGETYPE} \
	r8a774b1-tqmarzg2n_b-mbarzg2x.dtb \
	r8a774b1-tqmarzg2n_b-mbarzg2x-lvds-tm070jvhg33.dtb \
"
```

## conf/machine/tqmls1012al-1gb-mbls1012al.conf
```bitbake
#@TYPE: Machine
#@NAME: TQ-Group TQMLS1012AL Module on MBLS1012AL Baseboard
#@SOC: LS1012A
#@DESCRIPTION: Machine configuration for TQ-Group TQMLS1012AL
#@MAINTAINER: Matthias Schiffer <matthias.schiffer@tq-group.com>
#
# Processor	Boot Device	Memory	Configuration
# ---------	-----------	------	--------------------
# LS1012A	QSPI		1GB	tqmls1012al_mbls1012al_tfa_defconfig
#

require conf/machine/include/tqmls1012al-1gb.inc
require conf/machine/include/tqmls1012al-mbls1012al.inc
```

## conf/machine/tqmls1012al-mbls1012al.conf
```bitbake
#@TYPE: Machine
#@NAME: TQ-Group TQMLS1012AL Module on MBLS1012AL Baseboard
#@SOC: LS1012A
#@DESCRIPTION: Machine configuration for TQ-Group TQMLS1012AL
#@MAINTAINER: Matthias Schiffer <matthias.schiffer@tq-group.com>
#
# Processor	Boot Device	Configuration
# ---------	-----------	--------------------
# LS1012A	QSPI		tqmls1012al_mbls1012al_tfa_defconfig
#

require conf/machine/include/tqmls1012al.inc

SERIAL_CONSOLES = "115200;ttyS0"
SERIAL_CONSOLES_CHECK = "${SERIAL_CONSOLES}"
# no virtual terminal needed
USE_VT = "0"

KERNEL_DEVICETREE ?= " \
  freescale/fsl-ls1012a-mbls1012al.dtb \
"

# Files are needed in IMAGE_BOOT_FILES because /boot is on an extra partition.
# If those files should be installed under /boot inside the rootfs, you can
# achieve this in your BSP layer adding them via
# IMAGE_INSTALL_append = " kernel-devicetree kernel-image"
#
IMAGE_BOOT_FILES ?= "\
	${KERNEL_IMAGETYPE} \
	fsl-ls1012a-mbls1012al.dtb \
"

UBOOT_CONFIG ?= "tfa"
UBOOT_CONFIG[tfa] = "tqmls1012al_mbls1012al_tfa_defconfig"
```

## conf/machine/tqmls1028a-mbls1028a-emmc.conf
```bitbake
#@TYPE: Machine
#@NAME: TQ-Group TQMLS1028a Module on MBLS1028a Baseboard (default to eMMC boot)
#@SOC: ls1028a
#@DESCRIPTION: Machine configuration for TQ-Group TQMLS1028a
#@MAINTAINER: Matthias Schiffer <matthias.schiffer@tq-group.com>
#
# By default, this machine will build for the full featured option
# with SD / eMMC boot
#
# To build U-Boot for other CPU or memory combinations, you can set
# the UBOOT_MACHINE variable in your local.conf according to the
# following table:
#
# Processor	Boot Device	Configuration
# --------- 	------------	-----------------------------------
# LS1028A	SD		tqmls1028a_mbls1028a_ind_sdcard_defconfig
# LS1028A	eMMC		tqmls1028a_mbls1028a_ind_emmc_defconfig

BOOTMODE ?= "emmc"

require conf/machine/tqmls1028a-mbls1028a.conf

MACHINEOVERRIDES =. "tqmls1028a-mbls1028a:"
```

## conf/machine/tqmls1028a-mbls1028a-ind.conf
```bitbake
#@TYPE: Machine
#@NAME: TQ-Group TQMLS1028A module on MBLS1028A-IND baseboard
#@SOC: LS1028A
#@DESCRIPTION: Machine configuration for TQ-Group TQMLS1028A
#@MAINTAINER: Matthias Schiffer <matthias.schiffer@tq-group.com>
#
# By default, this machine will build for the full featured option
# with SD / eMMC boot
#
# To build U-Boot for other CPU or memory combinations, you can set
# the UBOOT_MACHINE variable in your local.conf according to the
# following table:
#
# Processor	Boot Device	Configuration
# --------- 	------------	--------------------------------------
# LS1028A	any		tqmls1028a_mbls1028a_ind_tfa_defconfig

require conf/machine/tqmls1028a-mbls1028a.conf

MACHINEOVERRIDES =. "tqmls1028a-mbls1028a:"

UBOOT_CONFIG[tfa] = "tqmls1028a_mbls1028a_ind_tfa_defconfig,wic"
```

## conf/machine/tqmls1028a-mbls1028a.conf
```bitbake
#@TYPE: Machine
#@NAME: TQ-Systems GmbH TQMLS1028A module on MBLS1028A baseboard
#@SOC: LS1028A
#@DESCRIPTION: Machine configuration for TQ-Systems GmbH TQMLS1028A
#@MAINTAINER: Matthias Schiffer <matthias.schiffer@tq-group.com>
#
# By default, this machine will build for the full featured option
# with SD / eMMC boot
#
# To build U-Boot for other CPU or memory combinations, you can set
# the UBOOT_MACHINE variable in your local.conf according to the
# following table:
#
# Processor	Boot Device	Configuration
# --------- 	------------	-----------------------------------
# LS1028A	any		tqmls1028a_mbls1028a_tfa_defconfig

# Note: This file is included by tqmls1028a-mbls1028a-ind.conf.
# Modifications to this file may require adjustments to the -ind
# configuration as well.

require conf/machine/include/tqmls1028a.inc

SERIAL_CONSOLES ?= "115200;ttyS1"
SERIAL_CONSOLES_CHECK ?= "${SERIAL_CONSOLES}"
# disable virtual console support for this board and limit getty to SERIAL_CONSOLES only
USE_VT = "0"

KERNEL_DEVICETREE ?= " \
    freescale/fsl-ls1028a-mbls1028a.dtb \
    freescale/fsl-ls1028a-mbls1028a-ind.dtb \
"

# Files are needed in IMAGE_BOOT_FILES because /boot is on an extra partition.
# If those files should be installed under /boot inside the rootfs, you can
# achieve this in your BSP layer adding them via
# IMAGE_INSTALL_append = " kernel-devicetree kernel-image-zimage"
#
IMAGE_BOOT_FILES = "\
    ${KERNEL_IMAGETYPE} \
    fsl-ls1028a-mbls1028a.dtb \
    fsl-ls1028a-mbls1028a-ind.dtb \
"
IMAGE_BOOT_FILES_append_qoriq = "\
    dp/ls1028a-dp-fw.bin;ls1028a-dp-fw.bin \
"

UBOOT_CONFIG ?= "tfa"

UBOOT_CONFIG[tfa] = "tqmls1028a_mbls1028a_tfa_defconfig,wic"
```
