## conf/machine/tqmls102xa-mbls102xa.conf
```bitbake
#@TYPE: Machine
#@NAME: TQ-Group TQMLS102xa Module on MBLS102xa Baseboard
#@SOC: ls102xa
#@DESCRIPTION: Machine configuration for TQ-Group TQMLS102xa
#@MAINTAINER: Markus Niebel <Markus.Niebel@tq-group.com>
#
# By default, this machine will build for the full featured option
# with SD / eMMC boot
#
# To build U-Boot for other CPU or memory combinations, you can set
# the UBOOT_MACHINE variable in your local.conf according to the
# following table:
#
# Processor	Memory / Options	Boot Device	Configuration
# ---------	----------------	-----------	-------------------------------------------
# LS1021A	1024MiB / RGMII		SD / e-MMC	tqmls102xa_mbls102xa_rgmii_mmcsd_defconfig
# LS1021A	1024MiB / RGMII		QSPI NOR	tqmls102xa_mbls102xa_rgmii_qspi_defconfig
# LS1021A	1024MiB / CAN		SD / e-MMC	tqmls102xa_mbls102xa_can_mmcsd_defconfig
# LS1021A	1024MiB / CAN		QSPI NOR	tqmls102xa_mbls102xa_can_qspi_defconfig
# LS1021A	1024MiB / SAI		SD / e-MMC	tqmls102xa_mbls102xa_sai_mmcsd_defconfig
# LS1021A	1024MiB / SAI		QSPI NOR	tqmls102xa_mbls102xa_sai_qspi_defconfig
# LS1021A	1024MiB / ECC / RGMII	QSPI NOR	tqmls102xa_mbls102xa_ecc_rgmii_qspi_defconfig
# LS1021A	1024MiB	/ ECC / RGMII	SD / e-MMC	tqmls102xa_mbls102xa_ecc_rgmii_mmcsd_defconfig
# LS1021A	1024MiB / ECC / CAN	QSPI NOR	tqmls102xa_mbls102xa_ecc_can_qspi_defconfig
# LS1021A	1024MiB	/ ECC / CAN	SD / e-MMC	tqmls102xa_mbls102xa_ecc_can_mmcsd_defconfig
# LS1021A	2048MiB	/ ECC / CAN	QSPI NOR	tqmls1021a-ae_mbls102xa_ecc_can_qspi_defconfig
# LS1021A	2048MiB	/ ECC / RGMII	QSPI NOR	tqmls1021a-ae_mbls102xa_ecc_rgmii_qspi_defconfig
#

require conf/machine/include/tqmls102xa.inc

SERIAL_CONSOLES ?= "115200;ttyS0 115200;ttyS1 115200;ttyLP0 115200"
SERIAL_CONSOLES_CHECK ?= "${SERIAL_CONSOLES}"
USE_VT ?= "0"

KERNEL_DEVICETREE ?= " \
                        ls1021a-mbls1021a.dtb \
                        ls1021a-mbls1021a-dmb-ct21.dtb \
                        ls1021a-mbls1021a-dmb-ct44.dtb \
                        ls1021a-mbls1021a-glyn-etm0700g0edh6.dtb \
                        ls1021a-mbls1021a-lvds-tm070jvhg33.dtb \
                        ls1021a-mbls1021a-hdmi.dtb \
"

QE_UCODE="iram_Type_A_LS1021a_r1.0.bin"

IMAGE_BOOT_FILES ?= "\
	${KERNEL_IMAGETYPE};linuximage \
	${KERNEL_DEVICETREE} \
"

UBOOT_CONFIG ??= "\
 sd qspi sd_can qspi_can sd_sai qspi_sai \
 sd_ecc qspi_ecc sd_ecc_can qspi_ecc_can \
 ae_qspi_ecc ae_qspi_ecc_can"

UBOOT_CONFIG[sd] = "tqmls102xa_mbls102xa_rgmii_mmcsd_defconfig,wic"
UBOOT_CONFIG[qspi] = "tqmls102xa_mbls102xa_rgmii_qspi_defconfig,ubi"
UBOOT_CONFIG[sd_can] = "tqmls102xa_mbls102xa_can_mmcsd_defconfig"
UBOOT_CONFIG[qspi_can] = "tqmls102xa_mbls102xa_can_qspi_defconfig"
UBOOT_CONFIG[sd_sai] = "tqmls102xa_mbls102xa_sai_mmcsd_defconfig"
UBOOT_CONFIG[qspi_sai] = "tqmls102xa_mbls102xa_sai_qspi_defconfig"
UBOOT_CONFIG[sd_ecc] = "tqmls102xa_mbls102xa_ecc_rgmii_mmcsd_defconfig"
UBOOT_CONFIG[qspi_ecc] = "tqmls102xa_mbls102xa_ecc_rgmii_qspi_defconfig"
UBOOT_CONFIG[sd_ecc_can] = "tqmls102xa_mbls102xa_ecc_can_mmcsd_defconfig"
UBOOT_CONFIG[qspi_ecc_can] = "tqmls102xa_mbls102xa_ecc_can_qspi_defconfig"
UBOOT_CONFIG[ae_qspi_ecc] = "tqmls1021a-ae_mbls102xa_ecc_rgmii_qspi_defconfig"
UBOOT_CONFIG[ae_qspi_ecc_can] = "tqmls1021a-ae_mbls102xa_ecc_can_qspi_defconfig"
```

## conf/machine/tqmls1043a_2g-mbls10xxa.conf
```bitbake
#@TYPE: Machine
#@NAME: TQ-Systems GmbH TQMLS1043A Module on MBLS10xxa Baseboard
#@SOC: ls1043a
#@DESCRIPTION: Machine configuration for TQ-Systems GmbH TQMLS1043A
#@MAINTAINER: Gregor Herburger <gregor.herburger@tq-group.com>
#
# By default, this machine will build for the full featured option
# with QSPI-NOR boot
#
# To build U-Boot for other CPU or memory combinations, you can set
# the UBOOT_MACHINE variable in your local.conf according to the
# following table:
#
# Processor Memory          Boot Device  Configuration
# --------- ---------------	------------ --------------------
# LS1043A   2048MiB / ECC   QSPI-NOR     tqmls1043a_mbls10xxa_qspi_2g_defconfig
# LS1043A   2048MiB / ECC   SD / eMMC    tqmls1043a_mbls10xxa_esdhc_2g_defconfig
#
# The reset-configuration word (RCW) for the board is included in the
# u-boot source code. There are various RCWs supported for different
# SerDes configurations supported on the MBLS10xxA baseboard. Select
# RCW by setting UBOOT_RCW_CONFIG variable in your local.conf to one
# of the following values, otherwise u-boot default would be used:
# - TQMLS1043A_RCW_3358

require conf/machine/include/tqmls1043a.inc

SERIAL_CONSOLES ?= "115200;ttyS1"
SERIAL_CONSOLES_CHECK ?= "${SERIAL_CONSOLES}"
# disable virtual console support for this board and limit getty to SERIAL_CONSOLES only
USE_VT = "0"

KERNEL_DEVICETREE ?= " \
    freescale/fsl-tqmls1043a-mbls10xxa.dtb \
"

# Files are needed in IMAGE_BOOT_FILES because /boot is on an extra partition.
# If those files should be installed under /boot inside the rootfs, you can
# achieve this in your BSP layer adding them via
# IMAGE_INSTALL_append = " kernel-devicetree kernel-image-zimage"
#
IMAGE_BOOT_FILES = "\
    ${KERNEL_IMAGETYPE};linuximage \
    fsl-tqmls1043a-mbls10xxa.dtb \
"

UBOOT_CONFIG ??= "qspi esdhc"
UBOOT_CONFIG[qspi] = "tqmls1043a_mbls10xxa_qspi_2g_defconfig,ubi"
UBOOT_CONFIG[esdhc] = "tqmls1043a_mbls10xxa_esdhc_2g_defconfig,wic"

UBOOT_RCW_CONFIG ??= ""
```

## conf/machine/tqmls1046a_8g-mbls10xxa.conf
```bitbake
#@TYPE: Machine
#@NAME: TQ-Systems GmbH TQMLS1046A Module with 8GB DDR on MBLS10xxa Baseboard
#@SOC: ls1046a
#@DESCRIPTION: Machine configuration for TQ-Systems GmbH TQMLS1046A (8GB DDR)
#@MAINTAINER: Timo Herbrecher <t.herbrecher@gateware.de>
#
# By default, this machine will build for the full featured option
# with QSPI-NOR boot
#
# To build U-Boot for other CPU or memory combinations, you can set
# the UBOOT_MACHINE variable in your local.conf according to the
# following table:
#
# Processor Memory          Boot Device  Configuration
# --------- ---------------	------------ --------------------
# LS1046A   8192MiB / ECC   QSPI-NOR     tqmls1046a_mbls10xxa_qspi_8g_defconfig
# LS1046A   8192MiB / ECC   SD / eMMC    tqmls1046a_mbls10xxa_esdhc_8g_defconfig
#
# The reset-configuration word (RCW) for the board is included in the
# u-boot source code. There are various RCWs supported for different
# SerDes configurations supported on the MBLS10xxA baseboard. Select
# RCW by setting UBOOT_RCW_CONFIG variable in your local.conf to one
# of the following values, otherwise u-boot default would be used:
# - TQMLS1046A_RCW_1040_5506
# - TQMLS1046A_RCW_1040_5559
# - TQMLS1046A_RCW_1040_5577
# - TQMLS1046A_RCW_1040_5A06
# - TQMLS1046A_RCW_1040_5A59
# - TQMLS1046A_RCW_1133_5506
# - TQMLS1046A_RCW_1133_5559
# - TQMLS1046A_RCW_1133_5577
# - TQMLS1046A_RCW_1133_5A06
# - TQMLS1046A_RCW_1133_5A59
# - TQMLS1046A_RCW_3333_5506
# - TQMLS1046A_RCW_3333_5559
# - TQMLS1046A_RCW_3333_5577
# - TQMLS1046A_RCW_3333_5A06
# - TQMLS1046A_RCW_3333_5A59

require conf/machine/include/tqmls1046a.inc

SERIAL_CONSOLES ?= "115200;ttyS1"
SERIAL_CONSOLES_CHECK ?= "${SERIAL_CONSOLES}"
USE_VT ?= "0"

KERNEL_DEVICETREE ?= " \
    freescale/fsl-tqmls1046a-mbls10xxa.dtb \
    "

# Files are needed in IMAGE_BOOT_FILES because /boot is on an extra partition.
# If those files should be installed under /boot inside the rootfs, you can
# achieve this in your BSP layer adding them via
# IMAGE_INSTALL_append = " kernel-devicetree kernel-image-zimage"
#
IMAGE_BOOT_FILES ?= "\
    ${KERNEL_IMAGETYPE};linuximage \
    fsl-tqmls1046a-mbls10xxa.dtb \
    "

UBOOT_CONFIG ??= "qspi esdhc"
UBOOT_CONFIG[qspi] = "tqmls1046a_mbls10xxa_qspi_8g_defconfig,ubi"
UBOOT_CONFIG[esdhc] = "tqmls1046a_mbls10xxa_esdhc_8g_defconfig,wic"

UBOOT_RCW_CONFIG ??= ""
```

## conf/machine/tqmls1088a-mbls10xxa.conf
```bitbake
#@TYPE: Machine
#@NAME: TQ-Systems GmbH TQMLS1088A Module on MBLS10xxa Baseboard
#@SOC: ls1088a
#@DESCRIPTION: Machine configuration for TQ-Systems GmbH TQMLS1088a
#@MAINTAINER: Timo Herbrecher <t.herbrecher@gateware.de>
#
# By default, this machine will build for the full featured option
# with QSPI-NOR boot
#
# To build U-Boot for other CPU or memory combinations, you can set
# the UBOOT_MACHINE variable in your local.conf according to the
# following table:
#
# Processor Memory          Boot Device  Configuration
# --------- ---------------	------------ --------------------
# LS1088A   2048MiB / ECC   QSPI-NOR     tqmls1088a_mbls10xxa_qspi_defconfig
# LS1088A   2048MiB / ECC   SD / eMMC    tqmls1088a_mbls10xxa_esdhc_defconfig
#

require conf/machine/include/tqmls1088a.inc

SERIAL_CONSOLES ?= "115200;ttyS1"
SERIAL_CONSOLES_CHECK ?= "${SERIAL_CONSOLES}"
# disable virtual console support for this board and limit getty to SERIAL_CONSOLES only
USE_VT = "0"

KERNEL_DEVICETREE ?= " \
    freescale/fsl-tqmls1088a-mbls10xxa.dtb \
"

# Files are needed in IMAGE_BOOT_FILES because /boot is on an extra partition.
# If those files should be installed under /boot inside the rootfs, you can
# achieve this in your BSP layer adding them via
# IMAGE_INSTALL_append = " kernel-devicetree kernel-image-zimage"
#
IMAGE_BOOT_FILES ?= "\
    ${KERNEL_IMAGETYPE};linuximage \
    fsl-tqmls1088a-mbls10xxa.dtb \
"

UBOOT_CONFIG ??= "qspi esdhc"
UBOOT_CONFIG[qspi] = "tqmls1088a_mbls10xxa_qspi_defconfig,ubi"
UBOOT_CONFIG[esdhc] = "tqmls1088a_mbls10xxa_esdhc_defconfig,wic"

# Reset Configuration Word for TQMLS1088A is handled by NXP RCW tool (see fork
# in TQ rcw git repository). Following variables select the RCW files used for
# different boot sources.
RCWSD ??= "RR_SSSSPPPH_3333_5559/rcw_1400_sdboot.bin"
RCWEMMC ??= "RR_SSSSPPPH_3333_5559/rcw_1400_emmcboot.bin"
RCWQSPI ??= "RR_SSSSPPPH_3333_5559/rcw_1400_qspiboot.bin"

MC_FLAVOUR ?= "${MACHINE}"
MC_DPC ?= "dpc.0x12_0x0D.dtb"
MC_DPL ?= "dpl-eth.0x12_0x0D.dtb"
```

## conf/machine/tqmlx2160a-mblx2160a.conf
```bitbake
#@TYPE: Machine
#@NAME: TQ-Systems GmbH TQMLX2160A Module on MBLX2160A Baseboard
#@SOC: lx2160A
#@DESCRIPTION: Machine configuration for TQ-Systems GmbH TQMLX2160A
#@MAINTAINER: Gregor Herburger <gregor.herburger@tq-group.com>
#
require conf/machine/include/tqmlx2160a.inc

# no default assignment here, since we overwrite defaults from qoriq-arm64.inc
SERIAL_CONSOLES = "115200;ttyS1"
SERIAL_CONSOLES_CHECK = "${SERIAL_CONSOLES}"
USE_VT = "0"

KERNEL_DEVICETREE ?= " \
    freescale/fsl-lx2160a-mblx2160a.dtb \
"

# Files are needed in IMAGE_BOOT_FILES because /boot is on an extra partition.
# If those files should be installed under /boot inside the rootfs, you can
# achieve this in your BSP layer adding them via
# IMAGE_INSTALL:append = " kernel-devicetree kernel-image-zimage"
#
IMAGE_BOOT_FILES = "\
    ${KERNEL_IMAGETYPE} \
    fsl-lx2160a-mblx2160a.dtb \
    mc_app/mc.itb;mc.itb \
    mc-utils/${MC_DPC};${MC_DPC} \
    mc-utils/${MC_DPL};${MC_DPL} \
"

# direct assignment to override empty default from meta-freescale
WKS_FILE = "tqmlx2160a.wks"

WKS_FILE_DEPENDS = "\
    dosfstools-native \
    mtools-native \
    parted-native \
    qoriq-atf \
    virtual/bootloader \
    virtual/kernel \
"

# Do not update fstab file when using wic images
WIC_CREATE_EXTRA_ARGS = "--no-fstab-update"

UBOOT_CONFIG ?= "tfa"

UBOOT_CONFIG[tfa] = "tqmlx2160a_mblx2160a_tfa_defconfig,wic"

# Reset Configuration Word for TQMLX2160A
rcw ?= "tqmlx2160a-mblx2160a/rcw_2200_750_2800_14_11_2"

#
# mc-utils example configuration for starter kit
# needs to be adjusted for custom boards / setups
#
MC_FOLDER ?= "${MACHINE}"
MC_DPC ?= "dpc-warn.dtb"
MC_DPL ?= "dpl-min.dtb"

BOOTTYPE ?= "\
    emmc \
    flexspi_nor \
    sd \
"

# Do not put Images into /boot of rootfs, install kernel-image if needed
RDEPENDS:${KERNEL_PACKAGE_NAME}-base = ""
```

## conf/machine/tqmt1022-64bit-stkt104x.conf
```bitbake
#@TYPE: Machine
#@NAME: TQMT1022-64B Starter Kit
#@SOC: tqmt1022
#@DESCRIPTION: Machine configuration for the TQMT1042 Starter Kit in 64-bit mode
#@MAINTAINER: Konrad Gräfe <k.graefe@gateware.de>
#
# Processor           Memory  Boot device  Configuration
# --------------      ------  -----------  --------------------
# T1022               2GiB    MMC / SD
# T1022               2GiB    QSPI-NOR
#

require conf/machine/include/tqmt104x-stkt104x.inc
include conf/machine/include/tqmt1022-stkt104x.inc
require conf/machine/include/tqmt104x-64bit-stkt104x.inc
```

## conf/machine/tqmt1040-64bit-stkt104x.conf
```bitbake
#@TYPE: Machine
#@NAME: TQMT1042-64B Starter Kit
#@SOC: tqmt1042
#@DESCRIPTION: Machine configuration for the TQMT1042 Starter Kit in 64-bit mode
#@MAINTAINER: Konrad Gräfe <k.graefe@gateware.de>
#
# Processor           Memory  Boot device  Configuration
# --------------      ------  -----------  --------------------
# T1040               2GiB    MMC / SD
# T1040               2GiB    QSPI-NOR
#

require conf/machine/include/tqmt104x-stkt104x.inc
include conf/machine/include/tqmt1040-stkt104x.inc
require conf/machine/include/tqmt104x-64bit-stkt104x.inc

#IMAGE_INSTALL_append = " uio-seville"
```

## conf/machine/tqmt1042-64bit-stkt104x-serdes88.conf
```bitbake
#@TYPE: Machine
#@NAME: TQMT1042-64B Starter Kit
#@SOC: tqmt1042
#@DESCRIPTION: Machine configuration for the TQMT1042 Starter Kit in 64-bit mode
#@MAINTAINER: Konrad Gräfe <k.graefe@gateware.de>
#
# Processor           Memory  Boot device  Configuration
# --------------      ------  -----------  --------------------
# T1042               2GiB    MMC / SD
# T1042               2GiB    QSPI-NOR
#

UBOOT_CONFIG[nor] = "TQMT1042_serdes88_defconfig"
UBOOT_CONFIG[sdcard] = "TQMT1042_SDCARD_serdes88_defconfig"

FSL_RCW ?= "TQMT1042_SERDES88"

require conf/machine/include/tqmt104x-stkt104x.inc
require conf/machine/include/tqmt1042-stkt104x.inc
require conf/machine/include/tqmt104x-64bit-stkt104x.inc
```
