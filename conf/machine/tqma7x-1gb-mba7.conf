## conf/machine/tqma7x-1gb-mba7.conf
```bitbake
#@TYPE: Machine
#@NAME: TQ-Group TQMa7x Module with 1 GiB RAM on MBa7 Baseboard
#@SOC: i.MX7
#@DESCRIPTION: Machine configuration for TQ-Group TQMa7 SOLO / DUAL
#@MAINTAINER: Markus Niebel <Markus.Niebel@tq-group.com>
#
# By default, this machine will build for the full featured option
# with SD / eMMC boot
#
# To build U-Boot for other CPU or memory combinations, you can set
# the UBOOT_MACHINE variable in your local.conf according to the
# following table:
#
# Processor           Memory  Boot device  Configuration
# --------------      ------  -----------  --------------------
# i.MX7 S/D	      1GiB    MMC / SD     tqma7d_1gb_mba7_mmc_defconfig
# i.MX7 S/D	      1GiB    QSPI NOR     tqma7d_1gb_mba7_qspi_defconfig
#

include conf/machine/include/tqma7x-mba7.inc

UBOOT_CONFIG ?= "sd qspi"
UBOOT_CONFIG[sd] = "tqma7d_1gb_mba7_mmc_defconfig,wic"
UBOOT_CONFIG[qspi] = "tqma7d_1gb_mba7_qspi_defconfig,ubi"
```

## conf/machine/tqma7x-mba7.conf
```bitbake
#@TYPE: Machine
#@NAME: TQ-Group TQMa7x Module on MBa7 Baseboard
#@SOC: i.MX7
#@DESCRIPTION: Machine configuration for TQ-Group TQMa7 SOLO / DUAL
#@MAINTAINER: Markus Niebel <Markus.Niebel@tq-group.com>
#
# By default, this machine will build for the full featured option
# with SD / eMMC boot
#
# To build U-Boot for other CPU or memory combinations, you can set
# the UBOOT_MACHINE variable in your local.conf according to the
# following table:
#
# Processor           Memory  Boot device  Configuration
# --------------      ------  -----------  --------------------
# i.MX7 S/D	      512MiB  MMC / SD     tqma7d_512mb_mba7_mmc_defconfig
# i.MX7 S/D	      512MiB  QSPI NOR     tqma7d_512mb_mba7_qspi_defconfig
# i.MX7 S/D	      1GiB    MMC / SD     tqma7d_1gb_mba7_mmc_defconfig
# i.MX7 S/D	      1GiB    QSPI NOR     tqma7d_1gb_mba7_qspi_defconfig
# i.MX7 S/D	      2GiB    MMC / SD     tqma7d_2gb_mba7_mmc_defconfig
# i.MX7 S/D	      2GiB    QSPI NOR     tqma7d_2gb_mba7_qspi_defconfig
#

include conf/machine/include/tqma7.inc

SERIAL_CONSOLES = "115200;ttymxc5"

KERNEL_DEVICETREE ?= " \
			imx7d-mba7.dtb \
			imx7d-mba7-lvds.dtb \
			imx7d-mba7-otg.dtb \
			imx7d-mba7-dmb-ct21.dtb \
			imx7d-mba7-dmb-ct44.dtb \
			imx7d-mba7-glyn-etm0700g0edh6.dtb \
			imx7d-mba7-r0100.dtb \
			imx7d-mba7-lvds-r0100.dtb \
			imx7d-mba7-otg-r0100.dtb \
			imx7d-mba7-dmb-ct21-r0100.dtb \
			imx7d-mba7-dmb-ct44-r0100.dtb \
			imx7d-mba7-glyn-etm0700g0edh6-r0100.dtb \
			imx7s-mba7.dtb \
			imx7s-mba7-lvds.dtb \
			imx7s-mba7-otg.dtb \
			imx7s-mba7-dmb-ct21.dtb \
			imx7s-mba7-dmb-ct44.dtb \
			imx7s-mba7-glyn-etm0700g0edh6.dtb \
			imx7s-mba7-r0100.dtb \
			imx7s-mba7-lvds-r0100.dtb \
			imx7s-mba7-otg-r0100.dtb \
			imx7s-mba7-dmb-ct21-r0100.dtb \
			imx7s-mba7-dmb-ct44-r0100.dtb \
			imx7s-mba7-glyn-etm0700g0edh6-r0100.dtb \
"

# Files are needed in IMAGE_BOOT_FILES because /boot is on an extra partition.
# If those files should be installed under /boot inside the rootfs, you can
# achieve this in your BSP layer adding them via
# IMAGE_INSTALL_append = " kernel-devicetree kernel-image-zimage"
#
IMAGE_BOOT_FILES ?= "\
	${KERNEL_IMAGETYPE};linuximage \
	${KERNEL_IMAGETYPE}-imx7d-mba7.dtb;imx7d-mba7.dtb \
	${KERNEL_IMAGETYPE}-imx7d-mba7-lvds.dtb;imx7d-mba7-lvds.dtb \
	${KERNEL_IMAGETYPE}-imx7d-mba7-otg.dtb;imx7d-mba7-otg.dtb \
	${KERNEL_IMAGETYPE}-imx7d-mba7-dmb-ct21.dtb;imx7d-mba7-dmb-ct21.dtb \
	${KERNEL_IMAGETYPE}-imx7d-mba7-dmb-ct44.dtb;imx7d-mba7-dmb-ct44.dtb \
	${KERNEL_IMAGETYPE}-imx7d-mba7-glyn-etm0700g0edh6.dtb;imx7d-mba7-glyn-etm0700g0edh6.dtb \
	${KERNEL_IMAGETYPE}-imx7d-mba7-r0100.dtb;imx7d-mba7-r0100.dtb \
	${KERNEL_IMAGETYPE}-imx7d-mba7-lvds-r0100.dtb;imx7d-mba7-lvds-r0100.dtb \
	${KERNEL_IMAGETYPE}-imx7d-mba7-otg-r0100.dtb;imx7d-mba7-otg-r0100.dtb \
	${KERNEL_IMAGETYPE}-imx7d-mba7-dmb-ct21-r0100.dtb;imx7d-mba7-dmb-ct21-r0100.dtb \
	${KERNEL_IMAGETYPE}-imx7d-mba7-dmb-ct44-r0100.dtb;imx7d-mba7-dmb-ct44-r0100.dtb \
	${KERNEL_IMAGETYPE}-imx7d-mba7-glyn-etm0700g0edh6-r0100.dtb;imx7d-mba7-glyn-etm0700g0edh6-r0100.dtb \
	${KERNEL_IMAGETYPE}-imx7s-mba7.dtb;imx7s-mba7.dtb \
	${KERNEL_IMAGETYPE}-imx7s-mba7-lvds.dtb;imx7s-mba7-lvds.dtb \
	${KERNEL_IMAGETYPE}-imx7s-mba7-otg.dtb;imx7s-mba7-otg.dtb \
	${KERNEL_IMAGETYPE}-imx7s-mba7-dmb-ct21.dtb;imx7s-mba7-dmb-ct21.dtb \
	${KERNEL_IMAGETYPE}-imx7s-mba7-dmb-ct44.dtb;imx7s-mba7-dmb-ct44.dtb \
	${KERNEL_IMAGETYPE}-imx7s-mba7-glyn-etm0700g0edh6.dtb;imx7s-mba7-glyn-etm0700g0edh6.dtb \
	${KERNEL_IMAGETYPE}-imx7s-mba7-r0100.dtb;imx7s-mba7-r0100.dtb \
	${KERNEL_IMAGETYPE}-imx7s-mba7-lvds-r0100.dtb;imx7s-mba7-lvds-r0100.dtb \
	${KERNEL_IMAGETYPE}-imx7s-mba7-otg-r0100.dtb;imx7s-mba7-otg-r0100.dtb \
	${KERNEL_IMAGETYPE}-imx7s-mba7-dmb-ct21-r0100.dtb;imx7s-mba7-dmb-ct21-r0100.dtb \
	${KERNEL_IMAGETYPE}-imx7s-mba7-dmb-ct44-r0100.dtb;imx7s-mba7-dmb-ct44-r0100.dtb \
	${KERNEL_IMAGETYPE}-imx7s-mba7-glyn-etm0700g0edh6-r0100.dtb;imx7s-mba7-glyn-etm0700g0edh6-r0100.dtb \
	"

WKS_FILE ?= "tqmaxx-sdimg.wks"

UBOOT_CONFIG ??= "sd sd_512mb sd_1gb sd_2gb qspi_512mb qspi_1gb qspi_2gb"
UBOOT_CONFIG[sd] = "tqma7d_512mb_mba7_mmc_defconfig"
UBOOT_CONFIG[sd_512mb] = "tqma7d_512mb_mba7_mmc_defconfig,wic"
UBOOT_CONFIG[sd_1gb] = "tqma7d_1gb_mba7_mmc_defconfig"
UBOOT_CONFIG[sd_2gb] = "tqma7d_2gb_mba7_mmc_defconfig"
UBOOT_CONFIG[qspi_512mb] = "tqma7d_512mb_mba7_qspi_defconfig,ubi"
UBOOT_CONFIG[qspi_1gb] = "tqma7d_1gb_mba7_qspi_defconfig"
UBOOT_CONFIG[qspi_2gb] = "tqma7d_2gb_mba7_qspi_defconfig"
UBOOT_CONFIG[mfgtool] = "tqma7d_512mb_mba7_mmc_defconfig"
```

## conf/machine/tqma8dx-mba8xx.conf
```bitbake
#@TYPE: Machine
#@NAME: i.MX 8DX TQMa8XD on MBa8Xx
#@DESCRIPTION: i.MX 8DX MBa8Xx starter kit
#@MAINTAINER: Markus Niebel <Markus.Niebel@tq-group.com>
#
# Processor                     Memory    Configuration
# --------------                ------    ----------------------------
# i.MX8DX B0                    512MiB    tqma8xd_mba8xx_mmc_defconfig

require conf/machine/include/tqma8qx.inc
require conf/machine/include/mba8qx-common.inc

# TODO:
KERNEL_DEVICETREE = "\
	freescale/fsl-imx8dx-tqma8xd-mba8xx.dtb \
	freescale/fsl-imx8dx-tqma8xd-mba8xx-lvds-tm070jvhg33.dtb \
"

# Files are needed in IMAGE_BOOT_FILES because /boot is on an extra partition.
# If those files should be installed under /boot inside the rootfs, you can
# achieve this in your BSP layer adding them via
# IMAGE_INSTALL_append = " kernel-devicetree kernel-image-zimage"
#
IMAGE_BOOT_FILES ?= "\
	${KERNEL_IMAGETYPE} \
	${KERNEL_IMAGETYPE}-fsl-imx8dx-tqma8xd-mba8xx.dtb;fsl-imx8dx-tqma8xd-mba8xx.dtb \
	${KERNEL_IMAGETYPE}-fsl-imx8dx-tqma8xd-mba8xx-lvds-tm070jvhg33.dtb;fsl-imx8dx-tqma8xd-mba8xx-lvds-tm070jvhg33.dtb \
	"

UBOOT_CONFIG ??= "sd"
UBOOT_CONFIG[sd] = "tqma8xd_mba8xx_mmc_defconfig"
```

## conf/machine/tqma8mpxl-2gb-mba8mpxl-r0100.conf
```bitbake
#@TYPE: Machine
#@NAME: i.MX 8MP TQMa8MP[Q,D,S[L]]L on MBa8MPxL REV.0100
#@DESCRIPTION: i.MX 8MP MBa8MPxL starter kit and computing board
#@MAINTAINER: Markus Niebel <Markus.Niebel@tq-group.com>
#
# Processor                     Memory    Configuration
# --------------                ------    --------------------------------------
# i.MX8MP[Q,D,S][L]             2GiB      tqma8mpxl_2gb_mba8mpxl_r0100_defconfig

require conf/machine/include/tqma8mpxl.inc
require conf/machine/include/tqma8mpxl-mba8mpxl.inc

# Set u-boot DTB
UBOOT_DTB_NAME = "imx8mp-mba8mpxl-r0100.dtb"

BOARD_DEVICETREE_FILES = "\
    imx8mp-tqma8mpql-mba8mpxl-r0100.dtb \
"

# Set u-boot DTB
UBOOT_DTB_NAME = "imx8mp-mba8mpxl-r0100.dtb"

UBOOT_CONFIG ??= "sd mfgtool"
UBOOT_CONFIG[sd] = "tqma8mpxl_2gb_mba8mpxl_r0100_defconfig,wic"
UBOOT_CONFIG[mfgtool] = "tqma8mpxl_2gb_mba8mpxl_r0100_mfg_defconfig"
```

## conf/machine/tqma8mpxl-2gb-mba8mpxl.conf
```bitbake
#@TYPE: Machine
#@NAME: i.MX 8MP TQMa8MP[Q,D,S[L]]L on MBa8MPxL
#@DESCRIPTION: i.MX 8MP MBa8MPxL starter kit and computing board
#@MAINTAINER: Markus Niebel <Markus.Niebel@tq-group.com>
#
# Processor                     Memory    Configuration
# --------------                ------    --------------------------------------
# i.MX8MP[Q,D,S][L]             2GiB      tqma8mpxl_2gb_mba8mpxl_defconfig

require conf/machine/include/tqma8mpxl.inc
require conf/machine/include/tqma8mpxl-mba8mpxl.inc

UBOOT_CONFIG ??= "sd mfgtool"
UBOOT_CONFIG[sd] = "tqma8mpxl_2gb_mba8mpxl_defconfig,wic"
UBOOT_CONFIG[mfgtool] = "tqma8mpxl_2gb_mba8mpxl_mfg_defconfig"
```

## conf/machine/tqma8mq-2gm-mba8mx.conf
```bitbake
#@TYPE: Machine
#@NAME: i.MX 8MQ TQMa8MQL on MBa8MX
#@DESCRIPTION: i.MX 8MQ MBa8MX starter kit
#@MAINTAINER: Markus Niebel <Markus.Niebel@tq-group.com>
#
# Processor                     Memory    Configuration
# --------------                ------    ----------------------------
# i.MX8MQ                       2GiB       tqma8mq_2gmicron_mba8mx_mmc_defconfig

require conf/machine/include/tqma8mx.inc
require conf/machine/include/mba8mx.inc

# Set u-boot DTB
UBOOT_DTB_NAME = "fsl-imx8mq-tqma8mq-mba8mx.dtb"

UBOOT_CONFIG ??= "sd"
UBOOT_CONFIG[sd] = "tqma8mq_2gmicron_mba8mx_mmc_defconfig"
```

## conf/machine/tqma8mq-mba8mx.conf
```bitbake
#@TYPE: Machine
#@NAME: i.MX 8MQ TQMa8MQ on MBa8MX
#@DESCRIPTION: i.MX 8MQ MBa8MX starter kit
#@MAINTAINER: Markus Niebel <Markus.Niebel@tq-group.com>
#
# Processor                     Memory    Configuration
# --------------                ------    ----------------------------
# i.MX8MQ                       1GB       tqma8mq_mba8mx_mmc_defconfig

require conf/machine/include/tqma8mx.inc

# TODO:
KERNEL_DEVICETREE = "\
	freescale/fsl-imx8mq-tqma8mq-mba8mx.dtb \
"

# Set Serial console
SERIAL_CONSOLE = "115200 ttymxc0"

# Files are needed in IMAGE_BOOT_FILES because /boot is on an extra partition.
# If those files should be installed under /boot inside the rootfs, you can
# achieve this in your BSP layer adding them via
# IMAGE_INSTALL_append = " kernel-devicetree kernel-image-zimage"
#
IMAGE_BOOT_FILES ?= "\
	${KERNEL_IMAGETYPE} \
	${KERNEL_IMAGETYPE}-fsl-imx8mq-tqma8mq-mba8mx.dtb;fsl-imx8mq-tqma8mq-mba8mx.dtb \
	"

# Set u-boot DTB
UBOOT_DTB_NAME = "fsl-imx8mq-tqma8mq-mba8mx.dtb"

UBOOT_CONFIG ??= "sd"
UBOOT_CONFIG[sd] = "tqma8mq_mba8mx_mmc_defconfig"
```

## conf/machine/tqma8mx-1gb-mba8mx.conf
```bitbake
#@TYPE: Machine
#@NAME: i.MX 8MQ TQMa8M[Q,D] (1 GiB) on MBa8Mx
#@DESCRIPTION: i.MX 8MQ MBa8Mx starter kit
#@MAINTAINER: Markus Niebel <Markus.Niebel@tq-group.com>
#
# Processor                     Memory    Configuration
# --------------                ------    --------------------------------------
# i.MX8M[Q,D]                   1GB       tqma8mq_1gb_mba8mx_mmc_defconfig

require conf/machine/include/tqma8mx.inc
require conf/machine/include/mba8mx.inc

# note: we can only build on configuration her, since do_eploy tries to install
# for imx_mkimage and this logic only can poe with on config at a time
UBOOT_CONFIG ??= "sd"
UBOOT_CONFIG[sd] = "tqma8mq_1gb_mba8mx_mmc_defconfig,wic"
UBOOT_CONFIG[mgftool] = "tqma8mq_1gb_mba8mx_mfg_defconfig"
```

## conf/machine/tqma8mx-1gm-mba8mx.conf
```bitbake
#@TYPE: Machine
#@NAME: i.MX 8MQ TQMa8MQ (1GiB) on MBa8MX
#@DESCRIPTION: i.MX 8MQ MBa8MX starter kit
#@MAINTAINER: Markus Niebel <Markus.Niebel@tq-group.com>
#
# Processor                     Memory    Configuration
# --------------                ------    ----------------------------
# i.MX8MQ                       1GB       tqma8mq_1g_mba8mx_mmc_defconfig

require conf/machine/include/tqma8mx.inc
require conf/machine/include/mba8mx.inc

# Set u-boot DTB
UBOOT_DTB_NAME = "fsl-imx8mq-tqma8mq-mba8mx.dtb"

UBOOT_CONFIG ??= "sd"
UBOOT_CONFIG[sd] = "tqma8mq_1g_mba8mx_mmc_defconfig,wic"
```

## conf/machine/tqma8mx-2gb-mba8mx.conf
```bitbake
#@TYPE: Machine
#@NAME: i.MX 8MQ TQMa8M[Q,D]L on MBa8Mx
#@DESCRIPTION: i.MX 8MQ MBa8Mx starter kit
#@MAINTAINER: Markus Niebel <Markus.Niebel@tq-group.com>
#
# Processor                     Memory    Configuration
# --------------                ------    --------------------------------------
# i.MX8M[Q,L]L                  2GiB      tqma8mq_2gb_mba8mx_mmc_defconfig

require conf/machine/include/tqma8mx.inc
require conf/machine/include/tqma8mx-mba8mx.inc

# note: we can only build one configuration here, since do_deploy tries to install
# for imx_mkimage and this logic only can cope with one config at a time
UBOOT_CONFIG ??= "sd"
UBOOT_CONFIG[sd] = "tqma8mq_2gb_mba8mx_mmc_defconfig,wic"
UBOOT_CONFIG[mfgtool] = "tqma8mq_2gb_mba8mx_mfg_defconfig"
```

## conf/machine/tqma8mx-2gm-mba8mx.conf
```bitbake
#@TYPE: Machine
#@NAME: i.MX 8MQ TQMa8M[Q,D]L on MBa8MX
#@DESCRIPTION: i.MX 8MQ MBa8MX starter kit
#@MAINTAINER: Markus Niebel <Markus.Niebel@tq-group.com>
#
# Processor                     Memory    Configuration
# --------------                ------    --------------------------------------
# i.MX8M[Q,L]L                  2GiB      tqma8mq_2g_mba8mx_mmc_defconfig

require conf/machine/include/tqma8mx.inc
require conf/machine/include/mba8mx.inc

# note: we can only build on configuration her, since do_eploy tries to install
# for imx_mkimage and this logic only can poe with on config at a time
UBOOT_CONFIG ??= "sd"
UBOOT_CONFIG[sd] = "tqma8mq_2g_mba8mx_mmc_defconfig,wic"
UBOOT_CONFIG[mgftool] = "tqma8mq_2g_mba8mx_mfg_defconfig"
```

## conf/machine/tqma8mxml-2gb-mba8mx.conf
```bitbake
#@TYPE: Machine
#@NAME: i.MX 8MM TQMa8MxML REV.0200 (2 GiB) on MBa8Mx
#@DESCRIPTION: i.MX8MM MBa8MX starter kit
#@MAINTAINER: Markus Niebel <Markus.Niebel@tq-group.com>
#
# Processor                     Memory    Configuration
# --------------                ------    --------------------------------------
# i.MX8MM                       2GB       tqma8mxml_2gb_mba8mx_mmc_defconfig

require conf/machine/include/tqma8mxml.inc

# Set u-boot DTB
UBOOT_DTB_NAME = "imx8mm-mba8mx.dtb"

BOARD_DEVICETREE_FILES = "\
    imx8mm-mba8mx.dtb \
    imx8mm-mba8mx-lcdif-lvds-tm070jvhg33.dtb \
    imx8mm-mba8mx-lcdif-lvds-tm070jvhg33-imx327.dtb \
    imx8mm-mba8mx-lcdif-lvds-tm070jvhg33-ov9281.dtb \
    imx8mm-mba8mx-rpmsg.dtb \
"

KERNEL_DEVICETREE = ""

require conf/machine/include/tqma8-common.inc

# Set Serial console
SERIAL_CONSOLES = "115200;ttymxc2"

IMAGE_BOOT_FILES ?= "\
    ${KERNEL_IMAGETYPE} \
    ${BOARD_DEVICETREE_FILES} \
"

MACHINE_FEATURES_append = " camera"

IMAGE_BOOT_FILES += " \
    hello_world.bin \
    rpmsg_lite_pingpong_rtos_linux_remote.bin \
"

WKS_FILE_DEPENDS_append = "\
	tqma8-cortexm-demos \
	"

UBOOT_CONFIG ??= "sd fspi mfgtool"
UBOOT_CONFIG[sd] = "tqma8mxml_2gb_mba8mx_mmc_defconfig,wic"
UBOOT_CONFIG[fspi] = "tqma8mxml_2gb_mba8mx_fspi_defconfig"
UBOOT_CONFIG[mfgtool] = "tqma8mxml_2gb_mba8mx_mfg_defconfig"

IMXBOOT_TARGETS = "flash_spl_uboot flash_evk_flexspi"
```
