## conf/machine/tqma8mxml-512m-mba8mx.conf
```bitbake
#@TYPE: Machine
#@NAME: i.MX 8MM TQMa8MxML (512 MiB) on MBa8Mx
#@DESCRIPTION: i.MX8MM MBa8MX starter kit
#@MAINTAINER: Markus Niebel <Markus.Niebel@tq-group.com>
#
# Processor                     Memory    Configuration
# --------------                ------    --------------------------------------
# i.MX8MM                       512MB     tqma8mmx_512mb_mba8mx_mmc_defconfig

require conf/machine/include/tqma8mxml.inc

# Set u-boot DTB
UBOOT_DTB_NAME = "fsl-imx8mm-mba8mx.dtb"

BOARD_DEVICETREE_FILES = "\
    imx8mm-mba8mx.dtb \
    imx8mm-mba8mx-lcdif-lvds-tm070jvhg33.dtb \
"

KERNEL_DEVICETREE = ""

require conf/machine/include/tqma8-common.inc

# Set Serial console
SERIAL_CONSOLES = "115200;ttymxc2"

# Files are needed in IMAGE_BOOT_FILES because /boot is on an extra partition.
# If those files should be installed under /boot inside the rootfs, you can
# achieve this in your BSP layer adding them via
# IMAGE_INSTALL_append = " kernel-devicetree kernel-image-zimage"
#
IMAGE_BOOT_FILES ?= "\
    ${KERNEL_IMAGETYPE} \
    ${BOARD_DEVICETREE_FILES} \
"

# note: we can only build on configuration her, since do_eploy tries to install
# for imx_mkimage and this logic only can poe with on config at a time
UBOOT_CONFIG ??= "sd"
UBOOT_CONFIG[sd] = "tqma8mmx_512mb_mba8mx_mmc_defconfig,wic"
UBOOT_CONFIG[mfgtool] = "tqma8mmx_512mb_mba8mx_mfg_defconfig"
```

## conf/machine/tqma8mxnl-1gb-mba8mx.conf
```bitbake
#@TYPE: Machine
#@NAME: i.MX 8MN TQMa8MxNL (1 GiB) on MBa8Mx
#@DESCRIPTION: i.MX8MN MBa8Mx starter kit
#@MAINTAINER: Markus Niebel <Markus.Niebel@tq-group.com>
#
# Processor                     Memory    Configuration
# --------------                ------    --------------------------------------
# i.MX8MN                       1GB       tqma8mxnl_1gb_mba8mx_defconfig

require conf/machine/include/tqma8mxnl.inc
require conf/machine/include/mba8mx-common.inc

# Set u-boot DTB
UBOOT_DTB_NAME = "imx8mn-mba8mx.dtb"

BOARD_DEVICETREE_FILES = "\
    imx8mn-tqma8mqnl-mba8mx.dtb \
    imx8mn-tqma8mqnl-mba8mx-lcdif-lvds-tm070jvhg33.dtb \
    imx8mn-tqma8mqnl-mba8mx-lcdif-lvds-tm070jvhg33-imx327.dtb \
    imx8mn-tqma8mqnl-mba8mx-lcdif-lvds-tm070jvhg33-ov9281.dtb \
    imx8mn-tqma8mqnl-mba8mx-rpmsg.dtb \
"

KERNEL_DEVICETREE = ""

require conf/machine/include/tqma8-common.inc

UBOOT_CONFIG ??= "\
    sd \
    mfgtool \
"

UBOOT_CONFIG[sd] = "tqma8mxnl_1gb_mba8mx_defconfig,wic"
UBOOT_CONFIG[mfgtool] = "tqma8mxnl_1gb_mba8mx_mfg_defconfig"

IMXBOOT_TARGETS ?= "\
    flash_evk_flexspi \
    flash_spl_uboot \
"
```

## conf/machine/tqma8qm-4gb-mba8x.conf
```bitbake
#@TYPE: Machine
#@NAME: i.MX 8QM TQMa8QM 4 GiB RAM on MBa8x
#@DESCRIPTION: i.MX 8QM MBa8x starter kit
#@MAINTAINER: Markus Niebel <Markus.Niebel@tq-group.com>
#
# Processor                     Memory    Configuration
# --------------                ------    -------------------------------
# i.MX8QM B0                    4 GiB     tqma8qm_4gb_mba8x_mmc_defconfig

require conf/machine/include/tqma8x.inc
require conf/machine/include/mba8x-common.inc

UBOOT_CONFIG ??= "sd"
UBOOT_CONFIG[sd] = "tqma8qm_4gb_mba8x_defconfig,wic"
UBOOT_CONFIG[fspi] = "tqma8qm_4gb_mba8x_defconfig"
UBOOT_CONFIG[mfgtool] = "tqma8qm_mba8x_mfg_defconfig"

# TODO: handle optee as soon as supported
IMXBOOT_TARGETS ?= "flash_spl flash_spl_flexspi"
```

## conf/machine/tqma8qm-8gb-mba8x.conf
```bitbake
#@TYPE: Machine
#@NAME: i.MX 8QM TQMa8QM 8 GiB RAM on MBa8x
#@DESCRIPTION: i.MX 8QM MBa8x starter kit
#@MAINTAINER: Markus Niebel <Markus.Niebel@tq-group.com>
#
# Processor                     Memory    Configuration
# --------------                ------    -------------------------------
# i.MX8QM B0                    8 GiB     tqma8qm_8gb_mba8x_mmc_defconfig

require conf/machine/include/tqma8x.inc
require conf/machine/include/mba8x-common.inc

UBOOT_CONFIG ??= "sd"
UBOOT_CONFIG[sd] = "tqma8qm_8gb_mba8x_mmc_defconfig,wic"
UBOOT_CONFIG[fspi] = "tqma8qm_8gb_mba8x_fspi_defconfig"

# TODO: handle optee as soon as supported
IMXBOOT_TARGETS_SD = "flash"
IMXBOOT_TARGETS_FSPI = "flash_flexspi"
IMXBOOT_TARGETS = \
    "${@bb.utils.contains('UBOOT_CONFIG', 'sd', '${IMXBOOT_TARGETS_SD}', \
                                                '${IMXBOOT_TARGETS_FSPI}', d)}"
```

## conf/machine/tqma8qm-mba8x.conf
```bitbake
#@TYPE: Machine
#@NAME: i.MX 8QM TQMa8QM on MBa8x
#@DESCRIPTION: i.MX 8QM MBa8x starter kit
#@MAINTAINER: Markus Niebel <Markus.Niebel@tq-group.com>
#
# Processor                     Memory    Configuration
# --------------                ------    -----------------------------
# i.MX8QM B0                    2 GiB     tqma8qm_mba8x_mmc_defconfig

require conf/machine/include/tqma8x.inc
require conf/machine/include/mba8x-common.inc

# TODO:
KERNEL_DEVICETREE = "\
	freescale/fsl-imx8qm-tqma8qm-mba8x.dtb \
"

# Files are needed in IMAGE_BOOT_FILES because /boot is on an extra partition.
# If those files should be installed under /boot inside the rootfs, you can
# achieve this in your BSP layer adding them via
# IMAGE_INSTALL_append = " kernel-devicetree kernel-image-zimage"
#
IMAGE_BOOT_FILES ?= "\
	${KERNEL_IMAGETYPE} \
	${KERNEL_IMAGETYPE}-fsl-imx8qm-tqma8qm-mba8x.dtb;fsl-imx8qm-tqma8qm-mba8x.dtb \
	"

UBOOT_CONFIG ??= "sd"
UBOOT_CONFIG[sd] = "tqma8qm_mba8x_mmc_defconfig"
```

## conf/machine/tqma8qxa0-mba8qx.conf
```bitbake
#@TYPE: Machine
#@NAME: i.MX 8QXP TQMa8QX on MBa8QX
#@DESCRIPTION: i.MX 8QXP MBa8QX starter kit
#@MAINTAINER: Markus Niebel <Markus.Niebel@tq-group.com>
#
# Processor                     Memory    Configuration
# --------------                ------    ----------------------------
# i.MX8QX A0                    2GB       tqma8qx_mba8qx_mmc_defconfig

require conf/machine/include/tqma8qxa0.inc
require conf/machine/include/mba8qx-common.inc

# TODO:
KERNEL_DEVICETREE = "\
	freescale/fsl-imx8qxp-tqma8qx-a0-mba8qx.dtb \
"

# Files are needed in IMAGE_BOOT_FILES because /boot is on an extra partition.
# If those files should be installed under /boot inside the rootfs, you can
# achieve this in your BSP layer adding them via
# IMAGE_INSTALL_append = " kernel-devicetree kernel-image-zimage"
#
IMAGE_BOOT_FILES ?= "\
	${KERNEL_IMAGETYPE} \
	${KERNEL_IMAGETYPE}-fsl-imx8qxp-tqma8qx-a0-mba8qx.dtb;fsl-imx8qxp-tqma8qx-a0-mba8qx.dtb \
	"

UBOOT_CONFIG ??= "sd"
UBOOT_CONFIG[sd] = "tqma8qx_mba8qx_mmc_defconfig"
```

## conf/machine/tqma8qxp-mba8xx.conf
```bitbake
#@TYPE: Machine
#@NAME: i.MX 8QXP TQMa8QXP on MBa8QX
#@DESCRIPTION: i.MX 8QXP MBa8QX starter kit
#@MAINTAINER: Markus Niebel <Markus.Niebel@tq-group.com>
#
# Processor                     Memory    Configuration
# --------------                ------    ----------------------------
# i.MX8QXP B0                   1GiB      tqma8qx_mba8qx_mmc_defconfig

require conf/machine/include/tqma8qx.inc
require conf/machine/include/mba8qx-common.inc

# TODO:
KERNEL_DEVICETREE = "\
	freescale/fsl-imx8qxp-tqma8qxp-mba8xx.dtb \
	freescale/fsl-imx8qxp-tqma8qxp-mba8xx-lvds-tm070jvhg33.dtb \
"

# Files are needed in IMAGE_BOOT_FILES because /boot is on an extra partition.
# If those files should be installed under /boot inside the rootfs, you can
# achieve this in your BSP layer adding them via
# IMAGE_INSTALL_append = " kernel-devicetree kernel-image-zimage"
#
IMAGE_BOOT_FILES ?= "\
	${KERNEL_IMAGETYPE} \
	${KERNEL_IMAGETYPE}-fsl-imx8qxp-tqma8qxp-mba8xx.dtb;fsl-imx8qxp-tqma8qxp-mba8xx.dtb \
	${KERNEL_IMAGETYPE}-fsl-imx8qxp-tqma8qxp-mba8xx-lvds-tm070jvhg33.dtb;fsl-imx8qxp-tqma8qxp-mba8xx-lvds-tm070jvhg33.dtb \
	"

UBOOT_CONFIG ??= "sd"
UBOOT_CONFIG[sd] = "tqma8qx_mba8qx_mmc_defconfig"
```

## conf/machine/tqma8qxs-mb-smarc-2.conf
```bitbake
#@TYPE: Machine
#@NAME: i.MX 8QXP TQMa8QXS on MB-SMARC-2
#@DESCRIPTION: i.MX 8QXP MB-SMARC-2 kit
#@MAINTAINER: Markus Niebel <Markus.Niebel@tq-group.com>
#
# Processor                     Memory    Configuration
# --------------                ------    ----------------------------
# i.MX8QX A0                    2GB       tqma8qxs_mb_smarc_2_mmc_defconfig

require conf/machine/include/tqma8qxs.inc
require conf/machine/include/tqma8qxs-mb-smarc-2-common.inc

# TODO:
KERNEL_DEVICETREE = "\
	freescale/fsl-imx8qxp-tqma8qxs-mb-smarc-2.dtb \
"

# Files are needed in IMAGE_BOOT_FILES because /boot is on an extra partition.
# If those files should be installed under /boot inside the rootfs, you can
# achieve this in your BSP layer adding them via
# IMAGE_INSTALL_append = " kernel-devicetree kernel-image-zimage"
#
IMAGE_BOOT_FILES ?= "\
	${KERNEL_IMAGETYPE} \
	${KERNEL_IMAGETYPE}-fsl-imx8qxp-tqma8qxs-mb-smarc-2.dtb;fsl-imx8qxp-tqma8qxs-mb-smarc-2.dtb \
	"

UBOOT_CONFIG ??= "sd"
UBOOT_CONFIG[sd] = "tqma8qxs_mb_smarc_2_mmc_defconfig"
```

## conf/machine/tqma8xdp-mba8xx.conf
```bitbake
#@TYPE: Machine
#@NAME: i.MX 8DXP TQMa8XDP on MBa8Xx
#@DESCRIPTION: i.MX 8DXP MBa8Xx starter kit
#@MAINTAINER: Markus Niebel <Markus.Niebel@tq-group.com>
#
# Processor       Boot device              Memory    Configuration
# -----------     -----------              ------    -----------------------------
# i.MX8DXP B0     e-MMM / SD               1GiB      tqma8xdp_mba8xx_defconfig
# i.MX8DXP B0     FlexSPI                  1GiB      tqma8xdp_mba8xx_defconfig

require conf/machine/include/tqma8xx.inc
require conf/machine/include/mba8xx-common.inc

BOARD_DEVICETREE_FILES = "\
	imx8dxp-mba8xx.dtb \
	imx8dxp-mba8xx-lvds0-tm070jvhg33.dtb \
	imx8dxp-mba8xx-lvds1-tm070jvhg33.dtb \
"

require conf/machine/include/tqma8-common.inc

# Files are needed in IMAGE_BOOT_FILES because /boot is on an extra partition.
# If those files should be installed under /boot inside the rootfs, you can
# achieve this in your BSP layer adding them via
# IMAGE_INSTALL_append = " kernel-devicetree kernel-image-zimage"
#
IMAGE_BOOT_FILES ?= "\
	${KERNEL_IMAGETYPE} \
	${BOARD_DEVICETREE_FILES} \
	"

# note: we can only build one configuration here, since do_deploy tries to install
# for imx_mkimage and this logic only can cope with one config at a time
UBOOT_CONFIG ??= "sd"
UBOOT_CONFIG[sd] = "tqma8xdp_mba8xx_defconfig,wic"
UBOOT_CONFIG[fspi] = "tqma8xdp_mba8xx_defconfig"
UBOOT_CONFIG[mfgtool] = "tqma8xdp_mba8xx_mfg_defconfig"

# TODO: handle optee as soon as supported
IMXBOOT_TARGETS ?= "flash_spl flash_spl_flexspi"
```

## conf/machine/tqma8xdps-mb-smarc-2.conf
```bitbake
#@TYPE: Machine
#@NAME: i.MX 8DXP TQMa8XDPS on MB-SMARC-2
#@DESCRIPTION: i.MX8DXP MB-SMARC-2 kit
#@MAINTAINER: Markus Niebel <Markus.Niebel@tq-group.com>
#
# Processor       Boot device              Memory    Configuration
# -----------     -----------              ------    -----------------------------
# i.MX8DXP C0     e-MMM / SD               2GiB      tqma8xdps_mb_smarc_2_defconfig
#                 FlexSPI                  2GiB      tqma8xdps_mb_smarc_2_defconfig

require conf/machine/include/tqma8xxs.inc
require conf/machine/include/mb-smarc-2-common.inc

BOARD_DEVICETREE_FILES = "\
    imx8dxp-tqma8xdps-mb-smarc-2.dtb \
    imx8dxp-tqma8xdps-mb-smarc-2-lvds0-tm070jvhg33.dtb \
    imx8dxp-tqma8xdps-mb-smarc-2-lvds1-tm070jvhg33.dtb \
    imx8dxp-tqma8xdps-mb-smarc-2-rpmsg.dtb \
"

#TODO:
#imx8dxp-tqma8xdps-mb-smarc-2-lvds0-g133han01.dtb

require conf/machine/include/tqma8-common.inc

IMAGE_BOOT_FILES ?= "\
    ${KERNEL_IMAGETYPE} \
    ${BOARD_DEVICETREE_FILES} \
"

UBOOT_CONFIG ??= "sd fspi mfgtool"
UBOOT_CONFIG[sd] = "tqma8xdps_mb_smarc_2_defconfig,wic"
UBOOT_CONFIG[fspi] = "tqma8xdps_mb_smarc_2_defconfig"
UBOOT_CONFIG[mfgtool] = "tqma8xdps_mb_smarc_2_mfg_defconfig"
```

## conf/machine/tqma8xds-mb-smarc-2.conf
```bitbake
#@TYPE: Machine
#@NAME: i.MX 8DX TQMa8XDS on MB-SMARC-2
#@DESCRIPTION: i.MX8XD MB-SMARC-2 kit
#@MAINTAINER: Markus Niebel <Markus.Niebel@tq-group.com>
#
# Processor                     Memory    Configuration
# --------------                ------    ---------------------------------
# i.MX8DX B0                    512MiB    tqma8xds_mb_smarc_2_mmc_defconfig

require conf/machine/include/tqma8xxs.inc
require conf/machine/include/tqma8xxs-mb-smarc-2-common.inc

# TODO:
KERNEL_DEVICETREE = "\
	freescale/fsl-imx8dx-tqma8xds-mb-smarc-2.dtb \
"

# Files are needed in IMAGE_BOOT_FILES because /boot is on an extra partition.
# If those files should be installed under /boot inside the rootfs, you can
# achieve this in your BSP layer adding them via
# IMAGE_INSTALL_append = " kernel-devicetree kernel-image-zimage"
#
IMAGE_BOOT_FILES ?= "\
	${KERNEL_IMAGETYPE} \
	${KERNEL_IMAGETYPE}-fsl-imx8dx-tqma8xds-mb-smarc-2.dtb;fsl-imx8dx-tqma8xds-mb-smarc-2.dtb \
	"

UBOOT_CONFIG ??= "sd"
UBOOT_CONFIG[sd] = "tqma8xds_mb_smarc_2_mmc_defconfig"
```

## conf/machine/tqma8xqp-1gb-mba8xx.conf
```bitbake
#@TYPE: Machine
#@NAME: i.MX 8QXP TQMa8XQP on MBa8Xx
#@DESCRIPTION: i.MX 8QXP MBa8Xx starter kit
#@MAINTAINER: Markus Niebel <Markus.Niebel@tq-group.com>
#
# Processor       Boot device              Memory    Configuration
# -----------     -----------              ------    -----------------------------
# i.MX8QXP C0     e-MMM / SD               1GiB      tqma8xqp_1gb_mba8xx_defconfig
# i.MX8QXP C0     FlexSPI                  1GiB      tqma8xqp_1gb_mba8xx_defconfig
# i.MX8QXP C0     Serial downloader        1GiB      tqma8xqp_1gb_mba8xx_mfg_defconfig

require conf/machine/include/tqma8xx.inc
require conf/machine/include/mba8xx-common.inc

BOARD_DEVICETREE_FILES = "\
	imx8qxp-tqma8xqp-mba8xx.dtb \
	imx8qxp-tqma8xqp-mba8xx-lvds0-tm070jvhg33.dtb \
	imx8qxp-tqma8xqp-mba8xx-lvds1-tm070jvhg33.dtb \
	imx8qxp-tqma8xqp-mba8xx-rpmsg.dtb \
"

require conf/machine/include/tqma8-common.inc

IMAGE_BOOT_FILES ?= "\
	${KERNEL_IMAGETYPE} \
	${BOARD_DEVICETREE_FILES} \
	"

UBOOT_CONFIG ??= "sd fspi mfgtool"
UBOOT_CONFIG[sd] = "tqma8xqp_1gb_mba8xx_defconfig,wic"
UBOOT_CONFIG[fspi] = "tqma8xqp_1gb_mba8xx_defconfig"
UBOOT_CONFIG[mfgtool] = "tqma8xqp_1gb_mba8xx_mfg_defconfig"
```

## conf/machine/tqma8xqp-mba8xx.conf
```bitbake
#@TYPE: Machine
#@NAME: i.MX 8QXP TQMa8XQP on MBa8Xx
#@DESCRIPTION: i.MX 8QXP MBa8Xx starter kit
#@MAINTAINER: Markus Niebel <Markus.Niebel@tq-group.com>
#
# Processor       Boot device              Memory    Configuration
# -----------     -----------              ------    -----------------------------
# i.MX8QXP B0     e-MMM / SD               1GiB      tqma8xqp_mba8xx_defconfig
# i.MX8QXP B0     FlexSPI                  1GiB      tqma8xqp_mba8xx_defconfig

require conf/machine/include/tqma8xx.inc
require conf/machine/include/mba8xx-common.inc

# TODO:
BOARD_DEVICETREE_FILES = "\
	imx8qxp-mba8xx.dtb \
	imx8qxp-mba8xx-lvds-tm070jvhg33.dtb \
"

###
#	fsl-imx8qxp-tqma8xqp-mba8xx-lvds-etml1010g0dka.dtb \
#	fsl-imx8qxp-tqma8xqp-mba8xx-lvds-tm070jvhg33.dtb \
#	fsl-imx8qxp-tqma8xqp-mba8xx-pcie-gen1.dtb \
#	fsl-imx8qxp-tqma8xqp-mba8xx-no-pcie.dtb \
###

require conf/machine/include/tqma8-common.inc

# Files are needed in IMAGE_BOOT_FILES because /boot is on an extra partition.
# If those files should be installed under /boot inside the rootfs, you can
# achieve this in your BSP layer adding them via
# IMAGE_INSTALL_append = " kernel-devicetree kernel-image-zimage"
#
IMAGE_BOOT_FILES ?= "\
	${KERNEL_IMAGETYPE} \
	${BOARD_DEVICETREE_FILES} \
	"

UBOOT_CONFIG ??= "sd"
UBOOT_CONFIG[sd] = "tqma8xqp_mba8xx_defconfig,wic"
UBOOT_CONFIG[fspi] = "tqma8xqp_mba8xx_defconfig"
UBOOT_CONFIG[mfgtool] = "tqma8xqp_mba8xx_mfg_defconfig"

# TODO: handle optee as soon as supported
IMXBOOT_TARGETS = "flash_spl flash_spl_flexspi"
```
