## conf/machine/include/mba8mx.inc
```bitbake
# Common definitions for TQ-Group MBa8Mx baseboard for TQMa8Mx modules

# Set u-boot DTB
UBOOT_DTB_NAME = "fsl-imx8mq-mba8mx.dtb"

BOARD_DEVICETREE_FILES = "\
    imx8mq-mba8mx.dtb \
    imx8mq-mba8mx-dcss-lvds-tm070jvhg33.dtb \
    imx8mq-mba8mx-lcdif-lvds-tm070jvhg33.dtb \
"

####
#	imx8mq-mba8mx-hdmi.dtb \
#	imx8mq-mba8mx-dcss-lvds-g150xne-l01.dtb \
#	imx8mq-mba8mx-dcss-lvds-g150xne-l01-18bit.dtb \
#	imx8mq-mba8mx-mikrobus-rtc5.dtb \
###


KERNEL_DEVICETREE = ""

require conf/machine/include/tqma8-common.inc

# Set Serial console
SERIAL_CONSOLES = "115200;ttymxc2"

# Files are needed in IMAGE_BOOT_FILES because /boot is on an extra partition.
# If those files should be installed under /boot inside the rootfs, you can
# achieve this in your BSP layer adding them via
# IMAGE_INSTALL_append = " kernel-devicetree kernel-image-zimage"
#
IMAGE_BOOT_FILES ?= "\
	${KERNEL_IMAGETYPE} \
	${BOARD_DEVICETREE_FILES} \
	"
```

## conf/machine/include/mba8qx-common.inc
```bitbake
# shared definitions for MBa8QX mainboard

# We have to disable SERIAL_CONSOLE due to auto-serial-console
SERIAL_CONSOLES = "115200;ttyLP1"

# we do not want to have getty running on tty1 as we run
# auto-serial-console there
USE_VT = "0"

# TODO: move to bsp layer

IMAGE_INSTALL_append = " memtester"
IMAGE_INSTALL_append = " usbutils"
IMAGE_INSTALL_append = " mmc-utils"
IMAGE_INSTALL_append = " i2c-tools"
IMAGE_INSTALL_append = " pciutils"
IMAGE_INSTALL_append = " ethtool"
IMAGE_INSTALL_append = " e2fsprogs"
# IMAGE_INSTALL_append = " iperf2"
IMAGE_INSTALL_append = " iperf3"
```

## conf/machine/include/mba8x-common.inc
```bitbake
# shared definitions for MBa8x mainboard

# We have to disable SERIAL_CONSOLE due to auto-serial-console
SERIAL_CONSOLES = "115200;ttyLP0"

# disable virtual console support for this board and limit getty to SERIAL_CONSOLES only
USE_VT = "0"

BOARD_DEVICETREE_FILES = "\
    imx8qm-tqma8qm-mba8x.dtb \
    imx8qm-tqma8qm-mba8x-dp.dtb \
    imx8qm-tqma8qm-mba8x-lvds0-tm070jvhg33.dtb \
    imx8qm-tqma8qm-mba8x-lvds1-tm070jvhg33.dtb \
    imx8qm-tqma8qm-mba8x-rpmsg.dtb \
"

BOARD_FIRMWARE_FILES = "\
    dpfw.bin \
    hdmirxfw.bin \
"

require conf/machine/include/tqma8-common.inc

IMAGE_BOOT_FILES ?= "\
    ${KERNEL_IMAGETYPE} \
    ${BOARD_DEVICETREE_FILES} \
    ${BOARD_FIRMWARE_FILES} \
"

# TODO: handle optee as soon as supported
IMXBOOT_TARGETS ?= "flash_spl flash_spl_flexspi flash_linux_m4"

MACHINE_FEATURES_append = " wifi"
MACHINE_EXTRA_RRECOMMENDS_append = " linux-firmware-ath10k"
```

## conf/machine/include/mba8xx-common.inc
```bitbake
# shared definitions for MBa8Xx mainboard

# We have to disable SERIAL_CONSOLE due to auto-serial-console
SERIAL_CONSOLES = "115200;ttyLP1"

# disable virtual console support for this board and limit getty to SERIAL_CONSOLES only
USE_VT = "0"

MACHINE_FEATURES:append = " wifi"
MACHINE_EXTRA_RRECOMMENDS:append = " linux-firmware-ath10k"

# TODO: handle optee as soon as supported
IMXBOOT_TARGETS ?= "flash_spl flash_spl_flexspi flash_linux_m4"
```

## conf/machine/include/ti-soc.inc
```bitbake
# This is a generic TI SOC family. It is a superset of all other SOCs
# and platforms defined in meta-ti to allow BSP-level overrides.
SOC_FAMILY = "ti-soc"
require conf/machine/include/soc-family.inc
```
