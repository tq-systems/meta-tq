## conf/distro/dumpling-nxp.conf
```bitbake
require conf/distro/dumpling.conf
require tq-provider-imx.inc

DISTRO = "dumpling-nxp"
DISTRO_NAME = "Dumpling (TQ-Systems Dumpling Distribution) for TQ-Systems NXP BSP"
```

## conf/distro/dumpling-ti.conf
```bitbake
require conf/distro/dumpling.conf
require tq-provider-ti.inc

DISTRO = "dumpling-ti"
DISTRO_NAME = "Dumpling (TQ-Systems Dumpling Distribution) for TQ-Systems TI BSP"
```

## conf/distro/dumpling-wayland.conf
```bitbake
require dumpling.conf

DISTRO = "dumpling-wayland"
DISTRO_NAME = "Dumpling Wayland (TQ-Systems Dumpling Wayland Distribution)"

DISTRO_FEATURES += "wayland pam"
```

## conf/distro/dumpling.conf
```bitbake
require dumpling.inc
require tq-provider-mainline.inc

DISTRO = "dumpling"
DISTRO_NAME = "Dumpling (TQ-Systems Dumpling Distribution)"
```

## conf/distro/dumpling.inc
```bitbake
require conf/distro/poky.conf
require tq-common.inc

DISTRO_SHORT_NAME = "dumpling"
DISTRO_FEATURES_DEFAULT:remove = "argp irda pcmcia zeroconf x11 bluetooth"
DISTRO_FEATURES = "${DISTRO_FEATURES_DEFAULT} opengl systemd"

# add some locales per default
IMAGE_LINGUAS:append = " de-de en-us"

# point some runtime providers to full fledged packages
VIRTUAL-RUNTIME_base-utils-hwclock ?= "util-linux-hwclock"

# strip some unused stuff to lower dependencies, work in progress:

# we do not have firewire support
PACKAGECONFIG_pn_gstreamer1.0-plugin-good:remove = "dv1394"
# at the moment gtk is not used
PACKAGECONFIG_pn_gstreamer1.0-plugin-good:remove = "gtk"

# TODO: cairo and gdk-pixbuf are default on - if not gstreamer dependencies
# can be removed.
```

## conf/distro/spaetzle-nxp.conf
```bitbake
require spaetzle.inc
require tq-provider-imx.inc

DISTRO = "spaetzle-nxp"
DISTRO_NAME = "Spaetzle (TQ-Systems Spaetzle Distribution) for NXP BSP"
```

## conf/distro/spaetzle-ti.conf
```bitbake
require spaetzle.conf

DISTRO = "spaetzle-ti"
DISTRO_NAME = "Spaetzle (TQ-Systems Spaetzle Distribution) for TI BSP"

require tq-provider-ti.inc
```

## conf/distro/spaetzle.conf
```bitbake
require conf/distro/poky-tiny.conf
require tq-common.inc
require tq-provider-mainline.inc

DISTRO = "spaetzle"
DISTRO_NAME = "Spaetzle (TQ-Systems Spaetzle Distribution)"

DISTRO_FEATURES += "tiny"

PNBLACKLIST[tq-image-weston] = "not buildable with spaetzle: use tq-image-generic"

# tinification of tq-common.inc

VIRTUAL-RUNTIME_dev_manager = "eudev"
VIRTUAL-RUNTIME_login_manager = "busybox"
VIRTUAL-RUNTIME_init_manager = "busybox"
VIRTUAL-RUNTIME_initscripts = "initscripts"
VIRTUAL-RUNTIME_keymaps = "keymaps"
DISTRO_FEATURES_BACKFILL_CONSIDERED += "sysvinit"

IMAGE_FSTYPES_append = "${@bb.utils.contains('MACHINE_FEATURES', 'ubi', ' ubi', '', d)}"
```

## conf/distro/spaetzle.inc
```bitbake
###############################################################################
# Attention: poky-tiny has a hard assignment:
# PREFERRED_PROVIDER_virtual/kernel = "linux-yocto-tiny"
# this will break our boards, preventing to use own kernel recipes, branches
# etc. To workaround this, store the value before inclusion, unset after
# inclusion and weak assign after inclusion. This allows all sort of reassignment
# from distro or environment and leaves the default.
###############################################################################
SPAETZLE_DEFAULT_KERNEL := "${PREFERRED_PROVIDER_virtual/kernel}"
require conf/distro/poky-tiny.conf
unset PREFERRED_PROVIDER_virtual/kernel
PREFERRED_PROVIDER_virtual/kernel ??= "${SPAETZLE_DEFAULT_KERNEL}"

require tq-common.inc

DISTRO_FEATURES += "tiny"
DISTRO_SHORT_NAME = "spaetzle"

# Make sure we have sysvinit in the list. Needed to get tasks injected by
# update-rc.d.bbclass. This will bring in the initscripts from different
# packages
DISTRO_FEATURES_append = " sysvinit"

# We have some images that can't be built with spaetzle
PNBLACKLIST[tq-image-weston] = "not buildable with spaetzle: use tq-image-small"
PNBLACKLIST[tq-image-qt5] = "not buildable with spaetzle: use tq-image-small"

# tinification of tq-common.inc (mostly similar to init-manager-mdev-busybox.inc).
# Although it is used as default assigned value from poky-tiny.conf documentation
# says it is good to set explicitely
INIT_MANAGER = "mdev-busybox"

# some modification of settings from INIT_MANAGER
# use eudev instead of mdev
VIRTUAL-RUNTIME_dev_manager = "eudev"
VIRTUAL-RUNTIME_login_manager = "busybox"
VIRTUAL-RUNTIME_init_manager = "busybox"
VIRTUAL-RUNTIME_initscripts = "initscripts"
VIRTUAL-RUNTIME_keymaps = "keymaps"

# force removal of systemd from DISTRO_FEATURES
# take care when updating yocto, at the moment sysvinit must not be removed,
# see above
DISTRO_FEATURES_BACKFILL_CONSIDERED_append = " systemd"

IMAGE_FSTYPES_append = "${@bb.utils.contains('MACHINE_FEATURES', 'ubi', ' ubi', '', d)}"
```

## conf/distro/tq-common.inc
```bitbake
VENDOR_SHORT_NAME = "tq"
VENDOR_LONG_NAME = "TQ-Systems"
TARGET_VENDOR = "-${VENDOR_SHORT_NAME}"
# should be set to a useful name as soon as we want to go away from
# poky/meta-poky/conf/distro/poky.conf
DISTRO_VERSION ??= "${VENDOR_SHORT_NAME}.0.1"

# The bundle version interacts with the downgrade barrier.
# "r0" as version, disables the downgrade barrier. If a
# downgrade barrier is set with r1, you have to increase
# the version for every update. In that way old security
# vulnerabilities cannot be exploited.
RAUC_BUNDLE_VERSION ?= "r0"

SDK_VENDOR = "-${VENDOR_SHORT_NAME}sdk"
SDK_VERSION := "${DISTRO_VERSION}"
SDK_NAME = "${VENDOR}-${DISTRO}-${TCLIBC}-${SDK_ARCH}-${IMAGE_BASENAME}-${TUNE_PKGARCH}"
SDKPATH = "/opt/${VENDOR}-${DISTRO}/${SDK_VERSION}"

# include the config checker
INHERIT += "sanity"

# run QA tests
INHERIT += "insane"
QA_LOG = "1"

# do images prelink
INHERIT += "image-prelink"

# optimize lib sizes with mklibs
INHERIT += "image-mklibs"

# include the version package
IMAGE_INSTALL_append = " os-release"

# listed checks from ERROR_QA to WARN_QA (from insane.bbclass)
ERROR_TO_WARN_QA = "version-going-backwards"

VIRTUAL-RUNTIME_dev_manager = "udev"
VIRTUAL-RUNTIME_init_manager = "systemd"
DISTRO_FEATURES_BACKFILL_CONSIDERED += "sysvinit"
VIRTUAL-RUNTIME_login_manager = "busybox"
VIRTUAL-RUNTIME_syslog = ""
VIRTUAL-RUNTIME_initscripts = ""

# home for root is '/root' and nothing else
ROOT_HOME ?= "/root"

IMAGE_FSTYPES ?= " tar.gz"
```

## conf/distro/tq-provider-imx.inc
```bitbake
IMX_DEFAULT_BSP = "nxp"

PREFERRED_PROVIDER_virtual/kernel_tqma6x = "linux-imx-tq"
PREFERRED_PROVIDER_virtual/kernel_tqma6ulx = "linux-imx-tq"
PREFERRED_PROVIDER_virtual/kernel_tqma6ullx = "linux-imx-tq"
PREFERRED_PROVIDER_virtual/kernel_tqma7x = "linux-imx-tq"

PREFERRED_PROVIDER_virtual/kernel_tqma8x = "linux-imx-tq"
PREFERRED_PROVIDER_virtual/kernel_tqma8xx = "linux-imx-tq"
PREFERRED_PROVIDER_virtual/kernel_tqma8xxs = "linux-imx-tq"
PREFERRED_PROVIDER_virtual/kernel_tqma8mq = "linux-imx-tq"
PREFERRED_PROVIDER_virtual/kernel_tqma8mxml = "linux-imx-tq"
PREFERRED_PROVIDER_virtual/kernel_tqma8mxnl = "linux-imx-tq"
PREFERRED_PROVIDER_virtual/kernel_tqma8mpxl = "linux-imx-tq"

PREFERRED_PROVIDER_virtual/bootloader = "u-boot-imx-tq"

PREFERRED_PROVIDER_virtual/libgbm_tqma6x = ""
PREFERRED_PROVIDER_virtual/libgbm_tqma7x = ""
PREFERRED_PROVIDER_virtual/libgbm_tqma6ulx = ""
PREFERRED_PROVIDER_virtual/libgbm_tqma6ullx = ""
```

## conf/distro/tq-provider-mainline.inc
```bitbake
# This file is used for all distro configs based on mainline kernel and / or
# mainline software stacks. To make it usable also with distros based on
# poky-tiny we need to add a specific PREFERRED_PROVIDER for virtual/kernel
# since poky-tiny has a hard assignment for linux-yocto-tiny

# set for meta-freescale to enforce mainline kernel / graphic stack
IMX_DEFAULT_BSP = "mainline"
DISTRO_FEATURES += "tq-mainline"

PREFERRED_PROVIDER_virtual/kernel ?= "linux-tq"

PREFERRED_PROVIDER_virtual/egl = "mesa"
PREFERRED_PROVIDER_virtual/libgl = "mesa"
PREFERRED_PROVIDER_virtual/libgles1 = "mesa"
PREFERRED_PROVIDER_virtual/libgles2 = "mesa"
PREFERRED_PROVIDER_virtual/libgbm = "mesa"

# Support building some machines without having neither mainline kernel support
# nor linux-yocto-tiny
# TODO: remove as soon we have a linux-tq recipe for the machine
PREFERRED_PROVIDER_virtual/kernel:tqma57xx ?= "linux-ti-tq"
PREFERRED_PROVIDER_virtual/kernel:tqmls1012al ?= "linux-imx-tq"
PREFERRED_PROVIDER_virtual/kernel:tqmls1028a ?= "linux-imx-tq"
PREFERRED_PROVIDER_virtual/kernel:tqmls1088a ?= "linux-lsdk-tq"
PREFERRED_PROVIDER_virtual/kernel:tqmlx2160a ?= "linux-lsdk-tq"
```

## conf/layer.conf
```bitbake
# We have a conf and classes directory, add to BBPATH
BBPATH .= ":${LAYERDIR}"

# We have recipes-* directories, add to BBFILES
BBFILES += "${LAYERDIR}/recipes-*/*/*.bb \
    ${LAYERDIR}/recipes-*/*/*.bbappend"

BBFILE_COLLECTIONS += "tq-layer"
BBFILE_PATTERN_tq-layer = "^${LAYERDIR}/"
BBFILE_PRIORITY_tq-layer = "9"

LAYERDEPENDS_tq-layer = "core"
LAYERSERIES_COMPAT_tq-layer = "hardknott"

# Add custom lisenses into the metadata
LICENSE_PATH += "${LAYERDIR}/custom-licenses"
# primary license for recipes using NXP EULA licensed binaries
# This is used by the fetching / unpacking support class (nxp-bin-unpack)
NXP_EULA_FILE = "${LAYERDIR}/custom-licenses/NXP-EULA-v24"

# The dynamic-layers directory hosts the extensions and layer specific
# modifications related to TQ Embedded products.
BBFILES_DYNAMIC += "\
   basler-imx8:${LAYERDIR}/dynamic-layers/basler-imx8/recipes-*/*/*.bbappend \
   basler-imx8:${LAYERDIR}/dynamic-layers/basler-imx8/recipes-*/*/*.bb \
   freescale-layer:${LAYERDIR}/dynamic-layers/freescale-layer/recipes-*/*/*.bbappend \
   freescale-layer:${LAYERDIR}/dynamic-layers/freescale-layer/recipes-*/*/*.bb \
   meta-ti:${LAYERDIR}/dynamic-layers/meta-ti/recipes-*/*/*.bbappend \
   meta-ti:${LAYERDIR}/dynamic-layers/meta-ti/recipes-*/*/*.bb \
   openembedded-layer:${LAYERDIR}/dynamic-layers/openembedded-layer/recipes-*/*/*.bbappend \
   openembedded-layer:${LAYERDIR}/dynamic-layers/openembedded-layer/recipes-*/*/*.bb \
"

#
# List of packages that provides targets which could also be found in vendor layers
#
BBMASK_FSL_LAYER = "\
    firmware-imx-tq \
"
BBMASK += "${@bb.utils.contains("BBFILE_COLLECTIONS", "freescale-layer", "${BBMASK_FSL_LAYER}", '', d)}"
# Do not add this .bbappend if meta-imx/meta-bsp is added (which has lower priority than meta-tq)
# This is just to update the SRCREV if basler-imx8 layer is used, which requires a more recent version than meta-freescale provides
BBMASK += "${@bb.utils.contains("BBFILE_COLLECTIONS", "fsl-bsp-release", "/meta-tq/dynamic-layers/basler-imx8/", '', d)}"

# this is the default location for TQ-Systems repos
# since this layer is intended to derive baseboards for TQ-Systems computing
# modules, define a variable which can be overwritten by machines, dependend
# layers or local.conf. Idea was borrowed from Stefan Lange <s.lange@gateware.de>
TQ_GIT_BASEURL ??= "git://github.com/tq-systems"
TQ_GIT_PROTOCOL ??= "https"
```

## conf/machine/include/k3r5.inc
```bitbake
# TI K3 Armv7 profile for Cortex-R5F cores

require conf/machine/include/ti-soc.inc
SOC_FAMILY_append = ":k3r5"

# The closest of existing tunes for Cortex-R5F
DEFAULTTUNE = "armv7athf"
require conf/machine/include/tune-cortexa8.inc

# R5 runs early bootloader and loads SYSFW
PREFERRED_PROVIDER_virtual/kernel = "linux-dummy"
PREFERRED_PROVIDER_virtual/bootloader = "u-boot-tq"
PREFERRED_PROVIDER_u-boot = "u-boot-tq"

SPL_BINARY = ""
UBOOT_SUFFIX = "bin"
UBOOT_BINARY = "tiboot3.${UBOOT_SUFFIX}"
UBOOT_IMAGE = "tiboot3-${MAINMACHINE}-${PV}-${PR}.${UBOOT_SUFFIX}"
UBOOT_SYMLINK = "tiboot3-${MAINMACHINE}.${UBOOT_SUFFIX}"

PACKAGECONFIG_pn-u-boot-tq = ""
```

## conf/machine/include/mb-smarc-2-common.inc
```bitbake
# shared definitions for MB-SMARC-2 mainboard

# We have to disable SERIAL_CONSOLE due to auto-serial-console
SERIAL_CONSOLES = "115200;ttyLP0"

# disable virtual console support for this board and limit getty to SERIAL_CONSOLES only
USE_VT = "0"

# TODO: handle optee as soon as supported
IMXBOOT_TARGETS ?= "flash_spl flash_spl_flexspi flash_linux_m4"

MACHINE_FEATURES:append = " wifi"
MACHINE_EXTRA_RRECOMMENDS:append = " linux-firmware-ath10k"
```

## conf/machine/include/mba57xx-common.inc
```bitbake
# Common definitions for TQ-Systems GmbH TQMa57xx modules on MBa57xx

KERNEL_DEVICETREE ?= "\
    am571x-mba57xx.dtb \
    am571x-mba57xx-cdtech-dc44.dtb \
    am571x-mba57xx-edt-etm0700g0edh6.dtb \
    am571x-mba57xx-tianma-tm070jvhg33.dtb \
    am572x-mba57xx.dtb \
    am572x-mba57xx-cdtech-dc44.dtb \
    am572x-mba57xx-edt-etm0700g0edh6.dtb \
    am572x-mba57xx-tianma-tm070jvhg33.dtb \
    am574x-mba57xx.dtb \
    am574x-mba57xx-cdtech-dc44.dtb \
    am574x-mba57xx-edt-etm0700g0edh6.dtb \
    am574x-mba57xx-tianma-tm070jvhg33.dtb \
"

# install also under /boot inside the rootfs, needed for UBIFS use case
# and because kernel / DTB in extra FAT boot partition on SD / e-MMC shall be
# removed in future
IMAGE_INSTALL:append = "\
    kernel-devicetree \
    kernel-image-zimage \
"

IMAGE_BOOT_FILES:append = "\
    ${KERNEL_IMAGETYPE};linuximage \
    ${KERNEL_DEVICETREE} \
"

SERIAL_CONSOLES ?= "115200;ttyS2"

# disable virtual console support for this board and limit getty to SERIAL_CONSOLES only
USE_VT = "0"

WKS_FILE ?= "tqmaxx-ti-sdimg.wks"
```

## conf/machine/include/mba6ulx-common.inc
```bitbake
# Common definitions for TQ-Systems GmbH MBa6ULx baseboard for
# TQMa6ULx/TQMa6ULLx/TQMa6ULxL/TQMa6ULLxL SOM

SERIAL_CONSOLES = "115200;ttymxc0"

# disable virtual console support for this board and limit getty to SERIAL_CONSOLES only
USE_VT = "0"

# install also under /boot inside the rootfs, needed for UBIFS use case
# and because extra FAT boot partition on SD / e-MMC shall be removed
IMAGE_INSTALL:append = "\
    kernel-devicetree \
    kernel-image \
"

# Files are needed in IMAGE_BOOT_FILES because we use an extra partition for
# backward compatibility.
IMAGE_BOOT_FILES = "\
    ${KERNEL_IMAGETYPE};linuximage \
    ${KERNEL_DEVICETREE} \
"

WKS_FILE = "tqmaxx-sdimg.wks"

MACHINE_FEATURES += "\
    bluetooth \
    display \
    wifi \
"

MACHINE_EXTRA_RRECOMMENDS += "\
    linux-firmware-ath10k \
    linux-firmware-qca \
"
```

## conf/machine/include/mba6x-common.inc
```bitbake
# Common definitions for TQ-Systems GmbH TQMa6x modules on MBa6x

SERIAL_CONSOLES = "115200;ttymxc1"

# disable virtual console support for this board and limit getty to SERIAL_CONSOLES only
USE_VT = "0"

# install also under /boot inside the rootfs, needed for UBIFS use case
# and because extra FAT boot partition on SD / e-MMC shall be removed
IMAGE_INSTALL:append = "\
    kernel-devicetree \
    kernel-image \
"

# Files are needed in IMAGE_BOOT_FILES because we use an extra partition for
# backward compatibility.
IMAGE_BOOT_FILES = "\
    ${KERNEL_IMAGETYPE};linuximage \
    ${KERNEL_DEVICETREE} \
"

WKS_FILE = "tqmaxx-sdimg.wks"

MACHINE_FEATURES:append = " wifi"
MACHINE_EXTRA_RRECOMMENDS += "linux-firmware-ath10k"
```

## conf/machine/include/mba8mx-common.inc
```bitbake
# Set Serial console
SERIAL_CONSOLES = "115200;ttymxc2"

IMAGE_BOOT_FILES = "\
    ${KERNEL_IMAGETYPE} \
    ${BOARD_DEVICETREE_FILES} \
"

MACHINE_FEATURES:append = "\
    camera \
    wifi \
"

MACHINE_EXTRA_RRECOMMENDS:append = " linux-firmware-ath10k"

IMAGE_BOOT_FILES += "\
    hello_world.bin \
    rpmsg_lite_pingpong_rtos_linux_remote.bin \
"

WKS_FILE_DEPENDS:append = "\
    virtual/imx-cortexm-demos \
"
```
