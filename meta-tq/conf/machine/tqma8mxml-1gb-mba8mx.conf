## meta-tq/conf/machine/tqma8mxml-1gb-mba8mx.conf
```bitbake
#@TYPE: Machine
#@NAME: i.MX 8MM TQMa8MxML REV.0200 (1 GiB) on MBa8Mx
#@DESCRIPTION: i.MX8MM MBa8MX starter kit
#@MAINTAINER: Markus Niebel <Markus.Niebel@tq-group.com>
#
# Processor                     Memory    Configuration
# --------------                ------    --------------------------------------
# i.MX8MM                       1GB       tqma8mxml_1gb_mba8mx_mmc_defconfig

require conf/machine/include/tqma8mxml-mba8mx.inc

UBOOT_CONFIG ??= "sd fspi mfgtool"
UBOOT_CONFIG[sd] = "tqma8mxml_1gb_mba8mx_mmc_defconfig,wic"
UBOOT_CONFIG[fspi] = "tqma8mxml_1gb_mba8mx_fspi_defconfig"
UBOOT_CONFIG[mfgtool] = "tqma8mxml_1gb_mba8mx_mfg_defconfig"
```

## meta-tq/conf/machine/tqma8mxml-4gb-mba8mx.conf
```bitbake
#@TYPE: Machine
#@NAME: i.MX 8MM TQMa8MxML REV.0201 (2 GiB) on MBa8Mx
#@DESCRIPTION: i.MX8MM MBa8MX starter kit
#@MAINTAINER: Markus Niebel <Markus.Niebel@tq-group.com>
#
# Processor                     Memory    Configuration
# --------------                ------    --------------------------------------
# i.MX8MM                       4GB       tqma8mxml_4gb_mba8mx_mmc_defconfig

require conf/machine/include/tqma8mxml-mba8mx.inc

UBOOT_CONFIG ??= "sd fspi mfgtool"
UBOOT_CONFIG[sd] = "tqma8mxml_4gb_mba8mx_mmc_defconfig,wic"
UBOOT_CONFIG[fspi] = "tqma8mxml_4gb_mba8mx_fspi_defconfig"
UBOOT_CONFIG[mfgtool] = "tqma8mxml_4gb_mba8mx_mfg_defconfig"
```

## meta-tq/conf/machine/tqma8mxml-multi-mba8mx.conf
```bitbake
#@TYPE: Machine
#@NAME: i.MX8MMini TQMa8MxML REV.020x (1,2,4 GiB) on MBa8Mx
#@DESCRIPTION:TQMa8MxML MBa8Mx starter kit
#@MAINTAINER: Markus Niebel <oss@ew.tq-group.com>

require conf/machine/include/tqma8mxml-mba8mx.inc

UBOOT_CONFIG ?= "\
    1gb_sd 1gb_fspi 1gb_mfgtool \
    2gb_sd 2gb_fspi 2gb_mfgtool \
    4gb_sd 4gb_fspi 4gb_mfgtool \
    sd fspi mfgtool \
"

UBOOT_CONFIG[sd] = "tqma8mxml_4gb_mba8mx_mmc_defconfig,wic"
UBOOT_CONFIG[fspi] = "tqma8mxml_4gb_mba8mx_fspi_defconfig"
UBOOT_CONFIG[mfgtool] = "tqma8mxml_4gb_mba8mx_mfg_defconfig"

UBOOT_CONFIG[4gb_sd] = "tqma8mxml_4gb_mba8mx_mmc_defconfig"
UBOOT_CONFIG[4gb_fspi] = "tqma8mxml_4gb_mba8mx_fspi_defconfig"
UBOOT_CONFIG[4gb_mfgtool] = "tqma8mxml_4gb_mba8mx_mfg_defconfig"

UBOOT_CONFIG[2gb_sd] = "tqma8mxml_2gb_mba8mx_mmc_defconfig"
UBOOT_CONFIG[2gb_fspi] = "tqma8mxml_2gb_mba8mx_fspi_defconfig"
UBOOT_CONFIG[2gb_mfgtool] = "tqma8mxml_2gb_mba8mx_mfg_defconfig"

UBOOT_CONFIG[1gb_sd] = "tqma8mxml_1gb_mba8mx_mmc_defconfig"
UBOOT_CONFIG[1gb_fspi] = "tqma8mxml_1gb_mba8mx_fspi_defconfig"
UBOOT_CONFIG[1gb_mfgtool] = "tqma8mxml_1gb_mba8mx_mfg_defconfig"

# allow creating multiple wic images for a single machine
IMAGE_CLASSES += "gen_additional_wic"

EXTWIC_BOOTLOADER_IMAGES = "\
    ${@bb.utils.contains('UBOOT_CONFIG', '1gb_sd', 'imx-boot-${MACHINE}-1gb_sd.bin-${IMXBOOT_SDMMC_TARGET}', '', d)} \
    ${@bb.utils.contains('UBOOT_CONFIG', '2gb_sd', 'imx-boot-${MACHINE}-2gb_sd.bin-${IMXBOOT_SDMMC_TARGET}', '', d)} \
    ${@bb.utils.contains('UBOOT_CONFIG', '4gb_sd', 'imx-boot-${MACHINE}-4gb_sd.bin-${IMXBOOT_SDMMC_TARGET}', '', d)} \
"
```

## meta-tq/conf/machine/tqma8xdp-1gb-mba8xx.conf
```bitbake
#@TYPE: Machine
#@NAME: i.MX 8DXP TQMa8XDP on MBa8Xx
#@DESCRIPTION: i.MX 8DXP MBa8Xx starter kit
#@MAINTAINER: Markus Niebel <oss@ew.tq-group.com>
#
# Processor       Boot device              Memory    Configuration
# -----------     -----------              ------    -----------------------------
# i.MX8DXP C0     e-MMM / SD               1GiB      tqma8xdp_1gb_mba8xx_defconfig
# i.MX8DXP C0     FlexSPI                  1GiB      tqma8xdp_1gb_mba8xx_defconfig
# i.MX8DXP C0     Serial downloader        1GiB      tqma8xdp_1gb_mba8xx_mfg_defconfig

require conf/machine/include/tqma8xx.inc
require conf/machine/include/mba8xx-common.inc

KERNEL_DEVICETREE = ""

KERNEL_DEVICETREE_linux-imx-tq = "\
    freescale/imx8dxp-tqma8xdp-mba8xx.dtb \
    freescale/imx8dxp-tqma8xdp-mba8xx-lvds-g133han01.dtb \
    freescale/imx8dxp-tqma8xdp-mba8xx-lvds0-tm070jvhg33.dtb \
    freescale/imx8dxp-tqma8xdp-mba8xx-lvds1-tm070jvhg33.dtb \
    freescale/imx8dxp-tqma8xdp-mba8xx-rpmsg.dtb \
"

KERNEL_DEVICETREE += "${@kernel_provider_dtbs(d)}"

IMAGE_BOOT_FILES = "\
    ${@create_image_boot_dtb_files(d)} \
    ${KERNEL_IMAGETYPE} \
"

SC_FIRMWARE_NAME = "mx8qx-tqma8xqp-1gb-mba8xx-scfw-tcm.bin"

UBOOT_CONFIG ??= "sd fspi mfgtool"
UBOOT_CONFIG[sd] = "tqma8xdp_1gb_mba8xx_defconfig,wic"
UBOOT_CONFIG[fspi] = "tqma8xdp_1gb_mba8xx_defconfig"
UBOOT_CONFIG[mfgtool] = "tqma8xdp_1gb_mba8xx_mfg_defconfig"
```

## meta-tq/conf/machine/tqma8xdp4-mba8xx.conf
```bitbake
#@TYPE: Machine
#@NAME: i.MX 8QXP TQMa8XDP4 on MBa8Xx
#@DESCRIPTION: i.MX 8DXP MBa8Xx starter kit
#@MAINTAINER: Markus Niebel <Markus.Niebel@tq-group.com>
#
# Processor       Boot device              Memory    Configuration
# -----------     -----------              ------    -----------------------------
# i.MX8DXP C0     e-MMM / SD               2GiB      tqma8xdp_2gb_mba8xx_defconfig
# i.MX8DXP C0     FlexSPI                  2GiB      tqma8xdp_2gb_mba8xx_defconfig
# i.MX8DXP C0     Serial downloader        2GiB      tqma8xdp_2gb_mba8xx_mfg_defconfig

require conf/machine/include/tqma8xx.inc
require conf/machine/include/mba8xx-common.inc

BOARD_DEVICETREE_FILES = "\
    imx8dxp-tqma8xdp-mba8xx.dtb \
    imx8dxp-tqma8xdp-mba8xx-lvds0-tm070jvhg33.dtb \
    imx8dxp-tqma8xdp-mba8xx-lvds1-tm070jvhg33.dtb \
    imx8dxp-tqma8xdp-mba8xx-rpmsg.dtb \
"

require conf/machine/include/tqma8-common.inc

IMAGE_BOOT_FILES = "\
    ${KERNEL_IMAGETYPE} \
    ${BOARD_DEVICETREE_FILES} \
"

UBOOT_CONFIG ??= "sd fspi mfgtool"
UBOOT_CONFIG[sd] = "tqma8xdp_2gb_mba8xx_defconfig,wic"
UBOOT_CONFIG[fspi] = "tqma8xdp_2gb_mba8xx_defconfig"
UBOOT_CONFIG[mfgtool] = "tqma8xdp_2gb_mba8xx_mfg_defconfig"
```

## meta-tq/conf/machine/tqma8xdps-mb-smarc-2.conf
```bitbake
#@TYPE: Machine
#@NAME: i.MX 8DXP TQMa8XDPS on MB-SMARC-2
#@DESCRIPTION: i.MX8DXP MB-SMARC-2 kit
#@MAINTAINER: Markus Niebel <Markus.Niebel@tq-group.com>
#
# Processor       Boot device              Memory    Configuration
# -----------     -----------              ------    -----------------------------
# i.MX8DXP C0     e-MMM / SD               2GiB      tqma8xdps_mb_smarc_2_defconfig
#                 FlexSPI                  2GiB      tqma8xdps_mb_smarc_2_defconfig

require conf/machine/include/tqma8xxs.inc
require conf/machine/include/mb-smarc-2-common.inc

KERNEL_DEVICETREE = ""

KERNEL_DEVICETREE_linux-imx-tq = "\
    freescale/imx8dxp-tqma8xdps-mb-smarc-2.dtb \
    freescale/imx8dxp-tqma8xdps-mb-smarc-2-lvds0-tm070jvhg33.dtb \
    freescale/imx8dxp-tqma8xdps-mb-smarc-2-lvds1-tm070jvhg33.dtb \
    freescale/imx8dxp-tqma8xdps-mb-smarc-2-rpmsg.dtb \
"

#TODO:
#imx8dxp-tqma8xdps-mb-smarc-2-lvds0-g133han01.dtb

KERNEL_DEVICETREE += "${@kernel_provider_dtbs(d)}"

IMAGE_BOOT_FILES = "\
    ${@create_image_boot_dtb_files(d)} \
    ${KERNEL_IMAGETYPE} \
"

UBOOT_CONFIG ??= "\
    fspi \
    mfgtool \
    sd \
"

UBOOT_CONFIG[sd] = "tqma8xdps_mb_smarc_2_defconfig,wic"
UBOOT_CONFIG[fspi] = "tqma8xdps_mb_smarc_2_defconfig"
UBOOT_CONFIG[mfgtool] = "tqma8xdps_mb_smarc_2_mfg_defconfig"
```

## meta-tq/conf/machine/tqma93xxla-mba93xxca.conf
```bitbake
# Common definitions for TQ-Systems GmbH TQMa93xxLA on MBa9xxxxCA

MACHINEOVERRIDES =. "imx:mx9:mx93:tqma93xx:"

LOADADDR = ""

require conf/machine/include/tqma9-common.inc

# Machine specific options

# Set DDR FIRMWARE
DDR_FIRMWARE_NAME = "\
    lpddr4_dmem_1d_v202201.bin \
    lpddr4_dmem_2d_v202201.bin \
    lpddr4_imem_1d_v202201.bin \
    lpddr4_imem_2d_v202201.bin \
"

ATF_PLATFORM = "imx93"

LOADADDR = ""
UBOOT_SUFFIX = "bin"
UBOOT_MAKE_TARGET = ""
SPL_BINARY = "spl/u-boot-spl.bin"

# for sdcard + wic image rule
IMX_BOOT_SEEK = "32"
IMX_BOOT_SOC_TARGET = "iMX9"

# Image Options

EXTRA_IMAGEDEPENDS += "\
    imx-boot:do_deploy \
    virtual/kernel:do_deploy \
"

# Verified values to generate UBI image:
# physical erase block size
UBI_PEB_SIZE = "65536"
UBI_MINIMUM_IO_UNIT_SIZE = "1"
UBI_SUB_PAGE_SIZE = "1"
# UBI_VID_HEADER_OFFSET="64"
# logical erase block size
UBI_LEB_SIZE = "65408"

# we have 64 MB flash, 8 MB for bootloader and env should be enough
# so use 1024 - 128 LEB
UBI_MAX_LEB_COUNT = "896"

MKUBIFS_ARGS = "\
    --min-io-size=${UBI_MINIMUM_IO_UNIT_SIZE} \
    --leb-size=${UBI_LEB_SIZE} \
    --max-leb-cnt=${UBI_MAX_LEB_COUNT} \
"

UBINIZE_ARGS = "\
    --peb-size=${UBI_PEB_SIZE} \
    --min-io-size=${UBI_MINIMUM_IO_UNIT_SIZE} \
    --sub-page-size=${UBI_SUB_PAGE_SIZE} \
"

# needs to be set to have it consistent for kernel command line
# Use the expected value of the ubifs filesystem's volume name in the kernel
# and u-boot.
UBI_VOLNAME = "root"

WKS_FILE = "tqmaxx-imx-v8-sdimg.wks.in"

WKS_FILE_DEPENDS += "\
    dosfstools-native \
    e2fsprogs-native \
    mtools-native \
    parted-native \
"

EXTRA_IMAGEDEPENDS += "\
    virtual/bootloader \
    virtual/kernel \
"

# optionally source the machine specific features for multimedia etc. from
# meta-freescale

include conf/machine/include/imx-base.inc
require conf/machine/include/arm/armv8-2a/tune-cortexa55.inc

MACHINE_FEATURES = "\
    bluetooth \
    can \
    ext2 \
    ext3 \
    rtc \
    serial \
    ubi \
    usbhost \
    vfat \
    wifi \
"

MACHINE_FEATURES += "\
    screen \
    touchscreen \
"

KERNEL_IMAGETYPE = "Image"

PREFERRED_PROVIDER_virtual/kernel ?= "linux-imx-tq"
PREFERRED_VERSION_linux-imx-tq = "5.15%"
PREFERRED_PROVIDER_imx-atf = "imx-atf-tq"

# Set u-boot DTB
UBOOT_DTB_NAME = "imx93-tqma93xxla-mba9xxxca.dtb"

UBOOT_CONFIG ??= "\
    sd \
"

UBOOT_CONFIG[sd] = "tqma93xxla_mba9xxxca_defconfig,wic"

IMXBOOT_TARGETS ?= "\
    flash_singleboot \
    flash_singleboot_flexspi \
"

KERNEL_DEVICETREE = ""

KERNEL_DEVICETREE_linux-imx-tq = "\
    freescale/imx93-tqma93xxla-mba93xxca.dtb \
    freescale/imx93-tqma93xxla-mba93xxca-lvds-tm070jvhg33.dtb \
"

KERNEL_DEVICETREE += "${@kernel_provider_dtbs(d)}"

SECO_FIRMWARE_NAME = "mx93a0-ahab-container.img"

#
# bootstream name, construction see imx-boot recipe, do_deploy
#
MACHINE_WKS_BOOTSTREAM ?= "imx-boot-${MACHINE}-sd.bin-flash_singleboot"

IMAGE_BOOT_FILES = "\
    ${@create_image_boot_dtb_files(d)} \
    ${KERNEL_IMAGETYPE} \
"

MACHINE_EXTRA_RRECOMMENDS += "\
    linux-firmware-pcie8997 \
    linux-firmware-sd8997 \
    linux-firmware-usb8997 \
"
```

## meta-tq/conf/machine/tqma93xxla-mba93xxla.conf
```bitbake
#@TYPE: Machine
#@NAME: i.MX93 TQMa93xxLA on MBa93xxLA
#@DESCRIPTION: TQ-Systems GmbH i.MX93 MBa93xxLA SBC
#@MAINTAINER: Markus Niebel <Markus.Niebel@tq-group.com>

require conf/machine/include/mba93xx-common.inc

MACHINE_FEATURES += "\
    lte \
"

# Set u-boot DTB
UBOOT_DTB_NAME = "imx93-tqma9352la-mba93xxla.dtb"

UBOOT_CONFIG ??= "\
    sd \
"

UBOOT_CONFIG[sd] = "tqma93xxla_mba93xxla_defconfig,wic"

KERNEL_DEVICETREE = ""

KERNEL_DEVICETREE_linux-imx-tq = "\
    freescale/imx93-tqma9352-mba93xxla.dtb \
    freescale/imx93-tqma9352-mba93xxla-lvds-tm070jvhg33.dtb \
"

KERNEL_DEVICETREE += "${@kernel_provider_dtbs(d)}"

# Set the USB UART of the wwan card inserted into mini PCIe slot. Use this UART
# to send AT commands to the wwan card (see quectel-ppp recipe). This assignment
# must not contain spaces and line feeds.
QUECTEL_PPP_TTY = "/dev/serial/by-path/platform-ci_hdrc\.0-usb-0\:1\.6\:1\.2-port0"

# This example shows the APN to be used for NXTGN IoT SIM cards. Please uncomment
# and override with the the string needed for your provider.
# For further information see README in doc folder of this layer.
# QUECTEL_PPP_APN ?= "h.nxtgn"
```

## meta-tq/conf/machine/tqmls1012al-mbls1012al.conf
```bitbake
#@TYPE: Machine
#@NAME: TQ-Systems GmbH TQMLS1012AL Module on MBLS1012AL Baseboard
#@SOC: LS1012A
#@DESCRIPTION: Machine configuration for TQ-Systems GmbH TQMLS1012AL
#@MAINTAINER: Matthias Schiffer <oss@ew.tq-group.com>
#
# Processor	Boot Device	Memory	Configuration
# ---------	-----------	------	--------------------
# LS1012A	QSPI		512MB	tqmls1012al_mbls1012al_tfa_defconfig
#

require conf/machine/include/tqmls1012al.inc
require conf/machine/include/tqmls1012al-mbls1012al.inc
```

## meta-tq/conf/machine/tqmls1043a-2gb-rev0300-mbls10xxa.conf
```bitbake
#@TYPE: Machine
#@NAME: TQ-Systems GmbH TQMLS1043A Module on MBLS10xxA Baseboard
#@SOC: ls1043a
#@DESCRIPTION: Machine configuration for TQ-Systems GmbH TQMLS1043A
#@MAINTAINER: Gregor Herburger <gregor.herburger@tq-group.com>
#
# By default, this machine will build for the full featured option
# with QSPI-NOR boot
#
# To build U-Boot for other CPU or memory combinations, you can set
# the UBOOT_MACHINE variable in your local.conf according to the
# following table:
#
# Processor Memory          Boot Device  Configuration
# --------- --------------- ------------ --------------------
# LS1043A   2 GiB / ECC     QSPI-NOR     tqmls1043a_mbls10xxa_tfa_defconfig
# LS1043A   2 GiB / ECC     SD / eMMC    tqmls1043a_mbls10xxa_tfa_defconfig
#
# The reset-configuration word (RCW) for the board is built with the rcw recipe
# and used by the qoriq-atf recipe. There are various RCWs supported for different
# SerDes configurations supported on the MBLS10xxA baseboard. Select
# RCW by setting RCWSD/RCWQSPI variable in your local.conf to one
# of the values available in the ATF_RCW_VARIANTS variable.

require conf/machine/include/tqmls1043a-mbls10xxa.inc

TQ_ATF_VARIANT = "tqmls1043a_2gb_rev0300"
```

## meta-tq/conf/machine/tqmls1043a-mbls10xxa.conf
```bitbake
#@TYPE: Machine
#@NAME: TQ-Systems GmbH TQMLS1043A Module on MBLS10xxA Baseboard
#@SOC: ls1043a
#@DESCRIPTION: Machine configuration for TQ-Systems GmbH TQMLS1043A
#@MAINTAINER: Gregor Herburger <gregor.herburger@tq-group.com>
#
# By default, this machine will build for the full featured option
# with QSPI-NOR boot
#
# To build U-Boot for other CPU or memory combinations, you can set
# the UBOOT_MACHINE variable in your local.conf according to the
# following table:
#
# Processor Memory          Boot Device  Configuration
# --------- --------------- ------------ --------------------
# LS1043A   1024MiB / ECC   QSPI-NOR     tqmls1043a_mbls10xxa_tfa_defconfig
# LS1043A   1024MiB / ECC   SD / eMMC    tqmls1043a_mbls10xxa_tfa_defconfig
# LS1043A   2048MiB / ECC   QSPI-NOR     tqmls1043a_mbls10xxa_tfa_defconfig
# LS1043A   2048MiB / ECC   SD / eMMC    tqmls1043a_mbls10xxa_tfa_defconfig
#
# The reset-configuration word (RCW) for the board is built with the rcw recipe
# and used by the qoriq-atf recipe. There are various RCWs supported for different
# SerDes configurations supported on the MBLS10xxA baseboard. Select
# RCW by setting RCWSD/RCWQSPI variable in your local.conf to one
# of the values available in the ATF_RCW_VARIANTS variable.

require conf/machine/include/tqmls1043a-mbls10xxa.inc

UBOOT_CONFIG ?= "tfa"
UBOOT_CONFIG[tfa] = "tqmls1043a_mbls10xxa_tfa_defconfig"

RCWSD ?= "default/rcw_1000_3358_sd"
RCWQSPI ?= "default/rcw_1000_3358_qspi"
ATF_RCW_VARIANTS ?= " \
    default/rcw_1000_1355_sd \
    default/rcw_1000_1355_qspi \
    default/rcw_1000_1455_sd \
    default/rcw_1000_1455_qspi \
    default/rcw_1000_3335_sd \
    default/rcw_1000_3335_qspi \
    default/rcw_1000_3355_sd \
    default/rcw_1000_3355_qspi \
    default/rcw_1000_3358_sd \
    default/rcw_1000_3358_qspi \
"

PBL_VARIANT = "bl2_sd_tqmls1043a_2gb"
```
