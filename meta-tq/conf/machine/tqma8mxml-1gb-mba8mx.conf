## meta-tq/conf/machine/tqmls1046a-2gb-mbls10xxa.conf
```bitbake
#@TYPE: Machine
#@NAME: TQ-Systems GmbH TQMLS1046A Module on MBLS10xxA Baseboard
#@SOC: ls1046a
#@DESCRIPTION: Machine configuration for TQ-Systems GmbH TQMLS1046A
#@MAINTAINER: Gregor Herburger <oss@ew.tq-group.com>
#
# By default, this machine will build for the full featured option
# with QSPI-NOR boot
#
# To build U-Boot for other CPU or memory combinations, you can set
# the UBOOT_MACHINE variable in your local.conf according to the
# following table:
#
# Processor Memory          Boot Device  Configuration
# --------- --------------- -----------  --------------------
# LS1046A   2 GiB / ECC     QSPI-NOR     tqmls1046a_mbls10xxa_tfa_defconfig
# LS1046A   2 GiB / ECC     SD / eMMC    tqmls1046a_mbls10xxa_tfa_defconfig
#
# The reset-configuration word (RCW) for the board is built with the rcw recipe
# and used by the qoriq-atf recipe. There are various RCWs supported for different
# SerDes configurations supported on the MBLS10xxA baseboard. Select
# RCW by setting RCWSD/RCWQSPI variable in your local.conf to one
# of the values available in the ATF_RCW_VARIANTS variable.

require conf/machine/include/tqmls1046a-mbls10xxa.inc

TQ_ATF_VARIANT = "tqmls1046a"
```

## meta-tq/conf/machine/tqmls1046a-mbls10xxa.conf
```bitbake
#@TYPE: Machine
#@NAME: TQ-Systems GmbH TQMLS1046A Module on MBLS10xxA Baseboard
#@SOC: ls1046a
#@DESCRIPTION: Machine configuration for TQ-Systems GmbH TQMLS1046A
#@MAINTAINER: Gregor Herburger <gregor.herburger@tq-group.com>
#
# By default, this machine will build for the full featured option
# with QSPI-NOR boot
#
# To build U-Boot for other CPU or memory combinations, you can set
# the UBOOT_MACHINE variable in your local.conf according to the
# following table:
#
# Processor Memory          Boot Device  Configuration
# --------- --------------- -----------  --------------------
# LS1046A   2048MiB / ECC   QSPI-NOR     tqmls1046a_mbls10xxa_tfa_defconfig
# LS1046A   2048MiB / ECC   SD / eMMC    tqmls1046a_mbls10xxa_tfa_defconfig
# LS1046A   8192MiB / ECC   QSPI-NOR     tqmls1046a_mbls10xxa_tfa_defconfig
# LS1046A   8192MiB / ECC   SD / eMMC    tqmls1046a_mbls10xxa_tfa_defconfig
#
# The reset-configuration word (RCW) for the board is built with the rcw recipe
# and used by the qoriq-atf recipe. There are various RCWs supported for different
# SerDes configurations supported on the MBLS10xxA baseboard. Select
# RCW by setting RCWSD/RCWQSPI variable in your local.conf to one
# of the values available in the ATF_RCW_VARIANTS variable.

require conf/machine/include/tqmls1046a-mbls10xxa.inc

UBOOT_CONFIG ?= "tfa"
UBOOT_CONFIG[tfa] = "tqmls1046a_mbls10xxa_tfa_defconfig"

RCWSD ?= "default/rcw_1800_3333_5559_sd"
RCWQSPI ?= "default/rcw_1800_3333_5559_qspi"
ATF_RCW_VARIANTS ?= "\
    default/rcw_1800_1040_5506_qspi \
    default/rcw_1800_1040_5506_sd \
    default/rcw_1800_1040_5559_qspi \
    default/rcw_1800_1040_5559_sd \
    default/rcw_1800_1040_5577_qspi \
    default/rcw_1800_1040_5577_sd \
    default/rcw_1800_1040_5A06_qspi \
    default/rcw_1800_1040_5A06_sd \
    default/rcw_1800_1040_5A59_qspi \
    default/rcw_1800_1040_5A59_sd \
    default/rcw_1800_1133_5506_qspi \
    default/rcw_1800_1133_5506_sd \
    default/rcw_1800_1133_5559_qspi \
    default/rcw_1800_1133_5559_sd \
    default/rcw_1800_1133_5577_qspi \
    default/rcw_1800_1133_5577_sd \
    default/rcw_1800_1133_5A06_qspi \
    default/rcw_1800_1133_5A06_sd \
    default/rcw_1800_1133_5A59_qspi \
    default/rcw_1800_1133_5A59_sd \
    default/rcw_1800_3333_5506_qspi \
    default/rcw_1800_3333_5506_sd \
    default/rcw_1800_3333_5559_qspi \
    default/rcw_1800_3333_5559_sd \
    default/rcw_1800_3333_5577_qspi \
    default/rcw_1800_3333_5577_sd \
    default/rcw_1800_3333_5A06_qspi \
    default/rcw_1800_3333_5A06_sd \
    default/rcw_1800_3333_5A59_qspi \
    default/rcw_1800_3333_5A59_sd \
"
```

## meta-tq/conf/machine/tqmls1088a-2gb-mbls10xxa.conf
```bitbake
#@TYPE: Machine
#@NAME: TQ-Systems GmbH TQMLS1088A Module on MBLS10xxa Baseboard
#@SOC: ls1088a
#@DESCRIPTION: Machine configuration for TQ-Systems GmbH TQMLS1088a
#@MAINTAINER: Gregor Herburger <gregor.herburger@tq-group.com>
#
# By default, this machine will build for the full featured option
# with QSPI-NOR boot
#
# Processor Memory          Boot Device  Configuration
# --------- ---------------	------------ --------------------
# LS1088A   2 GiB / ECC     QSPI-NOR     tqmls1088a_mbls10xxa_tfa_defconfig
# LS1088A   2 GiB / ECC     SD / eMMC    tqmls1088a_mbls10xxa_tfa_defconfig
#

require conf/machine/include/tqmls1088a-mbls10xxa.inc

TQ_ATF_VARIANT = "tqmls1088a"
```

## meta-tq/conf/machine/tqmls1088a-mbls10xxa.conf
```bitbake
#@TYPE: Machine
#@NAME: TQ-Systems GmbH TQMLS1088A Module on MBLS10xxa Baseboard
#@SOC: ls1088a
#@DESCRIPTION: Machine configuration for TQ-Systems GmbH TQMLS1088a
#@MAINTAINER: Timo Herbrecher <t.herbrecher@gateware.de>
#
# By default, this machine will build for the full featured option
# with QSPI-NOR boot
#
# To build U-Boot for other CPU or memory combinations, you can set
# the UBOOT_MACHINE variable in your local.conf according to the
# following table:
#
# Processor Memory          Boot Device  Configuration
# --------- ---------------	------------ --------------------
# LS1088A   2048MiB / ECC   QSPI-NOR     tqmls1088a_mbls10xxa_qspi_defconfig
# LS1088A   2048MiB / ECC   SD / eMMC    tqmls1088a_mbls10xxa_esdhc_defconfig
#

require conf/machine/include/tqmls1088a.inc

# no default assignment here, since we overwrite defaults from qoriq-arm64.inc
SERIAL_CONSOLES = "115200;ttyS1"
SERIAL_CONSOLES_CHECK = "${SERIAL_CONSOLES}"
# disable virtual console support for this board and limit getty to SERIAL_CONSOLES only
USE_VT = "0"

KERNEL_DEVICETREE ?= " \
    freescale/fsl-tqmls1088a-mbls10xxa.dtb \
"

# Files are needed in IMAGE_BOOT_FILES because /boot is on an extra partition.
# If those files should be installed under /boot inside the rootfs, you can
# achieve this in your BSP layer adding them via
# IMAGE_INSTALL:append = " kernel-devicetree kernel-image-zimage"
#
IMAGE_BOOT_FILES = "\
    ${KERNEL_IMAGETYPE};linuximage \
    fsl-tqmls1088a-mbls10xxa.dtb \
"

# direct assignment to override empty default from meta-freescale
WKS_FILE = "tqmls1088a-sdimg.wks.in"

WKS_FILE_DEPENDS += "\
    dosfstools-native \
    e2fsprogs-native \
    mtools-native \
    parted-native \
"

# Install kernel and devicetree also under /boot inside the rootfs,
# needed for UBIFS use case to prevent extra partition(s) for kernel and dtb.
MACHINE_EXTRA_RRECOMMENDS += "\
    kernel-devicetree \
    kernel-image \
"

WICVARS:append = " RCWIMG MC_DPL MC_DPC"

RCWIMG ?= "tqmls1088a-mbls10xxa/${@d.getVar('RCW' + d.getVar('BOOTMODE').upper())}"

UBOOT_CONFIG ??= "qspi esdhc"
UBOOT_CONFIG[qspi] = "tqmls1088a_mbls10xxa_qspi_defconfig,ubi"
UBOOT_CONFIG[esdhc] = "tqmls1088a_mbls10xxa_esdhc_defconfig,wic"

# Reset Configuration Word for TQMLS1088A is handled by NXP RCW tool (see fork
# in TQ rcw git repository). Following variables select the RCW files used for
# different boot sources.
RCWSD ??= "RR_SSSSPPPH_3333_5559/rcw_1400_sdboot.bin"
RCWEMMC ??= "RR_SSSSPPPH_3333_5559/rcw_1400_emmcboot.bin"
RCWQSPI ??= "RR_SSSSPPPH_3333_5559/rcw_1400_qspiboot.bin"

#
# mc-utils example configuration for starter kit
# needs to be adjusted for custom boards / setups
#
MC_FOLDER ?= "${MACHINE}"
MC_DPC ?= "dpc.0x12_0x0D.dtb"
MC_DPL ?= "dpl-eth.0x12_0x0D.dtb"
```

## meta-tq/conf/machine/tqmlx2160a-mblx2160a.conf
```bitbake
#@TYPE: Machine
#@NAME: TQ-Systems GmbH TQMLX2160A Module on MBLX2160A Baseboard
#@SOC: lx2160A
#@DESCRIPTION: Machine configuration for TQ-Systems GmbH TQMLX2160A
#@MAINTAINER: Gregor Herburger <oss@ew.tq-group.com>
#
require conf/machine/include/tqmlx2160a.inc

# no default assignment here, since we overwrite defaults from qoriq-arm64.inc
SERIAL_CONSOLES = "115200;ttyAMA0"
SERIAL_CONSOLES_CHECK = "${SERIAL_CONSOLES}"
USE_VT = "0"

KERNEL_DEVICETREE ?= " \
    freescale/fsl-lx2160a-mblx2160a.dtb \
"

IMAGE_BOOT_FILES = "\
    mc_app/mc.itb;mc.itb \
    mc-utils/${MC_DPC};${MC_DPC} \
    mc-utils/${MC_DPL};${MC_DPL} \
"

# Add packages we want to be deployed, even when they are not part of rootfs
# We need these here to support UBI / NFS boot case
EXTRA_IMAGEDEPENDS += "\
    virtual/bootloader \
    virtual/kernel \
"

# direct assignment to override empty default from meta-freescale
WKS_FILE = "tqmlx2160a.wks.in"

# EXTRA_IMAGEDEPENDS are applied to do_image_complete only. do_image_wic may run
# before and needs those packages as well
WKS_FILE_DEPENDS += "${EXTRA_IMAGEDEPENDS}"

UBOOT_CONFIG ?= "tfa"

UBOOT_CONFIG[tfa] = "tqmlx2160a_mblx2160a_tfa_defconfig,wic"

# auto boottype can boot from both eMMC and SD card
BOOTTYPE ?= "\
    auto \
    flexspi_nor \
"

# Reset Configuration Word for ATF
RCWXSPI ?= "${MACHINE}/rcw_2200_750_2800_14_11_2"
RCWAUTO ?= "${MACHINE}/rcw_2200_750_2800_14_11_2"
ATF_RCW_VARIANTS ?= " \
    ${MACHINE}/rcw_2200_750_2800_0_0_0 \
    ${MACHINE}/rcw_2200_750_2800_12_11_3 \
    ${MACHINE}/rcw_2200_750_2800_12_7_3 \
    ${MACHINE}/rcw_2200_750_2800_12_8_3 \
    ${MACHINE}/rcw_2200_750_2800_14_11_2 \
    ${MACHINE}/rcw_2200_750_2800_14_11_3 \
    ${MACHINE}/rcw_2200_750_2800_14_7_2 \
    ${MACHINE}/rcw_2200_750_2800_14_7_3 \
    ${MACHINE}/rcw_2200_750_2800_14_8_2 \
    ${MACHINE}/rcw_2200_750_2800_14_8_3 \
"

# Build additional bootonly image with this PBL variant
PBL_VARIANT = "bl2_auto_tqmlx2160a_16gb"

IMAGE_OFFSET_PBL ?= "4"
IMAGE_OFFSET_FIP ?= "1024"
IMAGE_MAXSIZE_PBL ?= "1020"

#
# mc-utils example configuration for starter kit
# needs to be adjusted for custom boards / setups
#
MC_FOLDER ?= "${MACHINE}"
MC_DPC ?= "dpc-warn.dtb"
MC_DPL ?= "dpl-min.dtb"

# Do not put Images into /boot of rootfs, install kernel-image if needed
RRECOMMENDS:${KERNEL_PACKAGE_NAME}-base = ""
```

## meta-tq/conf/machine/tqmt1022-64bit-stkt104x.conf
```bitbake
#@TYPE: Machine
#@NAME: TQMT1022-64B module on STKT1042
#@SOC: T1022
#@DESCRIPTION: Machine configuration for the TQ-Systems GmbH TQMT1022
#@MAINTAINER: Gregor Herburger <gregor.herburger@tq-group.com>
#
# Processor           Memory  Boot device  Configuration
# --------------      ------  -----------  --------------------
# T1022               2GiB    MMC / SD
# T1022               2GiB    QSPI-NOR
#

MACHINEOVERRIDES =. "t1022:tqmt1022:"

require conf/machine/include/tqmt10xx.inc

UBOOT_CONFIG ??= "sdcard nor"
UBOOT_CONFIG[nor] ?= "TQMT1022_defconfig"
UBOOT_CONFIG[sdcard] ?= "TQMT1022_SDCARD_defconfig,,u-boot-with-spl-pbl.bin"

UBOOT_RCW_VARIANTS ?= "\
    default/rcw_86_sdcard \
    default/rcw_88_sdcard \
    default/rcw_8e_sdcard \
"

KERNEL_DEVICETREE ?= "\
    fsl/tqmt1022-stkt104x.dtb \
"

# Files are needed in IMAGE_BOOT_FILES because /boot is on an extra partition.
# If those files should be installed under /boot inside the rootfs, you can
# achieve this in your BSP layer adding them via
# IMAGE_INSTALL_append = " kernel-devicetree kernel-image-zimage"
#
IMAGE_BOOT_FILES = "\
    ${KERNEL_IMAGETYPE} \
    tqmt1022-stkt104x.dtb \
"

FMAN_UCODE ?= "fsl_fman_ucode_t1040_r1.1_107_4_2.bin"
```

## meta-tq/conf/machine/tqmt1024-64bit-stkt104x.conf
```bitbake
#@TYPE: Machine
#@NAME: TQMT1024-64B module on STKT1042
#@SOC: T1024
#@DESCRIPTION: Machine configuration for the TQ-Systems GmbH TQMT1024
#@MAINTAINER: Gregor Herburger <oss@ew.tq-group.com>
#
# Processor           Memory  Boot device  Configuration
# --------------      ------  -----------  --------------------
# T1024               2GiB    MMC / SD
# T1024               2GiB    QSPI-NOR
#

MACHINEOVERRIDES =. "t1024:tqmt1024:"

include conf/machine/include/tqmt10xx.inc

UBOOT_CONFIG ??= "sdcard nor"
UBOOT_CONFIG[nor] ?= "TQMT1024_defconfig"
UBOOT_CONFIG[sdcard] ?= "TQMT1024_SDCARD_defconfig,,u-boot-with-spl-pbl.bin"

UBOOT_RCW_VARIANTS ?= "\
    default/rcw_6b_sdcard \
    default/rcw_95_sdcard \
"

KERNEL_DEVICETREE ?= "\
    fsl/tqmt1024-stkt104x-6b.dtb \
    fsl/tqmt1024-stkt104x-95.dtb \
"

# Files are needed in IMAGE_BOOT_FILES because /boot is on an extra partition.
# If those files should be installed under /boot inside the rootfs, you can
# achieve this in your BSP layer adding them via
# IMAGE_INSTALL_append = " kernel-devicetree kernel-image-zimage"
#
IMAGE_BOOT_FILES = "\
    ${KERNEL_IMAGETYPE} \
    tqmt1024-stkt104x-6b.dtb \
    tqmt1024-stkt104x-95.dtb \
"

FMAN_UCODE ?= "fsl_fman_ucode_t1024_r1.0_108_4_9.bin"
```

## meta-tq/conf/machine/tqmt1040-64bit-stkt104x.conf
```bitbake
#@TYPE: Machine
#@NAME: TQMT1040-64B module on STKT1042
#@SOC: T1040
#@DESCRIPTION: Machine configuration for the TQ-Systems GmbH TQMT1040
#@MAINTAINER: Gregor Herburger <gregor.herburger@tq-group.com>
#
# Processor           Memory  Boot device  Configuration
# --------------      ------  -----------  --------------------
# T1040               2GiB    MMC / SD
# T1040               2GiB    QSPI-NOR
#

MACHINEOVERRIDES =. "t1040:tqmt1040:"

include conf/machine/include/tqmt10xx.inc

UBOOT_CONFIG ??= "sdcard nor"
UBOOT_CONFIG[nor] ?= "TQMT1040_defconfig"
UBOOT_CONFIG[sdcard] ?= "TQMT1040_SDCARD_defconfig,,u-boot-with-spl-pbl.bin"

UBOOT_RCW_VARIANTS ?= "\
    default/rcw_66_sdcard \
"

KERNEL_DEVICETREE ?= "\
    fsl/tqmt1040-stkt104x.dtb \
"

# Files are needed in IMAGE_BOOT_FILES because /boot is on an extra partition.
# If those files should be installed under /boot inside the rootfs, you can
# achieve this in your BSP layer adding them via
# IMAGE_INSTALL_append = " kernel-devicetree kernel-image-zimage"
#
IMAGE_BOOT_FILES = "\
    ${KERNEL_IMAGETYPE} \
    tqmt1040-stkt104x.dtb \
"

FMAN_UCODE ?= "fsl_fman_ucode_t1040_r1.1_107_4_2.bin"
```

## meta-tq/conf/machine/tqmt1042-64bit-stkt104x.conf
```bitbake
#@TYPE: Machine
#@NAME: TQMT1042-64B module on STKT1042
#@SOC: T1042
#@DESCRIPTION: Machine configuration for the TQ-Systems GmbH TQMT1042
#@MAINTAINER: Gregor Herburger <gregor.herburger@tq-group.com>
#
# Processor           Memory  Boot device  Configuration
# --------------      ------  -----------  --------------------
# T1042               2GiB    MMC / SD
# T1042               2GiB    QSPI-NOR
#

MACHINEOVERRIDES =. "t1042:tqmt1042:"

include conf/machine/include/tqmt10xx.inc

UBOOT_CONFIG ??= "sdcard nor"
UBOOT_CONFIG[nor] ?= "TQMT1042_defconfig"
UBOOT_CONFIG[sdcard] ?= "TQMT1042_SDCARD_defconfig,,u-boot-with-spl-pbl.bin"

FSL_RCW ?= "TQMT1042_SERDES86"

KERNEL_DEVICETREE ?= "\
    fsl/tqmt1042-stkt104x.dtb \
"

# Files are needed in IMAGE_BOOT_FILES because /boot is on an extra partition.
# If those files should be installed under /boot inside the rootfs, you can
# achieve this in your BSP layer adding them via
# IMAGE_INSTALL_append = " kernel-devicetree kernel-image-zimage"
#
IMAGE_BOOT_FILES = "\
    ${KERNEL_IMAGETYPE} \
    tqmt1042-stkt104x.dtb \
"

FMAN_UCODE ?= "fsl_fman_ucode_t1040_r1.1_107_4_2.bin"
```

## meta-tq/files/wic/tqmls1012al-sdimg.wks
```
# short-description: Create SD card image with a boot partition
# long-description:
# Create an image that can be written onto a SD card using dd for use
# with tqmls1012al
#
# The disk layout used is:
#  -- -------- ------------- ---
# |  | /boot  |    rootfs   |
#  -- -------- ------------- ---
# ^  ^        ^             ^
# |  |        |             |
# 0 4MiB      |        variable
#             |
#            4MiB + 32 MiB * overhead-factor (default: `--overhead-factor=1.3`)
#            alignment 4 MiB (managed NAND)
#
part /boot --source bootimg-partition --fstype=vfat --label boot --active --offset 4M --size 32M
part / --source rootfs --fstype=ext4 --label root --align 4096

bootloader --ptable msdos
```
