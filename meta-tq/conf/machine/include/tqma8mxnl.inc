## meta-tq/conf/machine/tqma67xx-mba67xx.conf
```bitbake
#@TYPE: Machine
#@NAME: TQ-Systems TQMa67xx Module on MBa67xx Baseboard
#@SOC: AM67xx
#@DESCRIPTION: Machine configuration for TQ-Systems TQMa67xx

require conf/machine/include/tqma67xx.inc
require conf/machine/include/tq-machine.inc

KERNEL_DEVICETREE = " \
    ti/k3-am67a-tqma67xx-mba67xx.dtb \
    ti/k3-am67a-tqma67xx-mba67xx-csi0-imx327.dtbo \
    ti/k3-am67a-tqma67xx-mba67xx-csi0-ov9281.dtbo \
    ti/k3-am67a-tqma67xx-mba67xx-csi2-imx219.dtbo \
    ti/k3-am67a-tqma67xx-mba67xx-csi3-imx219.dtbo \
    ti/k3-am67a-tqma67xx-mba67xx-dsi-rpi-7inch-panel.dtbo \
    ti/k3-am67a-tqma67xx-mba67xx-lvds-tm070jdhg30.dtbo \
    ti/k3-am67a-tqma67xx-mba67xx-lvds-vesa-fhd.dtbo \
    ti/k3-am67a-tqma67xx-mba67xx-spe.dtbo \
"

SERIAL_CONSOLES = "115200;ttyS0"

# disable virtual console support for this board and limit getty to SERIAL_CONSOLES only
USE_VT = "0"

UBOOT_EXTLINUX_FDTDIR ?= ""

UBOOT_EXTLINUX_LABELS ?= " \
    default \
    dsi-rpi-7inch-panel \
    lvds-tm070jdhg30 \
    lvds-vesa-fhd \
    csi0-imx327 \
    csi0-ov9281 \
    csi2-imx219 \
    csi3-imx219 \
    lvds-tm070jdhg30-csi0-imx327 \
    lvds-tm070jdhg30-csi0-ov9281 \
    lvds-tm070jdhg30-csi2-imx219 \
    lvds-tm070jdhg30-csi3-imx219 \
    lvds-vesa-fhd-csi0-imx327 \
    lvds-vesa-fhd-csi0-ov9281 \
    lvds-vesa-fhd-csi2-imx219 \
    lvds-vesa-fhd-csi3-imx219 \
    spe \
"
UBOOT_EXTLINUX_DEFAULT_LABEL ?= "default"

UBOOT_EXTLINUX_KERNEL_IMAGE_default = "../fitImage"
UBOOT_EXTLINUX_MENU_DESCRIPTION_default = "${DISTRO_NAME} on ${MACHINE} (default)"

UBOOT_EXTLINUX_KERNEL_IMAGE_dsi-rpi-7inch-panel = \
    "../fitImage#conf-k3-am67a-tqma67xx-mba67xx.dtb#conf-k3-am67a-tqma67xx-mba67xx-dsi-rpi-7inch-panel.dtbo"
UBOOT_EXTLINUX_MENU_DESCRIPTION_dsi-rpi-7inch-panel = \
    "${DISTRO_NAME} on ${MACHINE} (DSI display: RPi 7inch)"

UBOOT_EXTLINUX_KERNEL_IMAGE_lvds-tm070jdhg30 = \
    "../fitImage#conf-k3-am67a-tqma67xx-mba67xx.dtb#conf-k3-am67a-tqma67xx-mba67xx-lvds-tm070jdhg30.dtbo"
UBOOT_EXTLINUX_MENU_DESCRIPTION_lvds-tm070jdhg30 = \
    "${DISTRO_NAME} on ${MACHINE} (LVDS display: TM070JDHG30)"

UBOOT_EXTLINUX_KERNEL_IMAGE_lvds-vesa-fhd = \
    "../fitImage#conf-k3-am67a-tqma67xx-mba67xx.dtb#conf-k3-am67a-tqma67xx-mba67xx-lvds-vesa-fhd.dtbo"
UBOOT_EXTLINUX_MENU_DESCRIPTION_lvds-vesa-fhd = \
    "${DISTRO_NAME} on ${MACHINE} (LVDS display: Generic VESA Full HD)"

UBOOT_EXTLINUX_KERNEL_IMAGE_csi0-imx327 = \
    "../fitImage#conf-k3-am67a-tqma67xx-mba67xx.dtb#conf-k3-am67a-tqma67xx-mba67xx-csi0-imx327.dtbo"
UBOOT_EXTLINUX_MENU_DESCRIPTION_csi0-imx327 = \
    "${DISTRO_NAME} on ${MACHINE} (MIPI-CSI camera: IMX327)"

UBOOT_EXTLINUX_KERNEL_IMAGE_csi0-ov9281 = \
    "../fitImage#conf-k3-am67a-tqma67xx-mba67xx.dtb#conf-k3-am67a-tqma67xx-mba67xx-csi0-ov9281.dtbo"
UBOOT_EXTLINUX_MENU_DESCRIPTION_csi0-ov9281 = \
    "${DISTRO_NAME} on ${MACHINE} (MIPI-CSI camera: OV9281)"

UBOOT_EXTLINUX_KERNEL_IMAGE_csi2-imx219 = \
    "../fitImage#conf-k3-am67a-tqma67xx-mba67xx.dtb#conf-k3-am67a-tqma67xx-mba67xx-csi2-imx219.dtbo"
UBOOT_EXTLINUX_MENU_DESCRIPTION_csi2-imx219 = \
    "${DISTRO_NAME} on ${MACHINE} (MIPI-CSI camera: RPi camera module on X19)"

UBOOT_EXTLINUX_KERNEL_IMAGE_csi3-imx219 = \
    "../fitImage#conf-k3-am67a-tqma67xx-mba67xx.dtb#conf-k3-am67a-tqma67xx-mba67xx-csi3-imx219.dtbo"
UBOOT_EXTLINUX_MENU_DESCRIPTION_csi3-imx219 = \
    "${DISTRO_NAME} on ${MACHINE} (MIPI-CSI camera: RPi camera module on X20)"

UBOOT_EXTLINUX_KERNEL_IMAGE_lvds-tm070jdhg30-csi0-imx327 = \
    "../fitImage#conf-k3-am67a-tqma67xx-mba67xx.dtb#conf-k3-am67a-tqma67xx-mba67xx-lvds-tm070jdhg30.dtbo#conf-k3-am67a-tqma67xx-mba67xx-csi0-imx327.dtbo"
UBOOT_EXTLINUX_MENU_DESCRIPTION_lvds-tm070jdhg30-csi0-imx327 = \
    "${DISTRO_NAME} on ${MACHINE} (LVDS display: TM070JDHG30 + MIPI-CSI camera: IMX327)"

UBOOT_EXTLINUX_KERNEL_IMAGE_lvds-tm070jdhg30-csi0-ov9281  = \
    "../fitImage#conf-k3-am67a-tqma67xx-mba67xx.dtb#conf-k3-am67a-tqma67xx-mba67xx-lvds-tm070jdhg30.dtbo#conf-k3-am67a-tqma67xx-mba67xx-csi0-ov9281.dtbo"
UBOOT_EXTLINUX_MENU_DESCRIPTION_lvds-tm070jdhg30-csi0-ov9281  = \
    "${DISTRO_NAME} on ${MACHINE} (LVDS display: TM070JDHG30 + MIPI-CSI camera: OV9281)"

UBOOT_EXTLINUX_KERNEL_IMAGE_lvds-tm070jdhg30-csi2-imx219 = \
    "../fitImage#conf-k3-am67a-tqma67xx-mba67xx.dtb#conf-k3-am67a-tqma67xx-mba67xx-lvds-tm070jdhg30.dtbo#conf-k3-am67a-tqma67xx-mba67xx-csi2-imx219.dtbo"
UBOOT_EXTLINUX_MENU_DESCRIPTION_lvds-tm070jdhg30-csi2-imx219 = \
    "${DISTRO_NAME} on ${MACHINE} (LVDS display: TM070JDHG30 + MIPI-CSI camera: RPi camera module on X19)"

UBOOT_EXTLINUX_KERNEL_IMAGE_lvds-tm070jdhg30-csi3-imx219 = \
    "../fitImage#conf-k3-am67a-tqma67xx-mba67xx.dtb#conf-k3-am67a-tqma67xx-mba67xx-lvds-tm070jdhg30.dtbo#conf-k3-am67a-tqma67xx-mba67xx-csi3-imx219.dtbo"
UBOOT_EXTLINUX_MENU_DESCRIPTION_lvds-tm070jdhg30-csi3-imx219 = \
    "${DISTRO_NAME} on ${MACHINE} (LVDS display: TM070JDHG30 + MIPI-CSI camera: RPi camera module on X20)"

UBOOT_EXTLINUX_KERNEL_IMAGE_lvds-vesa-fhd-csi0-imx327 = \
    "../fitImage#conf-k3-am67a-tqma67xx-mba67xx.dtb#conf-k3-am67a-tqma67xx-mba67xx-lvds-vesa-fhd.dtbo#conf-k3-am67a-tqma67xx-mba67xx-csi0-imx327.dtbo"
UBOOT_EXTLINUX_MENU_DESCRIPTION_lvds-vesa-fhd-csi0-imx327 = \
    "${DISTRO_NAME} on ${MACHINE} (LVDS display: Generic VESA Full HD + MIPI-CSI camera: IMX327)"

UBOOT_EXTLINUX_KERNEL_IMAGE_lvds-vesa-fhd-csi0-ov9281  = \
    "../fitImage#conf-k3-am67a-tqma67xx-mba67xx.dtb#conf-k3-am67a-tqma67xx-mba67xx-lvds-vesa-fhd.dtbo#conf-k3-am67a-tqma67xx-mba67xx-csi0-ov9281.dtbo"
UBOOT_EXTLINUX_MENU_DESCRIPTION_lvds-vesa-fhd-csi0-ov9281  = \
    "${DISTRO_NAME} on ${MACHINE} (LVDS display: Generic VESA Full HD + MIPI-CSI camera: OV9281)"

UBOOT_EXTLINUX_KERNEL_IMAGE_lvds-vesa-fhd-csi2-imx219 = \
    "../fitImage#conf-k3-am67a-tqma67xx-mba67xx.dtb#conf-k3-am67a-tqma67xx-mba67xx-lvds-vesa-fhd.dtbo#conf-k3-am67a-tqma67xx-mba67xx-csi2-imx219.dtbo"
UBOOT_EXTLINUX_MENU_DESCRIPTION_lvds-vesa-fhd-csi2-imx219 = \
    "${DISTRO_NAME} on ${MACHINE} (LVDS display: Generic VESA Full HD + MIPI-CSI camera: RPi camera module on X19)"

UBOOT_EXTLINUX_KERNEL_IMAGE_lvds-vesa-fhd-csi3-imx219 = \
    "../fitImage#conf-k3-am67a-tqma67xx-mba67xx.dtb#conf-k3-am67a-tqma67xx-mba67xx-lvds-vesa-fhd.dtbo#conf-k3-am67a-tqma67xx-mba67xx-csi3-imx219.dtbo"
UBOOT_EXTLINUX_MENU_DESCRIPTION_lvds-vesa-fhd-csi3-imx219 = \
    "${DISTRO_NAME} on ${MACHINE} (LVDS display: Generic VESA Full HD + MIPI-CSI camera: RPi camera module on X20)"

UBOOT_EXTLINUX_KERNEL_IMAGE_spe = \
    "../fitImage#conf-k3-am67a-tqma67xx-mba67xx.dtb#conf-k3-am67a-tqma67xx-mba67xx-spe.dtbo"
UBOOT_EXTLINUX_MENU_DESCRIPTION_spe = \
    "${DISTRO_NAME} on ${MACHINE} (Single-pair Ethernet)"

MACHINE_FEATURES += "bluetooth camera wifi"
MACHINE_EXTRA_RRECOMMENDS += " \
    cc33xx-fw \
"

# Do not automatically load the RPMsg example to avoid log spam during boot
#KERNEL_MODULE_PROBECONF += "rpmsg_client_sample"
#module_conf_rpmsg_client_sample ?= "blacklist rpmsg_client_sample"

UBOOT_MACHINE = "tqma67xx_mba67xx_a53_defconfig"

require conf/machine/include/tq-distroboot.inc
```

## meta-tq/conf/machine/tqma6qdl-multi-mba6x.conf
```bitbake
#@TYPE: Machine
#@NAME: TQ-Systems GmbH TQMa6x SOM with on MBa6ULx baseboard, variants TQMa6S, TQMa6DL (1/2GB RAM), TQMa6D/Q  (1/2GB RAM), TQMa6DP/QP 
#@SOC: i.MX6S / i.MX6DL / i.MX6D / i.MX6Q / i.MX6DP / i.MX6QP
#@DESCRIPTION: Machine configuration for TQ-Systems GmbH TQMa6x
#@MAINTAINER: Markus Niebel <oss@ew.tq-group.com>

MACHINEOVERRIDES =. "imx:mx6q:mx6dl:"

require conf/machine/include/tqma6x.inc
require conf/machine/include/tq-machine.inc

SERIAL_CONSOLES = "115200;ttymxc1"

# disable virtual console support for this board and limit getty to SERIAL_CONSOLES only
USE_VT = "0"

KERNEL_DEVICETREE = "\
    nxp/imx/imx6dl-mba6a.dtb \
    nxp/imx/imx6dl-mba6b.dtb \
    \
    nxp/imx/imx6q-mba6a.dtb \
    nxp/imx/imx6q-mba6b.dtb \
    \
    nxp/imx/imx6qp-mba6b.dtb \
"

KERNEL_DEVICETREE_linux-tq = "\
    nxp/imx/imx6dl-mba6a-duallvds-tm070jvhg33.dtb \
    nxp/imx/imx6dl-mba6a-lvds-g133han01.dtb \
    nxp/imx/imx6dl-mba6a-lvds-tm070jvhg33.dtb \
    nxp/imx/imx6dl-mba6a-rgb-cdtech-dc44.dtb \
    nxp/imx/imx6dl-mba6a-rgb-cdtech-fc21.dtb \
    \
    nxp/imx/imx6dl-mba6b-duallvds-tm070jvhg33.dtb \
    nxp/imx/imx6dl-mba6b-lvds-g133han01.dtb \
    nxp/imx/imx6dl-mba6b-lvds-tm070jvhg33.dtb \
    nxp/imx/imx6dl-mba6b-rgb-cdtech-dc44.dtb \
    nxp/imx/imx6dl-mba6b-rgb-cdtech-fc21.dtb \
    \
    nxp/imx/imx6q-mba6a-duallvds-tm070jvhg33.dtb \
    nxp/imx/imx6q-mba6a-lvds-g133han01.dtb \
    nxp/imx/imx6q-mba6a-lvds-tm070jvhg33.dtb \
    nxp/imx/imx6q-mba6a-rgb-cdtech-dc44.dtb \
    nxp/imx/imx6q-mba6a-rgb-cdtech-fc21.dtb \
    \
    nxp/imx/imx6q-mba6b-duallvds-tm070jvhg33.dtb \
    nxp/imx/imx6q-mba6b-lvds-g133han01.dtb \
    nxp/imx/imx6q-mba6b-lvds-tm070jvhg33.dtb \
    nxp/imx/imx6q-mba6b-rgb-cdtech-dc44.dtb \
    nxp/imx/imx6q-mba6b-rgb-cdtech-fc21.dtb \
    \
    nxp/imx/imx6qp-mba6b-duallvds-tm070jvhg33.dtb \
    nxp/imx/imx6qp-mba6b-lvds-g133han01.dtb \
    nxp/imx/imx6qp-mba6b-lvds-tm070jvhg33.dtb \
    nxp/imx/imx6qp-mba6b-rgb-cdtech-dc44.dtb \
    nxp/imx/imx6qp-mba6b-rgb-cdtech-fc21.dtb \
    \
    nxp/imx/imx6qdl-mba6-duallvds-tm070jvhg33.dtbo \
    nxp/imx/imx6qdl-mba6-lvds-g133han01.dtbo \
    nxp/imx/imx6qdl-mba6-lvds-tm070jvhg33.dtbo \
    nxp/imx/imx6qdl-mba6-rgb-cdtech-dc44.dtbo \
    nxp/imx/imx6qdl-mba6-rgb-cdtech-fc21.dtbo \
"

KERNEL_DEVICETREE += "${@kernel_provider_dtbs(d)}"

MACHINE_FEATURES += "\
    bluetooth \
    screen \
    wifi \
"

MACHINE_EXTRA_RRECOMMENDS += "${@bb.utils.contains('COMBINED_FEATURES', 'wifi', 'linux-firmware-ath10k', '', d)}"
MACHINE_EXTRA_RRECOMMENDS += "${@bb.utils.contains('COMBINED_FEATURES', 'bluetooth', 'linux-firmware-qca', '', d)}"

UBOOT_CONFIG ?= "\
    sd \
    tqma6s_512mb \
    tqma6s_512mb_uuu \
    tqma6dl_1024mb tqma6dl_2048mb \
    tqma6dl_1024mb_uuu tqma6dl_2048mb_uuu \
    tqma6q_1024mb tqma6q_2048mb \
    tqma6q_1024mb_uuu tqma6q_2048mb_uuu \
    tqma6qp_1024mb \
    tqma6qp_1024mb_uuu \
"

UBOOT_CONFIG[sd] = "tqma6qp_mba6_defconfig"
UBOOT_CONFIG_IMAGE_FSTYPES[sd] = "wic"

UBOOT_CONFIG[tqma6s_512mb] = "tqma6s_mba6_defconfig"
UBOOT_CONFIG[tqma6s_512mb_uuu] = "tqma6s_mba6_mfg_defconfig"

UBOOT_CONFIG[tqma6dl_1024mb] = "tqma6dl_mba6_defconfig"
UBOOT_CONFIG[tqma6dl_1024mb_uuu] = "tqma6dl_mba6_mfg_defconfig"
UBOOT_CONFIG[tqma6dl_2048mb] = "tqma6dl_2gb_mba6_defconfig"
UBOOT_CONFIG[tqma6dl_2048mb_uuu] = "tqma6dl_2gb_mba6_mfg_defconfig"

UBOOT_CONFIG[tqma6q_1024mb] = "tqma6q_mba6_defconfig"
UBOOT_CONFIG[tqma6q_1024mb_uuu] = "tqma6q_mba6_mfg_defconfig"
UBOOT_CONFIG[tqma6q_2048mb] = "tqma6q_2gb_mba6_defconfig"
UBOOT_CONFIG[tqma6q_2048mb_uuu] = "tqma6q_2gb_mba6_mfg_defconfig"

UBOOT_CONFIG[tqma6qp_1024mb] = "tqma6qp_mba6_defconfig"
UBOOT_CONFIG[tqma6qp_1024mb_uuu] = "tqma6qp_mba6_mfg_defconfig"

# allow creating multiple wic images for a single machine
IMAGE_CLASSES += "gen_additional_wic"
# Workaround for gen_additional_wic, remove after conversion / compression is handled in class
TQ_IMAGE_COMPRESSION = ""

EXTWIC_BOOTLOADER_IMAGES = "\
    ${UBOOT_BINARY_BASENAME}-${MACHINE}.${UBOOT_SUFFIX}-tqma6s_512mb \
    ${UBOOT_BINARY_BASENAME}-${MACHINE}.${UBOOT_SUFFIX}-tqma6dl_1024mb \
    ${UBOOT_BINARY_BASENAME}-${MACHINE}.${UBOOT_SUFFIX}-tqma6dl_2048mb \
    ${UBOOT_BINARY_BASENAME}-${MACHINE}.${UBOOT_SUFFIX}-tqma6q_1024mb \
    ${UBOOT_BINARY_BASENAME}-${MACHINE}.${UBOOT_SUFFIX}-tqma6q_2048mb \
    ${UBOOT_BINARY_BASENAME}-${MACHINE}.${UBOOT_SUFFIX}-tqma6qp_1024mb \
"
```
