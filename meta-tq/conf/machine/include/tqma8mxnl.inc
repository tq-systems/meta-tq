## meta-tq/conf/machine/include/tqma91xx-common.inc
```bitbake
# Common definitions for TQ-Systems GmbH TQMa91xxLA / TQMa91xxCA

MACHINEOVERRIDES =. "imx:nxp-ahab:mx9:mx91:tqma91xx:"

# optionally source the machine specific features for multimedia etc. from
# meta-freescale

include conf/machine/include/imx-base.inc

# Override incompatible defaults from imx-base.inc.
IMAGE_BOOT_FILES = "u-boot-initial-env-sd"

require conf/machine/include/arm/armv8-2a/tune-cortexa55.inc

require conf/machine/include/tqmxx.inc

LOADADDR = ""

# Set DDR FIRMWARE
DDR_FIRMWARE_NAME = "\
    lpddr4_dmem_1d_v202201.bin \
    lpddr4_dmem_2d_v202201.bin \
    lpddr4_imem_1d_v202201.bin \
    lpddr4_imem_2d_v202201.bin \
"

IMX_SOC_REV ?= "A0"

ATF_PLATFORM = "imx91"

LOADADDR = ""
UBOOT_SUFFIX = "bin"
UBOOT_MAKE_TARGET = ""
SPL_BINARY = "spl/u-boot-spl.bin"

# Image Options

# Add packages we want to be deployed, even when they are not part of rootfs
EXTRA_IMAGEDEPENDS += "\
    imx-boot \
"

# for sdcard + wic image rule
RAW_BOOT_START_OFFSET_KB = "32"
RAW_BOOT_END_OFFSET_KB = "4096"
# compatibility with meta-freescale
IMX_BOOT_SEEK = "${RAW_BOOT_START_OFFSET_KB}"

#
# bootstream name, construction see imx-boot-tq recipe, do_deploy()
#
MACHINE_WKS_BOOTSTREAM ?= "imx-boot-${MACHINE}-sd.bin-flash_singleboot"

python() {
    wks_type = ""

    if bb.utils.contains("DISTRO_FEATURES", "secure", True, False, d):
        wks_type = "-verity"
    if bb.utils.contains("DISTRO_FEATURES", "rauc", True, False, d):
        if not bb.utils.contains("DISTRO_FEATURES", "secure", True, False, d):
            wks_type = "-rauc-ab"
        else:
            bb.warn("DISTRO_FEATURES contains 'rauc' and 'secure', using WKS_FILE selected by distro feature 'secure'")

    d.setVar("WKS_FILE", "tqmaxx-imx-v8-sdimg%s.wks.in" % wks_type)
}

MACHINE_FEATURES += "\
    can \
    ext2 \
    ext3 \
    rtc \
    serial \
    ubi \
    vfat \
"

KERNEL_IMAGETYPE = "Image"

PREFERRED_PROVIDER_imx-boot ?= "imx-boot-tq"
PREFERRED_PROVIDER_virtual/kernel:mx91-nxp-bsp ?= "linux-imx-tq"
# At the moment we support only these forks:
PREFERRED_PROVIDER_u-boot:mx91-generic-bsp ?= "u-boot-imx-tq"
PREFERRED_PROVIDER_virtual/bootloader:mx91-generic-bsp ?= "u-boot-imx-tq"
UBOOT_SUFFIX:mx91-generic-bsp = "bin"
UBOOT_SUFFIX:pn-u-boot-imx-tq = "bin"
IMX_DEFAULT_BOOTLOADER ?= "u-boot-imx-tq"

# multiple U-Boot env locations
TQ_FW_ENV_CONFIGS = "mmc0 mmc1 spi"

# Common image configuration
require conf/machine/include/tq-image.inc

PREFERRED_VERSION_linux-imx-tq ?= "6.6.%"
```

## meta-tq/conf/machine/include/tqma95xx-common.inc
```bitbake
# Common definitions for all TQ-Systems GmbH TQMa95xxLA / TQMa95xxSA modules

MACHINEOVERRIDES =. "imx:mx9:mx95:tqma95xx:"

# optionally source the machine specific features for multimedia etc. from
# meta-freescale

include conf/machine/include/imx-base.inc
require conf/machine/include/arm/armv8-2a/tune-cortexa55.inc

require conf/machine/include/tqmxx.inc

LOADADDR = ""

# Set DDR FIRMWARE
DDR_FIRMWARE_NAME = " \
    lpddr5_dmem_v202409.bin \
    lpddr5_dmem_qb_v202409.bin \
    lpddr5_imem_v202409.bin \
    lpddr5_imem_qb_v202409.bin \
"

IMX_SOC_REV:${MACHINE} ?= "B0"
OEI_DDRCONFIG ?= "TQMa95xxSA.DDR-Timing.${OEI_RAM_SIZE}GB.V25.06.0006"

ATF_PLATFORM = "imx95"
OEI_CONFIGS = "ddr tcm"
OEI_CORE   = "m33"
OEI_SOC    = "mx95"
OEI_BOARD  ?= "tqma95xx"
DDR_TYPE   = "lpddr5"

SYSTEM_MANAGER_FIRMWARE_BASENAME = "m33_image"

PREFERRED_PROVIDER_virtual/imx-system-manager = "imx-system-manager-tq"
PREFERRED_PROVIDER_virtual/imx-oei = "imx-oei-tq"

UBOOT_SUFFIX = "bin"
UBOOT_MAKE_TARGET = ""
SPL_BINARY = "spl/u-boot-spl.bin"

# Image Options

IMXBOOT_TARGETS ?= "\
    flash_a55 \
    flash_a55_flexspi \
"
MACHINE_WKS_BOOTSTREAM = "imx-boot-${MACHINE}-sd.bin-flash_a55"

WKS_FILE = "${@imx_v8_wks_from_distro_features(d)}"

# Add packages we want to be deployed, even when they are not part of rootfs
EXTRA_IMAGEDEPENDS += "\
    imx-boot \
"

# for sdcard + wic image rule
RAW_BOOT_START_OFFSET_KB = "32"
RAW_BOOT_END_OFFSET_KB = "4096"
# compatibility with meta-freescale
IMX_BOOT_SEEK = "${RAW_BOOT_START_OFFSET_KB}"

MACHINE_EXTRA_RRECOMMENDS += "\
    mali-imx-libgles1 \
"

MACHINE_FEATURES += "\
    can \
    ext2 \
    ext3 \
    npu \
    rtc \
    pci \
    serial \
    ubi \
    vfat \
    vpu \
"

KERNEL_IMAGETYPE = "Image"

PREFERRED_PROVIDER_imx-boot ?= "imx-boot-tq"
PREFERRED_PROVIDER_virtual/kernel:mx95-nxp-bsp ?= "linux-imx-tq"
# At the moment we support only these forks:
PREFERRED_PROVIDER_u-boot:mx95-generic-bsp ?= "u-boot-imx-tq"
PREFERRED_PROVIDER_virtual/bootloader:mx95-generic-bsp ?= "u-boot-imx-tq"
UBOOT_SUFFIX:mx95-generic-bsp = "bin"
UBOOT_SUFFIX:pn-u-boot-imx-tq = "bin"
IMX_DEFAULT_BOOTLOADER ?= "u-boot-imx-tq"

# Common image configuration
require conf/machine/include/tq-image.inc
```

## meta-tq/conf/machine/tqma62xx-mba62xx.conf
```bitbake
#@TYPE: Machine
#@NAME: TQ-Systems TQMa62xx Module on MBa62xx Baseboard
#@SOC: AM62xx
#@DESCRIPTION: Machine configuration for TQ-Systems TQMa62xx
#@MAINTAINER: Nora Schiffer, Alexander Feilke <oss@ew.tq-group.com>

require conf/machine/include/tqma62xx.inc
require conf/machine/include/tq-machine.inc

KERNEL_DEVICETREE = " \
    ti/k3-am625-tqma62xx-mba62xx.dtb \
    ti/k3-am62-tqma62xx-mba62xx-csi-imx327.dtbo \
    ti/k3-am62-tqma62xx-mba62xx-csi-ov9281.dtbo \
    ti/k3-am62-tqma62xx-mba62xx-lvds-tm070jdhg30.dtbo \
    ti/k3-am62-tqma62xx-mba62xx-lvds-vesa-fhd.dtbo \
"

SERIAL_CONSOLES = "115200;ttyS0"

# disable virtual console support for this board and limit getty to SERIAL_CONSOLES only
USE_VT = "0"

UBOOT_EXTLINUX_FDTDIR ?= ""

UBOOT_EXTLINUX_LABELS ?= " \
    default \
    lvds-tm070jdhg30 \
    lvds-vesa-fhd \
    csi-imx327 \
    csi-ov9281 \
    lvds-tm070jdhg30-csi-imx327 \
    lvds-tm070jdhg30-csi-ov9281 \
    lvds-vesa-fhd-csi-imx327 \
    lvds-vesa-fhd-csi-ov9281 \
"
UBOOT_EXTLINUX_DEFAULT_LABEL ?= "default"

UBOOT_EXTLINUX_KERNEL_IMAGE_default = "../fitImage"
UBOOT_EXTLINUX_MENU_DESCRIPTION_default = "${DISTRO_NAME} on ${MACHINE} (default)"

UBOOT_EXTLINUX_KERNEL_IMAGE_lvds-tm070jdhg30 = \
    "../fitImage#conf-k3-am625-tqma62xx-mba62xx.dtb#conf-k3-am62-tqma62xx-mba62xx-lvds-tm070jdhg30.dtbo"
UBOOT_EXTLINUX_MENU_DESCRIPTION_lvds-tm070jdhg30 = \
    "${DISTRO_NAME} on ${MACHINE} (LVDS display: TM070JDHG30)"

UBOOT_EXTLINUX_KERNEL_IMAGE_lvds-vesa-fhd = \
    "../fitImage#conf-k3-am625-tqma62xx-mba62xx.dtb#conf-k3-am62-tqma62xx-mba62xx-lvds-vesa-fhd.dtbo"
UBOOT_EXTLINUX_MENU_DESCRIPTION_lvds-vesa-fhd = \
    "${DISTRO_NAME} on ${MACHINE} (LVDS display: Generic VESA Full HD)"

UBOOT_EXTLINUX_KERNEL_IMAGE_csi-imx327 = \
    "../fitImage#conf-k3-am625-tqma62xx-mba62xx.dtb#conf-k3-am62-tqma62xx-mba62xx-csi-imx327.dtbo"
UBOOT_EXTLINUX_MENU_DESCRIPTION_csi-imx327 = \
    "${DISTRO_NAME} on ${MACHINE} (MIPI-CSI camera: IMX327)"

UBOOT_EXTLINUX_KERNEL_IMAGE_csi-ov9281 = \
    "../fitImage#conf-k3-am625-tqma62xx-mba62xx.dtb#conf-k3-am62-tqma62xx-mba62xx-csi-ov9281.dtbo"
UBOOT_EXTLINUX_MENU_DESCRIPTION_csi-ov9281 = \
    "${DISTRO_NAME} on ${MACHINE} (MIPI-CSI camera: OV9281)"

UBOOT_EXTLINUX_KERNEL_IMAGE_lvds-tm070jdhg30-csi-imx327 = \
    "../fitImage#conf-k3-am625-tqma62xx-mba62xx.dtb#conf-k3-am62-tqma62xx-mba62xx-lvds-tm070jdhg30.dtbo#conf-k3-am62-tqma62xx-mba62xx-csi-imx327.dtbo"
UBOOT_EXTLINUX_MENU_DESCRIPTION_lvds-tm070jdhg30-csi-imx327 = \
    "${DISTRO_NAME} on ${MACHINE} (LVDS display: TM070JDHG30 + MIPI-CSI camera: IMX327)"

UBOOT_EXTLINUX_KERNEL_IMAGE_lvds-tm070jdhg30-csi-ov9281  = \
    "../fitImage#conf-k3-am625-tqma62xx-mba62xx.dtb#conf-k3-am62-tqma62xx-mba62xx-lvds-tm070jdhg30.dtbo#conf-k3-am62-tqma62xx-mba62xx-csi-ov9281.dtbo"
UBOOT_EXTLINUX_MENU_DESCRIPTION_lvds-tm070jdhg30-csi-ov9281  = \
    "${DISTRO_NAME} on ${MACHINE} (LVDS display: TM070JDHG30 + MIPI-CSI camera: OV9281)"

UBOOT_EXTLINUX_KERNEL_IMAGE_lvds-vesa-fhd-csi-imx327 = \
    "../fitImage#conf-k3-am625-tqma62xx-mba62xx.dtb#conf-k3-am62-tqma62xx-mba62xx-lvds-vesa-fhd.dtbo#conf-k3-am62-tqma62xx-mba62xx-csi-imx327.dtbo"
UBOOT_EXTLINUX_MENU_DESCRIPTION_lvds-vesa-fhd-csi-imx327 = \
    "${DISTRO_NAME} on ${MACHINE} (LVDS display: Generic VESA Full HD + MIPI-CSI camera: IMX327)"

UBOOT_EXTLINUX_KERNEL_IMAGE_lvds-vesa-fhd-csi-ov9281  = \
    "../fitImage#conf-k3-am625-tqma62xx-mba62xx.dtb#conf-k3-am62-tqma62xx-mba62xx-lvds-vesa-fhd.dtbo#conf-k3-am62-tqma62xx-mba62xx-csi-ov9281.dtbo"
UBOOT_EXTLINUX_MENU_DESCRIPTION_lvds-vesa-fhd-csi-ov9281  = \
    "${DISTRO_NAME} on ${MACHINE} (LVDS display: Generic VESA Full HD + MIPI-CSI camera: OV9281)"

MACHINE_FEATURES += "bluetooth camera wifi"
MACHINE_EXTRA_RRECOMMENDS += " \
    linux-firmware-sd8997 \
"

# Do not automatically load the RPMsg example to avoid log spam during boot
KERNEL_MODULE_PROBECONF += "rpmsg_client_sample"
module_conf_rpmsg_client_sample ?= "blacklist rpmsg_client_sample"

UBOOT_MACHINE = "tqma62xx_mba62xx_a53_defconfig"

require conf/machine/include/tq-distroboot.inc
```
