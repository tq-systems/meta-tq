## meta-tq/conf/machine/include/mba8x-common.inc
```bitbake
# shared definitions for MBa8x mainboard
require conf/machine/include/tqma8x.inc
require conf/machine/include/tq-machine.inc

# We have to disable SERIAL_CONSOLE due to auto-serial-console
SERIAL_CONSOLES = "115200;ttyLP0"

# disable virtual console support for this board and limit getty to SERIAL_CONSOLES only
USE_VT = "0"

KERNEL_DEVICETREE = ""

KERNEL_DEVICETREE_linux-imx-tq = "\
    freescale/imx8qm-tqma8qm-mba8x.dtb \
    freescale/imx8qm-tqma8qm-mba8x-lvds0-g133han01.dtb \
    freescale/imx8qm-tqma8qm-mba8x-lvds0-tm070jvhg33.dtb \
    freescale/imx8qm-tqma8qm-mba8x-lvds1-g133han01.dtb \
    freescale/imx8qm-tqma8qm-mba8x-lvds1-tm070jvhg33.dtb \
    freescale/imx8qm-tqma8qm-mba8x-rpmsg.dtb \
"

KERNEL_DEVICETREE += "${@kernel_provider_dtbs(d)}"

BOARD_FIRMWARE_FILES = "\
    dpfw.bin \
    hdmirxfw.bin \
"

IMAGE_BOOT_FILES = "\
    ${@create_image_boot_dtb_files(d)} \
    ${BOARD_FIRMWARE_FILES} \
    ${KERNEL_IMAGETYPE} \
"

# TODO: handle optee as soon as supported
IMXBOOT_TARGETS ?= "\
    flash_linux_m4 \
    flash_spl \
    flash_spl_flexspi \
"

MACHINE_FEATURES += "\
    bluetooth \
    display \
    wifi \
"

MACHINE_EXTRA_RRECOMMENDS += "${@bb.utils.contains('COMBINED_FEATURES', 'wifi', 'linux-firmware-ath10k', '', d)}"
MACHINE_EXTRA_RRECOMMENDS += "${@bb.utils.contains('COMBINED_FEATURES', 'bluetooth', 'linux-firmware-qca', '', d)}"
```

## meta-tq/conf/machine/include/tqma6ull.inc
```bitbake
# Common definitions for TQ-Systems GmbH TQMa6ULL SOM

# optionally source the machine specific features for multimedia etc. from
# meta-freescale

MACHINEOVERRIDES =. "imx:mx6ull:tqma6ullx:"

include conf/machine/include/imx-base.inc

require conf/machine/include/arm/armv7a/tune-cortexa7.inc

# TQ u-boot and kernel
#
require conf/machine/include/tqmxx.inc

# Machine specific options

MACHINE_EXTRA_RRECOMMENDS += "\
    kernel-devicetree \
    kernel-modules \
    linux-firmware-imx-sdma-imx6q \
"

MACHINE_FEATURES += "\
    alsa \
    can \
    ext2 \
    rtc \
    serial \
    ubi \
    usbhost \
    vfat \
"

KERNEL_IMAGETYPE = "zImage"

PREFERRED_PROVIDER_u-boot:mx6ull-generic-bsp ?= "u-boot-imx-tq"
PREFERRED_PROVIDER_virtual/bootloader:mx6ull-generic-bsp ?= "u-boot-imx-tq"
UBOOT_MAKE_TARGET:mx6ull-generic-bsp ?= "u-boot.imx"
UBOOT_SUFFIX:mx6ull-generic-bsp = "imx"
UBOOT_SUFFIX:pn-u-boot-imx-tq = "imx"
IMX_DEFAULT_BOOTLOADER ?= "u-boot-imx-tq"

# Common image configuration
RAW_BOOT_START_OFFSET_KB = "1"
RAW_BOOT_END_OFFSET_KB = "1024"

require conf/machine/include/tq-image.inc
```

## meta-tq/conf/machine/include/tqma6x.inc
```bitbake
# Common definitions for TQ-Systems GmbH TQMa6 SOM

# optionally source the machine specific features for multimedia etc. from
# meta-freescale

MACHINEOVERRIDES =. "imx:mx6:tqma6x:"

include conf/machine/include/imx-base.inc

# Override incompatible defaults from imx-base.inc.
IMAGE_BOOT_FILES = "u-boot-initial-env-sd"

require conf/machine/include/arm/armv7a/tune-cortexa9.inc

# TQ u-boot and kernel
#
require conf/machine/include/tqmxx.inc

# Machine specific options

MACHINE_EXTRA_RRECOMMENDS += "\
    firmware-imx-vpu-imx6d \
    firmware-imx-vpu-imx6q \
    linux-firmware-imx-sdma-imx6q \
"

MACHINE_FEATURES += "\
    alsa \
    can \
    ext2 \
    pci \
    rtc \
    serial \
    ubi \
    usbhost \
    vfat \
    vpu \
"

KERNEL_IMAGETYPE = "zImage"

PREFERRED_PROVIDER_u-boot:mx6-generic-bsp ?= "u-boot-tq"
PREFERRED_PROVIDER_virtual/bootloader:mx6-generic-bsp ?= "u-boot-tq"
UBOOT_SUFFIX:mx6-generic-bsp = "imx"
UBOOT_BINARY_BASENAME:mx6-generic-bsp = "u-boot-with-spl"
UBOOT_MAKE_TARGET:mx6-generic-bsp = "${UBOOT_BINARY_BASENAME}.${UBOOT_SUFFIX}"
UBOOT_BINARY:mx6-generic-bsp = "${UBOOT_MAKE_TARGET}"
IMX_DEFAULT_BOOTLOADER ?= "u-boot-tq"

# multiple U-Boot env locations
TQ_FW_ENV_CONFIGS = "mmc0 mmc1 spi"

# allow to easy override for different configuration
MACHINE_WKS_BOOTSTREAM ?= "${UBOOT_BINARY_BASENAME}-${MACHINE}.${UBOOT_SUFFIX}-sd"

WKS_FILE = "tqmaxx-imx-v7-sdimg.wks.in"

# Common image configuration
RAW_BOOT_START_OFFSET_KB = "1"
RAW_BOOT_END_OFFSET_KB = "1024"

require conf/machine/include/tq-image.inc
```

## meta-tq/conf/machine/include/tqma7.inc
```bitbake
# Common definitions for TQ-Systems GmbH TQMa7x modules

MACHINEOVERRIDES =. "imx:mx7:mx7d:tqma7x:"

# optionally source the machine specific features for multimedia etc. from
# meta-freescale
include conf/machine/include/imx-base.inc

# Override incompatible defaults from imx-base.inc.
IMAGE_BOOT_FILES = "u-boot-initial-env-sd"

require conf/machine/include/arm/armv7a/tune-cortexa7.inc

# TQ u-boot and kernel
#
require conf/machine/include/tqmxx.inc

# Machine specific options
#
MACHINE_EXTRA_RRECOMMENDS += "\
    linux-firmware-imx-sdma-imx7d \
"

MACHINE_FEATURES += "\
    alsa \
    can \
    ext2 \
    pci \
    rtc \
    serial \
    ubi \
    usbhost \
    vfat \
"

KERNEL_IMAGETYPE = "zImage"

PREFERRED_PROVIDER_u-boot:mx7-generic-bsp ?= "u-boot-tq"
PREFERRED_PROVIDER_virtual/bootloader:mx7-generic-bsp ?= "u-boot-tq"
UBOOT_SUFFIX:mx7-generic-bsp = "imx"
UBOOT_BINARY_BASENAME:mx7-generic-bsp = "u-boot-dtb"
UBOOT_MAKE_TARGET:mx7-generic-bsp ?= "${UBOOT_BINARY_BASENAME}.${UBOOT_SUFFIX}"
UBOOT_BINARY:mx7-generic-bsp = "${UBOOT_MAKE_TARGET}"
IMX_DEFAULT_BOOTLOADER ?= "u-boot-tq"

# multiple U-Boot env locations
TQ_FW_ENV_CONFIGS = "mmc0 mmc1 spi"

# allow to easy override for different configuration
MACHINE_WKS_BOOTSTREAM ?= "${UBOOT_BINARY_BASENAME}-${MACHINE}.${UBOOT_SUFFIX}-sd"

WKS_FILE = "tqmaxx-imx-v7-sdimg.wks.in"

# Common image configuration
RAW_BOOT_START_OFFSET_KB = "1"
RAW_BOOT_END_OFFSET_KB = "1024"

require conf/machine/include/tq-image.inc
```

## meta-tq/conf/machine/include/tqma8-common.inc
```bitbake
# Common definitions for all TQ-Systems GmbH TQMa8x / TQMa8Xx / TQMa8Mx /
# TQMa8MxML / TQMa8MxNL / TQMa8MPxL modules

require conf/machine/include/tqmxx.inc

MACHINE_FEATURES += "\
    alsa \
    ext2 \
    ext3 \
    rtc \
    serial \
    ubi \
    usbhost \
    vfat \
"

# This should be added to 'MACHINE_FEATURES` after inclusion of 'imx-base.inc'
MACHINE_FEATURES += "vpu"
MACHINE_FEATURES:remove:mx8mn-generic-bsp = "vpu"

PREFERRED_PROVIDER_imx-boot ?= "imx-boot-tq"

KERNEL_IMAGETYPE = "Image"

SPL_BINARY = "spl/u-boot-spl.bin"

PREFERRED_PROVIDER_u-boot:mx8-generic-bsp ?= "u-boot-imx-tq"
PREFERRED_PROVIDER_virtual/bootloader:mx8-generic-bsp ?= "u-boot-imx-tq"
UBOOT_SUFFIX:mx8-generic-bsp = "bin"
UBOOT_SUFFIX:pn-u-boot-imx-tq = "bin"
IMX_DEFAULT_BOOTLOADER ?= "u-boot-imx-tq"


PREFERRED_PROVIDER_virtual/imx-cortexm-demos ?= "tqma8-cortexm-demos"

python() {
    wks_type = ""

    if bb.utils.contains("DISTRO_FEATURES", "secure", True, False, d):
        wks_type = "-verity"
    if bb.utils.contains("DISTRO_FEATURES", "rauc", True, False, d):
        if not bb.utils.contains("DISTRO_FEATURES", "secure", True, False, d):
            wks_type = "-rauc-ab"
        else:
            bb.warn("DISTRO_FEATURES contains 'rauc' and 'secure', using WKS_FILE selected by distro feature 'secure'")

    d.setVar("WKS_FILE", "tqmaxx-imx-v8-sdimg%s.wks.in" % wks_type)
}

# Common image configuration
require conf/machine/include/tq-image.inc
```
