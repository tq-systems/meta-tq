## meta-tq/conf/machine/tqma57xx-mba57xx.conf
```bitbake
#@TYPE: Machine
#@NAME: TQ-Systems GmbH TQMa57[1,2,4]x Module on MBa57xx Baseboard
#@SOC: AM57[1,2,4]x
#@DESCRIPTION: Machine configuration for TQ-Systems GmbH TQMa57[1,2,4]x
#@MAINTAINER: Markus Niebel <oss@ew.tq-group.com>
#
# By default, this machine will build for the full featured option
# with SD / eMMC boot
#
# To build U-Boot for other CPU or memory combinations, you can set
# the UBOOT_MACHINE variable in your local.conf according to the
# following table:
#
# Processor           Memory             Boot device    Configuration
# --------------      ---------------    -----------    -----------------------------
# AM5718              1 GiB              SD / e-MMC     tqma57xx_mba57xx_ecc_config
# AM5728              2 GiB              SD / e-MMC     tqma57xx_mba57xx_ecc_config
# AM5748              2 GiB              SD / e-MMC     tqma57xx_mba57xx_ecc_config
#

require conf/machine/include/tqma57xx.inc
require conf/machine/include/tqma57xx-prueth.inc
require conf/machine/include/mba57xx-common.inc

UBOOT_CONFIG ?= "sd"
UBOOT_CONFIG[sd] = "tqma57xx_mba57xx_defconfig,wic"
## TODO: qspi boot missing
```

## meta-tq/conf/machine/tqma62xx-mba62xx-k3r5.conf
```bitbake
#@TYPE: Machine
#@NAME: TQ-Systems TQMa62xx Module on MBa62xx Baseboard (AM62xx R5)
#@SOC: AM62xx
#@DESCRIPTION: Machine configuration for TQ-Systems TQMa62xx (Cortex-R5 toolchain)

require conf/machine/include/tqma62xx-k3r5.inc

UBOOT_MACHINE = "tqma62xx_mba62xx_r5_defconfig"
```

## meta-tq/conf/machine/tqma64xxl-mbax4xxl-k3r5-gp.conf
```bitbake
#@TYPE: Machine
#@NAME: TQ-Systems TQMa64xxL Module on MBaX4XxL Baseboard (AM64xx GP R5)
#@SOC: AM64xx
#@DESCRIPTION: Machine configuration for TQ-Systems TQMa64xxL (Cortex-R5 toolchain)

require conf/machine/include/tqma64xxl-k3r5-gp.inc
require conf/machine/include/tqma64xxl-mbax4xxl-k3r5.inc
```

## meta-tq/conf/machine/tqma64xxl-mbax4xxl-k3r5-sr2-hs-se.conf
```bitbake
#@TYPE: Machine
#@NAME: TQ-Systems TQMa64xxL Module on MBaX4XxL Baseboard (AM64xx SR2.0 HS-SE R5)
#@SOC: AM64xx
#@DESCRIPTION: Machine configuration for TQ-Systems TQMa64xxL (Cortex-R5 toolchain)

require conf/machine/include/tqma64xxl-k3r5-sr2-hs-se.inc
require conf/machine/include/tqma64xxl-mbax4xxl-k3r5.inc
```

## meta-tq/conf/machine/tqma64xxl-mbax4xxl-k3r5.conf
```bitbake
#@TYPE: Machine
#@NAME: TQ-Systems TQMa64xxL Module on MBaX4XxL Baseboard (AM64xx R5)
#@SOC: AM64xx
#@DESCRIPTION: Machine configuration for TQ-Systems TQMa64xxL (Cortex-R5 toolchain)

require conf/machine/include/tqma64xxl-k3r5.inc

UBOOT_MACHINE = "tqma64xxl_mbax4xxl_r5_defconfig"
```

## meta-tq/conf/machine/tqma64xxl-mbax4xxl.conf
```bitbake
#@TYPE: Machine
#@NAME: TQ-Systems TQMa64xxL Module on MBaX4XxL Baseboard
#@SOC: AM64xx
#@DESCRIPTION: Machine configuration for TQ-Systems TQMa64xxL

require conf/machine/include/tqma64xxl.inc

KERNEL_DEVICETREE = " \
    ti/k3-am642-tqma64xxl-mbax4xxl.dtb \
    ti/k3-am64-tqma64xxl-mbax4xxl-sdcard.dtbo \
    ti/k3-am64-tqma64xxl-mbax4xxl-wlan.dtbo \
"

SERIAL_CONSOLES = "115200;ttyS2"

# disable virtual console support for this board and limit getty to SERIAL_CONSOLES only
USE_VT = "0"

# Add packages we want to be deployed, even when they are not part of rootfs
# We need these here to support UBI / NFS boot case
EXTRA_IMAGEDEPENDS += "\
    virtual/bootloader \
"

KERNEL_IMAGETYPE = "fitImage"
UBOOT_EXTLINUX_FDTDIR ?= ""

UBOOT_EXTLINUX_LABELS ?= "sdcard wlan"
UBOOT_EXTLINUX_DEFAULT_LABEL ?= "sdcard"

UBOOT_EXTLINUX_KERNEL_IMAGE_sdcard = "../fitImage#conf-ti_k3-am642-tqma64xxl-mbax4xxl.dtb#conf-ti_k3-am64-tqma64xxl-mbax4xxl-sdcard.dtbo"
UBOOT_EXTLINUX_MENU_DESCRIPTION_sdcard = "${DISTRO_NAME} on ${MACHINE} (SD-card on SDHCI1)"
UBOOT_EXTLINUX_KERNEL_IMAGE_wlan = "../fitImage#conf-ti_k3-am642-tqma64xxl-mbax4xxl.dtb#conf-ti_k3-am64-tqma64xxl-mbax4xxl-wlan.dtbo"
UBOOT_EXTLINUX_MENU_DESCRIPTION_wlan = "${DISTRO_NAME} on ${MACHINE} (WLAN on SDHCI1)"

# Do not update fstab file when using wic images
WIC_CREATE_EXTRA_ARGS ?= "--no-fstab-update"

WKS_FILE = "tqmaxx-ti-sdimg.wks.in"

# EXTRA_IMAGEDEPENDS are applied to do_image_complete only. do_image_wic may run
# before and needs those packages as well
WKS_FILE_DEPENDS += "${EXTRA_IMAGEDEPENDS}"

WIC_BOOTPART_SIZE = "12M"

require conf/machine/include/tqma64xxl-pru.inc

MACHINE_FEATURES += "bluetooth wifi"
MACHINE_EXTRA_RRECOMMENDS += "linux-firmware-nxp-w8987-sdiouart"

UBOOT_MACHINE = "tqma64xxl_mbax4xxl_a53_defconfig"

require conf/machine/include/tq-distroboot.inc
```

## meta-tq/conf/machine/tqma6dl-mba6x.conf
```bitbake
#@TYPE: Machine
#@NAME: TQ-Systems GmbH TQMa6DL Module on MBa6x Baseboard
#@SOC: i.MX6DL
#@DESCRIPTION: Machine configuration for TQ-Systems GmbH TQMa6 DualLight
#@MAINTAINER: Markus Niebel <oss@ew.tq-group.com>
#
# Processor        Boot device     Memory    Configuration
# --------------   -----------     ------    --------------------
# i.MX6Dual-Lite   e-MMM / SD         1GB    tqma6dl_mba6_defconfig
# i.MX6Dual-Lite   SPI NOR            1GB    tqma6dl_mba6_defconfig
#

require conf/machine/include/tqma6dl.inc
require conf/machine/include/tqma6dl-mba6x.inc
require conf/machine/include/mba6x-common.inc

UBOOT_CONFIG ?= "\
    sd \
"

UBOOT_CONFIG[sd] = "tqma6dl_mba6_defconfig,wic"
```

## meta-tq/conf/machine/tqma6q-2gb-mba6x.conf
```bitbake
#@TYPE: Machine
#@NAME: TQ-Systems GmbH TQMa6[Q,D] Module with 2GB RAM on MBa6x Baseboard
#@SOC: i.MX6Q
#@DESCRIPTION: Machine configuration for TQ-Systems GmbH TQMa6 Quad / Dual
#@MAINTAINER: Markus Niebel <Markus.Niebel@tq-group.com>
#
# Processor        Boot device     Memory    Configuration
# --------------   -----------     ------    --------------------
# i.MX6Quad/Dual   e-MMM / SD         2GB    tqma6q_2gb_mba6_defconfig
# i.MX6Quad/Dual   SPI NOR            2GB    tqma6q_2gb_mba6_defconfig
#

require conf/machine/include/tqma6q.inc
require conf/machine/include/tqma6q-mba6x.inc
require conf/machine/include/mba6x-common.inc

UBOOT_CONFIG ?= "\
    sd \
"

UBOOT_CONFIG[sd] = "tqma6q_2gb_mba6_defconfig,wic"
```

## meta-tq/conf/machine/tqma6qp-mba6x.conf
```bitbake
#@TYPE: Machine
#@NAME: TQ-Systems GmbH TQMa6[QP,DP] Module on MBa6x Baseboard
#@SOC: i.MX6QP
#@DESCRIPTION: Machine configuration for TQ-Systems GmbH TQMa6 QuadPlus / DualPlus
#@MAINTAINER: Markus Niebel <Markus.Niebel@tq-group.com>
#
# Processor                Boot device     Memory    Configuration
# --------------           -----------     ------    --------------------------
# i.MX6QuadPLus/DualPlus   e-MMM / SD         1GB    tqma6qp_mba6_defconfig
# i.MX6QuadPLus/DualPlus   SPI NOR            1GB    tqma6qp_mba6_defconfig
#

require conf/machine/include/tqma6q.inc
require conf/machine/include/mba6x-common.inc

KERNEL_DEVICETREE = "\
    imx6qp-mba6b.dtb \
    imx6qp-mba6b-duallvds-tm070jvhg33.dtb \
    imx6qp-mba6b-hdmi.dtb \
    imx6qp-mba6b-lvds-tm070jvhg33.dtb \
"

KERNEL_DEVICETREE_linux-tq = "\
    imx6qp-mba6b-cdtech-dc44.dtb \
    imx6qp-mba6b-cdtech-fc21.dtb \
    imx6qp-mba6b-multi.dtb \
"

KERNEL_DEVICETREE += "${@kernel_provider_dtbs(d)} "

UBOOT_CONFIG ?= "\
    sd \
"

UBOOT_CONFIG[sd] = "tqma6qp_mba6_defconfig,wic"
```

## meta-tq/conf/machine/tqma6s-mba6x.conf
```bitbake
#@TYPE: Machine
#@NAME: TQ-Systems GmbH TQMa6S Module on MBa6x Baseboard
#@SOC: i.MX6S
#@DESCRIPTION: Machine configuration for TQ-Systems GmbH TQMa6 Quad / Dual
#@MAINTAINER: Markus Niebel <oss@ew.tq-group.com>
#
# Processor        Boot device     Memory    Configuration
# --------------   -----------     ------    --------------------
# i.MX6Solo        e-MMM / SD       512MB    tqma6s_mba6_defconfig
# i.MX6Solo        SPI NOR          512MB    tqma6s_mba6_defconfig
#

require conf/machine/include/tqma6dl.inc
require conf/machine/include/tqma6dl-mba6x.inc
require conf/machine/include/mba6x-common.inc

UBOOT_CONFIG ?= "\
    sd \
"

UBOOT_CONFIG[sd] = "tqma6s_mba6_defconfig,wic"
```

## meta-tq/conf/machine/tqma6ulx-512mb-mba6ulx.conf
```bitbake
#@TYPE: Machine
#@NAME: TQ-Systems GmbH TQMa6ULx SOM with 512 MB RAM on MBa6ULx baseboard
#@SOC: i.MX6UL
#@DESCRIPTION: Machine configuration for TQ-Systems GmbH TQMaULx
#@MAINTAINER: Markus Niebel <oss@ew.tq-group.com>
#
# By default, this machine will be built for the full featured option
# with SD / eMMC boot
#
# To build U-Boot for other CPU or memory combinations, you can set
# the UBOOT_MACHINE variable in your local.conf according to the
# following table:
#
# Processor     Memory     Boot device     Configuration
# ----------    -------    ------------    -------------------------------------
# i.MX6UL       512MiB     SD / e-MMC      tqma6ulx_512mb_mba6ul_mmc_defconfig
# i.MX6UL       512MiB     QSPI-NOR        tqma6ulx_512mb_mba6ul_qspi_defconfig
#

include conf/machine/include/tqma6ul.inc
include conf/machine/include/tqma6ulx-mba6ulx.inc
include conf/machine/include/mba6ulx-common.inc


UBOOT_CONFIG ?= "\
    qspi \
    sd \
"

UBOOT_CONFIG[sd] = "tqma6ulx_512mb_mba6ul_mmc_defconfig,wic"
UBOOT_CONFIG[qspi] = "tqma6ulx_512mb_mba6ul_qspi_defconfig,ubi"
```

## meta-tq/conf/machine/tqma8mx-2gb-mba8mx.conf
```bitbake
#@TYPE: Machine
#@NAME: i.MX 8MQ TQMa8M[Q,D]L on MBa8Mx
#@DESCRIPTION: i.MX 8MQ MBa8Mx starter kit
#@MAINTAINER: Markus Niebel <oss@ew.tq-group.com>
#
# Processor                     Memory    Configuration
# --------------                ------    --------------------------------------
# i.MX8M[Q,L]L                  2GiB      tqma8mq_2gb_mba8mx_mmc_defconfig

require conf/machine/include/tqma8mx-mba8mx.inc

UBOOT_CONFIG ??= "sd mfgtool"
UBOOT_CONFIG[sd] = "tqma8mq_2gb_mba8mx_mmc_defconfig,wic"
UBOOT_CONFIG[mfgtool] = "tqma8mq_2gb_mba8mx_mfg_defconfig"
```

## meta-tq/conf/machine/tqma8mx-4gb-mba8mx.conf
```bitbake
#@TYPE: Machine
#@NAME: i.MX 8MQ TQMa8M[Q,D]L on MBa8Mx
#@DESCRIPTION: i.MX 8MQ MBa8Mx starter kit
#@MAINTAINER: Markus Niebel <Markus.Niebel@tq-group.com>
#
# Processor                     Memory    Configuration
# --------------                ------    --------------------------------------
# i.MX8M[Q,L]L                  4GiB      tqma8mq_4gb_mba8mx_mmc_defconfig

require conf/machine/include/tqma8mx-mba8mx.inc

UBOOT_CONFIG ??= "sd mfgtool"
UBOOT_CONFIG[sd] = "tqma8mq_4gb_mba8mx_mmc_defconfig,wic"
UBOOT_CONFIG[mfgtool] = "tqma8mq_4gb_mba8mx_mfg_defconfig"
```
