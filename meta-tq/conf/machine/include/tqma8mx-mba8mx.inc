## meta-tq/conf/machine/include/tqma8mx-mba8mx.inc
```bitbake
# Common definitions for TQ-Systems GmbH MBa8Mx baseboard for TQMa8Mx modules

require conf/machine/include/tqma8mx.inc
require conf/machine/include/mba8mx-common.inc

# Set u-boot DTB
UBOOT_DTB_NAME = "imx8mq-mba8mx.dtb"

KERNEL_DEVICETREE = "\
    freescale/imx8mq-tqma8mq-mba8mx.dtb \
"

KERNEL_DEVICETREE_linux-imx-tq = "\
    freescale/imx8mq-tqma8mq-mba8mx-dcss-hdmi.dtb \
    freescale/imx8mq-tqma8mq-mba8mx-dcss-hdmi-ov9281.dtb \
    freescale/imx8mq-tqma8mq-mba8mx-dcss-hdmi-imx327.dtb \
    freescale/imx8mq-tqma8mq-mba8mx-dcss-lvds-tm070jvhg33.dtb \
    freescale/imx8mq-tqma8mq-mba8mx-lcdif-lvds-tm070jvhg33.dtb \
    freescale/imx8mq-tqma8mq-mba8mx-rpmsg.dtb \
"

KERNEL_DEVICETREE += "${@kernel_provider_dtbs(d)}"

IMAGE_BOOT_FILES += "${@create_image_boot_dtb_files(d)}"

IMXBOOT_SDMMC_HDMI_TARGET = "flash_hdmi_spl_uboot"
IMXBOOT_SDMMC_TARGET = "flash_spl_uboot"

IMXBOOT_TARGETS ?= "\
    ${IMXBOOT_SDMMC_HDMI_TARGET} \
    ${IMXBOOT_SDMMC_TARGET} \
"

#
# primary bootstream name for WKS / WIC, construction see imx-boot recipe,
# do_deploy
#
MACHINE_WKS_BOOTSTREAM ?= "imx-boot-${MACHINE}-sd.bin-${IMXBOOT_SDMMC_HDMI_TARGET}"
```

## meta-tq/conf/machine/include/tqma8mxml-mba8mx.inc
```bitbake
# Common definitions for TQ-Systems GmbH TQMa8MxML modules on MBa8Mx starter kit

require conf/machine/include/tqma8mxml.inc
require conf/machine/include/mba8mx-common.inc

# Set u-boot DTB
UBOOT_DTB_NAME = "imx8mm-mba8mx.dtb"

KERNEL_DEVICETREE = "\
    freescale/imx8mm-tqma8mqml-mba8mx.dtb \
"

KERNEL_DEVICETREE_linux-imx-tq = "\
    freescale/imx8mm-tqma8mqml-mba8mx-lcdif-lvds-tm070jvhg33.dtb \
    freescale/imx8mm-tqma8mqml-mba8mx-lcdif-lvds-tm070jvhg33-imx327.dtb \
    freescale/imx8mm-tqma8mqml-mba8mx-lcdif-lvds-tm070jvhg33-ov9281.dtb \
    freescale/imx8mm-tqma8mqml-mba8mx-rpmsg.dtb \
"

KERNEL_DEVICETREE += "${@kernel_provider_dtbs(d)}"

IMAGE_BOOT_FILES += "${@create_image_boot_dtb_files(d)}"

IMXBOOT_FSPI_TARGET = "flash_evk_flexspi"
IMXBOOT_SDMMC_TARGET = "flash_spl_uboot"

IMXBOOT_TARGETS ?= "\
    ${IMXBOOT_FSPI_TARGET} \
    ${IMXBOOT_SDMMC_TARGET} \
"

#
# primary bootstream name for WKS / WIC, construction see imx-boot recipe,
# do_deploy
#
MACHINE_WKS_BOOTSTREAM ?= "imx-boot-${MACHINE}-sd.bin-${IMXBOOT_SDMMC_TARGET}"
# append to prevent overwriting default assignment
WICVARS:append = " MACHINE_WKS_BOOTSTREAM"
```

## meta-tq/conf/machine/include/tqma8x-common.inc
```bitbake
# Common definitions for all TQ-Systems GmbH TQMa8x modules

MACHINEOVERRIDES =. "imx:mx8:mx8qm:"

# Don't include kernels in standard images
RDEPENDS:${KERNEL_PACKAGE_NAME}-base = ""

LOADADDR = ""

# Machine specific options
#
MACHINE_FEATURES:append = " can pci"

PREFERRED_PROVIDER_virtual/imx-cortexm-demos = "tqma8-cortexm-demos"
PREFERRED_PROVIDER_imx-sc-firmware ?= "imx-sc-firmware-tq"

UBOOT_MAKE_TARGET ?= "all"
UBOOT_SUFFIX ?= "bin"

ATF_PLATFORM = "imx8qm"

# for sdcard image rule
BOOT_SPACE = "65536"
IMAGE_BOOTLOADER = "imx-boot"
# for sdcard + wic image rule
IMX_BOOT_SEEK = "32"
IMX_BOOT_SOC_TARGET = "iMX8QM"


# Image Options
#
EXTRA_IMAGEDEPENDS += "u-boot imx-boot imx-sc-firmware"

# Verified values to generate UBI image:
# physical erase block size
UBI_PEB_SIZE = "65536"
UBI_MINIMUM_IO_UNIT_SIZE = "1"
UBI_SUB_PAGE_SIZE = "1"
# UBI_VID_HEADER_OFFSET="64"
# logical erase block size
UBI_LEB_SIZE = "65408"

# we have 64 MB flash, 8 MB for bootloader and env should be enough
# so use 1024 - 128 LEB
UBI_MAX_LEB_COUNT = "896"

MKUBIFS_ARGS = "\
    --min-io-size=${UBI_MINIMUM_IO_UNIT_SIZE} \
    --leb-size=${UBI_LEB_SIZE} \
    --max-leb-cnt=${UBI_MAX_LEB_COUNT} \
"

UBINIZE_ARGS = "\
    --peb-size=${UBI_PEB_SIZE} \
    --min-io-size=${UBI_MINIMUM_IO_UNIT_SIZE} \
    --sub-page-size=${UBI_SUB_PAGE_SIZE} \
"

# needs to be set to have it consistent for kernel command line
# Use the expected value of the ubifs filesystem's volume name in the kernel
# and u-boot.
UBI_VOLNAME = "root"

WKS_FILE_DEPENDS = "\
    mtools-native \
    dosfstools-native \
    parted-native \
    virtual/kernel \
    virtual/bootloader \
    imx-boot \
    imx-sc-firmware \
"

# optionally source the machine specific features for multimedia etc. from
# meta-freescale

include conf/machine/include/imx-base.inc
require conf/machine/include/arm/armv8a/tune-cortexa72-cortexa53.inc

# need to do after imx-base, not included in firmware-imx-8.3
MACHINE_FIRMWARE:remove = "firmware-imx-brcm"
```

## meta-tq/conf/machine/include/tqma9-common.inc
```bitbake
# Common definitions for all TQ-Systems GmbH TQMa9xxx SOM

require conf/machine/include/tqmxx.inc

MACHINE_EXTRA_RRECOMMENDS += "\
    kernel-devicetree \
    kernel-modules \
"

PREFERRED_PROVIDER_imx-boot ?= "imx-boot-tq"

KERNEL_IMAGETYPE = "Image"

SPL_BINARY = "spl/u-boot-spl.bin"

# Do not update fstab file when using wic images
WIC_CREATE_EXTRA_ARGS ?= "--no-fstab-update"

WKS_FILE = "tqmaxx-imx-v8-sdimg.wks.in"
```

## meta-tq/conf/machine/include/tqma93xx-common.inc
```bitbake
# Common definitions for TQ-Systems GmbH TQMa93xxLA / TQMa93xxCA

MACHINEOVERRIDES =. "imx:mx9:mx93:tqma93xx:"

# optionally source the machine specific features for multimedia etc. from
# meta-freescale

include conf/machine/include/imx-base.inc
require conf/machine/include/arm/armv8-2a/tune-cortexa55.inc

require conf/machine/include/tqmxx.inc

LOADADDR = ""

# Set DDR FIRMWARE
DDR_FIRMWARE_NAME = "\
    lpddr4_dmem_1d_v202201.bin \
    lpddr4_dmem_2d_v202201.bin \
    lpddr4_imem_1d_v202201.bin \
    lpddr4_imem_2d_v202201.bin \
"

IMX_SOC_REV ?= "A1"

ATF_PLATFORM = "imx93"

LOADADDR = ""
UBOOT_SUFFIX = "bin"
UBOOT_MAKE_TARGET = ""
SPL_BINARY = "spl/u-boot-spl.bin"

# Image Options

# Add packages we want to be deployed, even when they are not part of rootfs
# We need these here to support UBI / NFS boot case
EXTRA_IMAGEDEPENDS += "\
    imx-boot \
    virtual/bootloader \
    virtual/kernel \
"

# Verified values to generate UBI image:
# physical erase block size
UBI_PEB_SIZE = "65536"
UBI_MINIMUM_IO_UNIT_SIZE = "1"
UBI_SUB_PAGE_SIZE = "1"
# UBI_VID_HEADER_OFFSET="64"
# logical erase block size
UBI_LEB_SIZE = "65408"

# we have 64 MB flash, 8 MB for bootloader and env should be enough
# so use 1024 - 128 LEB
UBI_MAX_LEB_COUNT = "896"

MKUBIFS_ARGS = "\
    --min-io-size=${UBI_MINIMUM_IO_UNIT_SIZE} \
    --leb-size=${UBI_LEB_SIZE} \
    --max-leb-cnt=${UBI_MAX_LEB_COUNT} \
"

UBINIZE_ARGS = "\
    --peb-size=${UBI_PEB_SIZE} \
    --min-io-size=${UBI_MINIMUM_IO_UNIT_SIZE} \
    --sub-page-size=${UBI_SUB_PAGE_SIZE} \
"

# needs to be set to have it consistent for kernel command line
# Use the expected value of the ubifs filesystem's volume name in the kernel
# and u-boot.
UBI_VOLNAME = "root"

# for sdcard + wic image rule
RAW_BOOT_START_OFFSET_KB = "32"
RAW_BOOT_END_OFFSET_KB = "4096"
# compatibility with meta-freescale
IMX_BOOT_SEEK = "${RAW_BOOT_START_OFFSET_KB}"
# imx-mkimage[-tq]
IMX_BOOT_SOC_TARGET = "iMX9"

MACHINE_EXTRA_RRECOMMENDS += "\
    kernel-devicetree \
    kernel-modules \
"

MACHINE_FEATURES += "\
    can \
    ext2 \
    ext3 \
    rtc \
    serial \
    ubi \
    vfat \
"

KERNEL_IMAGETYPE = "Image"

PREFERRED_PROVIDER_imx-boot ?= "imx-boot-tq"
PREFERRED_PROVIDER_virtual/kernel:mx93-nxp-bsp ?= "linux-imx-tq"
# At the moment we support only these forks:
PREFERRED_PROVIDER_imx-atf:mx93-generic-bsp = "imx-atf-tq"
PREFERRED_PROVIDER_u-boot:mx93-generic-bsp ?= "u-boot-imx-tq"
PREFERRED_PROVIDER_virtual/bootloader:mx93-generic-bsp ?= "u-boot-imx-tq"
UBOOT_SUFFIX:mx93-generic-bsp = "bin"
UBOOT_SUFFIX:pn-u-boot-imx-tq = "bin"
IMX_DEFAULT_BOOTLOADER ?= "u-boot-imx-tq"
```

## meta-tq/conf/machine/include/tqmls1012al-mbls1012al.inc
```bitbake
# Common definitions for TQ-Systems GmbH TQMLS1012AL modules on MBLS1012AL

MACHINE_FEATURES += "wifi"
MACHINE_EXTRA_RRECOMMENDS += "linux-firmware-ath10k"

# no default assignment here, since we overwrite defaults from qoriq-arm.inc
SERIAL_CONSOLES = "115200;ttyS0"
SERIAL_CONSOLES_CHECK = "${SERIAL_CONSOLES}"
# disable virtual console support for this board and limit getty to SERIAL_CONSOLES only
USE_VT = "0"

KERNEL_DEVICETREE ?= " \
  freescale/fsl-ls1012a-mbls1012al.dtb \
"

# Files are needed in IMAGE_BOOT_FILES because /boot is on an extra partition.
# If those files should be installed under /boot inside the rootfs, you can
# achieve this in your BSP layer adding them via
# IMAGE_INSTALL:append = " kernel-devicetree kernel-image"
#
IMAGE_BOOT_FILES = "\
    ${KERNEL_IMAGETYPE} \
    fsl-ls1012a-mbls1012al.dtb \
"

# direct assignment to override empty default from meta-freescale
WKS_FILE = "tqmls1012al-sdimg.wks"

WKS_FILE_DEPENDS = "\
    mtools-native \
    dosfstools-native \
    parted-native \
"

UBOOT_CONFIG ?= "tfa"
UBOOT_CONFIG[tfa] = "tqmls1012al_mbls1012al_tfa_defconfig"
```

## meta-tq/conf/machine/include/tqmls1043a-mbls10xxa.inc
```bitbake
# Common definitions for TQ-Systems GmbH TQMLS1043A modules on MBLS10xxA

require conf/machine/include/tqmls1043a.inc
require conf/machine/include/tqmls104xa-mbls10xxa.inc

KERNEL_DEVICETREE ?= " \
    freescale/fsl-ls1043a-tqmls1043a-mbls10xxa.dtb \
"

UBOOT_CONFIG ?= "tfa"
UBOOT_CONFIG[tfa] = "tqmls1043a_mbls10xxa_tfa_defconfig"

RCWSD ?= "default/rcw_1000_3358_sd"
RCWQSPI ?= "default/rcw_1000_3358_qspi"
ATF_RCW_VARIANTS ?= " \
    default/rcw_1000_1355_sd \
    default/rcw_1000_1355_qspi \
    default/rcw_1000_1455_sd \
    default/rcw_1000_1455_qspi \
    default/rcw_1000_3335_sd \
    default/rcw_1000_3335_qspi \
    default/rcw_1000_3355_sd \
    default/rcw_1000_3355_qspi \
    default/rcw_1000_3358_sd \
    default/rcw_1000_3358_qspi \
"
```

## meta-tq/conf/machine/include/tqmls1043a.inc
```bitbake
# Common definitions for TQ-Systems GmbH TQMLS1043A modules

MACHINEOVERRIDES =. "fsl-lsch2:ls1043a:tqmlsx:tqmls10xxa:tqmls104xa:tqmls1043a:"

require conf/machine/include/tqmls10xxa.inc

UBOOT_ENTRYPOINT:ls1043a = "0x80008000"

# Image Options
#

IMAGE_OFFSET_FMAN_UCODE ?= "9216"
FMAN_UCODE ?= "fsl_fman_ucode_ls1043_r1.1_106_4_18.bin"
```

## meta-tq/conf/machine/include/tqmls1046a-mbls10xxa.inc
```bitbake
# Common definitions for TQ-Systems GmbH TQMLS1046A modules on MBLS10xxA

require conf/machine/include/tqmls1046a.inc
require conf/machine/include/tqmls104xa-mbls10xxa.inc

KERNEL_DEVICETREE ?= " \
    freescale/fsl-ls1046a-tqmls1046a-mbls10xxa.dtb \
"

UBOOT_CONFIG ?= "tfa"
UBOOT_CONFIG[tfa] = "tqmls1046a_mbls10xxa_tfa_defconfig"

RCWSD ?= "default/rcw_1800_3333_5559_sd"
RCWQSPI ?= "default/rcw_1800_3333_5559_qspi"
ATF_RCW_VARIANTS ?= "\
    default/rcw_1800_1040_5506_qspi \
    default/rcw_1800_1040_5506_sd \
    default/rcw_1800_1040_5559_qspi \
    default/rcw_1800_1040_5559_sd \
    default/rcw_1800_1040_5577_qspi \
    default/rcw_1800_1040_5577_sd \
    default/rcw_1800_1040_5A06_qspi \
    default/rcw_1800_1040_5A06_sd \
    default/rcw_1800_1040_5A59_qspi \
    default/rcw_1800_1040_5A59_sd \
    default/rcw_1800_1133_5506_qspi \
    default/rcw_1800_1133_5506_sd \
    default/rcw_1800_1133_5559_qspi \
    default/rcw_1800_1133_5559_sd \
    default/rcw_1800_1133_5577_qspi \
    default/rcw_1800_1133_5577_sd \
    default/rcw_1800_1133_5A06_qspi \
    default/rcw_1800_1133_5A06_sd \
    default/rcw_1800_1133_5A59_qspi \
    default/rcw_1800_1133_5A59_sd \
    default/rcw_1800_3333_5506_qspi \
    default/rcw_1800_3333_5506_sd \
    default/rcw_1800_3333_5559_qspi \
    default/rcw_1800_3333_5559_sd \
    default/rcw_1800_3333_5577_qspi \
    default/rcw_1800_3333_5577_sd \
    default/rcw_1800_3333_5A06_qspi \
    default/rcw_1800_3333_5A06_sd \
    default/rcw_1800_3333_5A59_qspi \
    default/rcw_1800_3333_5A59_sd \
"
```

## meta-tq/conf/machine/include/tqmls1046a.inc
```bitbake
# Common definitions for TQ-Systems GmbH TQMLS1046A modules

MACHINEOVERRIDES =. "fsl-lsch2:ls1046a:tqmlsx:tqmls10xxa:tqmls104xa:tqmls1046a:"

require conf/machine/include/tqmls10xxa.inc

UBOOT_ENTRYPOINT:ls1046a = "0x80008000"

# Image Options
#

IMAGE_OFFSET_FMAN_UCODE ?= "9216"
FMAN_UCODE ?= "fsl_fman_ucode_ls1046_r1.0_106_4_18.bin"
```

## meta-tq/conf/machine/include/tqmls1088a-mbls10xxa.inc
```bitbake
#@TYPE: Machine
#@NAME: TQ-Systems GmbH TQMLS1088A Module on MBLS10xxa Baseboard
#@SOC: ls1088a
#@DESCRIPTION: Machine configuration for TQ-Systems GmbH TQMLS1088a
#@MAINTAINER: Gregor Herburger <oss@ew.tq-group.com>
#
# By default, this machine will build for the full featured option
# with QSPI-NOR boot
#
# Processor Memory          Boot Device  Configuration
# --------- ---------------	------------ --------------------
# LS1088A   2048MiB / ECC   QSPI-NOR     tqmls1088a_mbls10xxa_tfa_defconfig
# LS1088A   2048MiB / ECC   SD / eMMC    tqmls1088a_mbls10xxa_tfa_defconfig
#

require conf/machine/include/tqmls1088a.inc

# no default assignment here, since we overwrite defaults from qoriq-arm64.inc
SERIAL_CONSOLES = "115200;ttyS1"
SERIAL_CONSOLES_CHECK = "${SERIAL_CONSOLES}"
# disable virtual console support for this board and limit getty to SERIAL_CONSOLES only
USE_VT = "0"

KERNEL_DEVICETREE ?= " \
    freescale/fsl-ls1088a-tqmls1088a-mbls10xxa.dtb \
"

IMAGE_BOOT_FILES = "\
    mc_app/mc.itb;mc.itb \
    mc-utils/${MC_DPC};${MC_DPC} \
    mc-utils/${MC_DPL};${MC_DPL} \
"

# direct assignment to override empty default from meta-freescale
WKS_FILE = "tqmls1088a-sdimg.wks.in"

# EXTRA_IMAGEDEPENDS are applied to do_image_complete only. do_image_wic may run
# before and needs those packages as well
WKS_FILE_DEPENDS += "${EXTRA_IMAGEDEPENDS}"

# Install kernel and devicetree also under /boot inside the rootfs,
# needed for UBIFS use case to prevent extra partition(s) for kernel and dtb.
MACHINE_EXTRA_RRECOMMENDS += "\
    kernel-devicetree \
    kernel-image \
"

UBOOT_CONFIG ?= "tfa"
UBOOT_CONFIG[tfa] = "tqmls1088a_mbls10xxa_tfa_defconfig"

RCWQSPI ??= "default/rcw_1400_3333_5559"
RCWAUTO ??= "default/rcw_1400_3333_5559"

ATF_RCW_VARIANTS ="\
    default/rcw_1400_1133_5506 \
    default/rcw_1400_1133_5559 \
    default/rcw_1400_1133_5577 \
    default/rcw_1400_1143_5506 \
    default/rcw_1400_1143_5559 \
    default/rcw_1400_1143_5577 \
    default/rcw_1400_1144_5506 \
    default/rcw_1400_1144_5559 \
    default/rcw_1400_1144_5577 \
    default/rcw_1400_3333_5506 \
    default/rcw_1400_3333_5559 \
    default/rcw_1400_3333_5577 \
"

#
# mc-utils example configuration for starter kit
# needs to be adjusted for custom boards / setups
#
MC_FOLDER ?= "tqmls1088a-mbls10xxa"
MC_DPC ?= "dpc.0x12_0x0D.dtb"
MC_DPL ?= "dpl-eth.0x12_0x0D.dtb"
```

## meta-tq/conf/machine/include/tqmls1088a.inc
```bitbake
# Common definitions for TQ-Systems GmbH TQMLS1088A modules

MACHINEOVERRIDES =. "fsl-lsch3:ls1088a:tqmlsx:tqmls10xxa:tqmls1088a:"

require conf/machine/include/tqmls10xxa.inc

UBOOT_ENTRYPOINT:ls1088a = "0x80008000"

# Image Options
#

# DPAA2 manament utility
MACHINE_EXTRA_RRECOMMENDS += "restool"
```
