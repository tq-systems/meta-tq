## meta-tq/conf/machine/tqma8mpxl-mba8mpxl.conf
```bitbake
#@TYPE: Machine
#@NAME: i.MX 8MP TQMa8MP[Q,D,S[L]]L on MBa8MPxL
#@DESCRIPTION: i.MX 8MP MBa8MPxL starter kit and computing board
#@MAINTAINER: Markus Niebel <oss@ew.tq-group.com>
#
# Processor                     Memory     Configuration
# --------------                ------     --------------------------------------
# i.MX8MP[Q,D,S][L]             1,2,8 GiB  tqma8mpxl_multi_mba8mpxl_[ecc,uuu]defconfig

require conf/machine/include/tqma8mpxl.inc
require conf/machine/include/tq-machine.inc

# Set u-boot DTB, needed for boot image construction
UBOOT_DTB_NAME = "imx8mp-tqma8mpql-mba8mpxl.dtb"

KERNEL_DEVICETREE = "\
    freescale/imx8mp-tqma8mpql-mba8mpxl.dtb \
    freescale/imx8mp-tqma8mpql-mba8mpxl-lvds-g133han01.dtb \
    freescale/imx8mp-tqma8mpql-mba8mpxl-lvds.dtbo \
    freescale/imx8mp-tqma8mpql-mba8mpxl-lvds-g133han01.dtbo \
"

KERNEL_DEVICETREE_linux-imx-tq = "\
    freescale/imx8mp-tqma8mpql-mba8mpxl-imx327.dtb \
    freescale/imx8mp-tqma8mpql-mba8mpxl-lvds-tm070jvhg33.dtb \
    freescale/imx8mp-tqma8mpql-mba8mpxl-ov9281.dtb \
    freescale/imx8mp-tqma8mpql-mba8mpxl-rpmsg.dtb \
    freescale/imx8mp-tqma8mpql-mba8mpxl-imx327.dtbo \
    freescale/imx8mp-tqma8mpql-mba8mpxl-ov9281.dtbo \
    freescale/imx8mp-tqma8mpql-mba8mpxl-rpmsg.dtbo \
"

KERNEL_DEVICETREE_linux-tq = "\
    freescale/imx8mp-tqma8mpql-mba8mpxl-lvds.dtb \
"

KERNEL_DEVICETREE += "${@kernel_provider_dtbs(d)}"

UBOOT_CONFIG ??= "\
    ecc \
    mfgtool \
    sd \
"

UBOOT_CONFIG[ecc] = "tqma8mpxl_multi_mba8mpxl_ecc_defconfig"
UBOOT_CONFIG[sd] = "tqma8mpxl_multi_mba8mpxl_defconfig,wic"
UBOOT_CONFIG[mfgtool] = "tqma8mpxl_multi_mba8mpxl_uuu_defconfig"

MACHINE_FEATURES += "\
    bluetooth \
    camera \
    screen \
    wifi \
"

MACHINE_EXTRA_RRECOMMENDS += "${@bb.utils.contains('COMBINED_FEATURES', 'wifi', 'linux-firmware-ath10k', '', d)}"
MACHINE_EXTRA_RRECOMMENDS += "${@bb.utils.contains('COMBINED_FEATURES', 'bluetooth', 'linux-firmware-qca', '', d)}"

# Add packages we want to be deployed, even when they are not part of rootfs
# We need these here to support UBI / NFS boot case
EXTRA_IMAGEDEPENDS += "\
    virtual/imx-cortexm-demos \
"

# Set Serial console @ UART4
SERIAL_CONSOLES = "115200;ttymxc3"
# recipe imx-atf-tq: boot / debug UART address for UART4
ATF_IMX_BOOT_UART_BASE ?= "0x30a60000"

# disable virtual console support for this board and limit getty to SERIAL_CONSOLES only
USE_VT = "0"

CORTEXM_DEMOS += "\
    hello_world.bin \
    rpmsg_lite_pingpong_rtos_linux_remote.bin \
"

IMAGE_BOOT_FILES = "\
    ${CORTEXM_DEMOS} \
"

UBOOT_EXTLINUX_FDTDIR ?= ""

UBOOT_EXTLINUX_LABELS ?= " \
    default \
"

EXTRA_EXTLINUX_LABELS ?= ""

EXTRA_EXTLINUX_LABELS:mx8mp-nxp-bsp = " \
    imx327 \
    ov9281 \
    lvds-g133han01 \
    lvds-tm070jvhg33 \
    rpmsg \
"

EXTRA_EXTLINUX_LABELS:mx8mp-mainline-bsp = " \
    lvds \
"

UBOOT_EXTLINUX_LABELS += "${EXTRA_EXTLINUX_LABELS}"

UBOOT_EXTLINUX_DEFAULT_LABEL ?= "default"
UBOOT_EXTLINUX_KERNEL_IMAGE_default = "../fitImage"
UBOOT_EXTLINUX_MENU_DESCRIPTION_default = "${DISTRO_NAME} on ${MACHINE} (default)"

UBOOT_EXTLINUX_KERNEL_IMAGE_imx327 = \
    "../fitImage#${FIT_CONF_PREFIX}imx8mp-tqma8mpql-mba8mpxl.dtb#${FIT_CONF_PREFIX}imx8mp-tqma8mpql-mba8mpxl-imx327.dtbo"
UBOOT_EXTLINUX_MENU_DESCRIPTION_imx327 = \
    "${DISTRO_NAME} on ${MACHINE} (CSI sensor: IMX327)"

UBOOT_EXTLINUX_KERNEL_IMAGE_lvds-g133han01 = \
    "../fitImage#${FIT_CONF_PREFIX}imx8mp-tqma8mpql-mba8mpxl.dtb#${FIT_CONF_PREFIX}imx8mp-tqma8mpql-mba8mpxl-lvds-g133han01.dtbo"
UBOOT_EXTLINUX_MENU_DESCRIPTION_lvds-g133han01 = \
    "${DISTRO_NAME} on ${MACHINE} (LVDS display: G133HAN01)"

UBOOT_EXTLINUX_KERNEL_IMAGE_lvds-tm070jvhg33 = \
    "../fitImage#${FIT_CONF_PREFIX}imx8mp-tqma8mpql-mba8mpxl.dtb#${FIT_CONF_PREFIX}imx8mp-tqma8mpql-mba8mpxl-lvds.dtbo"
UBOOT_EXTLINUX_MENU_DESCRIPTION_lvds-tm070jvhg33 = \
    "${DISTRO_NAME} on ${MACHINE} (LVDS display: TM070JVHG33)"

# TODO: upstream name change is pending, to be removed once name change is backported
UBOOT_EXTLINUX_KERNEL_IMAGE_lvds = \
    "../fitImage#${FIT_CONF_PREFIX}imx8mp-tqma8mpql-mba8mpxl.dtb#${FIT_CONF_PREFIX}imx8mp-tqma8mpql-mba8mpxl-lvds.dtbo"
UBOOT_EXTLINUX_MENU_DESCRIPTION_lvds = \
    "${DISTRO_NAME} on ${MACHINE} (LVDS display: TM070JVHG33)"

UBOOT_EXTLINUX_KERNEL_IMAGE_ov9281 = \
    "../fitImage#${FIT_CONF_PREFIX}imx8mp-tqma8mpql-mba8mpxl.dtb#${FIT_CONF_PREFIX}imx8mp-tqma8mpql-mba8mpxl-ov9281.dtbo"
UBOOT_EXTLINUX_MENU_DESCRIPTION_ov9281 = \
    "${DISTRO_NAME} on ${MACHINE} (CSI sensor: OV9281)"

UBOOT_EXTLINUX_KERNEL_IMAGE_rpmsg = \
    "../fitImage#${FIT_CONF_PREFIX}imx8mp-tqma8mpql-mba8mpxl.dtb#${FIT_CONF_PREFIX}imx8mp-tqma8mpql-mba8mpxl-rpmsg.dtbo"
UBOOT_EXTLINUX_MENU_DESCRIPTION_rpmsg = \
    "${DISTRO_NAME} on ${MACHINE} (RPMSG support)"

require conf/machine/include/tq-distroboot.inc
```

## meta-tq/conf/machine/tqma95xxla-4gb-mba95xxca.conf
```bitbake
#@TYPE: Machine
#@NAME: i.MX95 TQMa95xxLA on MBa95xxCA
#@DESCRIPTION: TQ-Systems GmbH i.MX95 MBa95xxCA Kit
#@MAINTAINER: Markus Niebel <oss@ew.tq-group.com>

require conf/machine/include/tqma95xxla.inc
require conf/machine/include/mba95xxca-common.inc

OEI_RAM_SIZE = "4"
SYSTEM_MANAGER_CONFIG ?= "tqm95_l04g0c000"

UBOOT_CONFIG[sd] = "tqma95xxla_4gb_mba95xxca_defconfig"
```

## meta-tq/conf/machine/tqma95xxsa-2gb-mb-smarc-2.conf
```bitbake
#@TYPE: Machine
#@NAME: i.MX95 TQMa95xxSA on MB-SMARC-2
#@DESCRIPTION: TQ-Systems GmbH i.MX95 MB-SMARC-2 Kit
#@MAINTAINER: Markus Niebel <oss@ew.tq-group.com>

require conf/machine/include/tqma95xxsa-mb-smarc-2.inc

OEI_RAM_SIZE = "2"
SYSTEM_MANAGER_CONFIG ?= "tqm95_s02g0c000"

UBOOT_CONFIG[sd] = "tqma95xxsa_2gb_mb_smarc_2_defconfig"
UBOOT_CONFIG_IMAGE_FSTYPES[sd] = "wic"
```

## meta-tq/conf/machine/tqma95xxsa-4gb-mb-smarc-2.conf
```bitbake
#@TYPE: Machine
#@NAME: i.MX95 TQMa95xxSA on MB-SMARC-2
#@DESCRIPTION: TQ-Systems GmbH i.MX95 MB-SMARC-2 Kit
#@MAINTAINER: Markus Niebel <oss@ew.tq-group.com>

require conf/machine/include/tqma95xxsa-mb-smarc-2.inc

OEI_RAM_SIZE = "4"
SYSTEM_MANAGER_CONFIG ?= "tqm95_s04g0c000"

UBOOT_CONFIG[sd] = "tqma95xxsa_4gb_mb_smarc_2_defconfig,wic"
```
