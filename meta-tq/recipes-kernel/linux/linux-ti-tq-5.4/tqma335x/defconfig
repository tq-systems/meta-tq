## wic/tqmls1012al.wks
```
# short-description: Create SD card image with a boot partition
# long-description:
# Create an image that can be written onto a SD card using dd for use
# with tqmls1012al
#
# The disk layout used is:
#  -- -------- ------------- ---
# |  | /boot  |    rootfs   |
#  -- -------- ------------- ---
# ^  ^        ^             ^
# |  |        |             |
# 0 4MiB    68MiB        324MiB
#
part /boot --source bootimg-partition --ondisk mmcblk --fstype=vfat --label boot --active --align 4096 --fixed-size 64M
part / --source rootfs --ondisk mmcblk --fstype=ext4 --label root --align 4096 --fixed-size 256M

bootloader --ptable msdos
```

## wic/tqmls1028a-emmcimg.wks
```
# short-description: Create SD card image with a boot partition
# long-description:
# Create an image that can be written onto a SD card using dd for use with
# TQMLS1028a modules
# It uses u-boot as boot loader
#
# The disk layout used is:
#  - --------- -------- ------- ------- -------- ------- --------
# | | rcw-pbi | u-boot |  env  |  PPA  | /boot | rootfs |
#  - --------- -------- ------- ------- -------- ------- --------
# ^ ^         ^        ^       ^       ^       ^        ^
# | |         |        |       |       |       |        |
# 0 4kiB    1MiB     3MiB   4MiB   16MiB   48MiB   304MiB
#

part rcw_pbi --source rawcopy --sourceparams="file=rcw-emmcboot.bin" --no-table --align 4
part u-boot --source rawcopy --sourceparams="file=u-boot.bin-emmc" --no-table --align 1024
part ppa --source rawcopy --sourceparams="file=ppa.itb" --no-table --align 4096
part /boot --source bootimg-partition --fstype=vfat --label boot --active --align 16384 --fixed-size 32M
part / --source rootfs --fstype=ext4 --label root --align 4096 --fixed-size 512M

bootloader --ptable msdos
```

## wic/tqmls102xa-sdimg.wks
```
# short-description: Create SD card image with a boot partition
# long-description:
# Create an image that can be written onto a SD card using dd for use
# with TQMLS102xa modules
# It uses u-boot as boot loader
#
# The disk layout used is:
#  - ---------- ------- -------- --------- ------------- -------------
# | |  u-boot  |  env  | resvd  |  /boot  |    rootfs   |
#  - ---------- ------- -------- --------- ------------- -------------
# ^ ^          ^       ^        ^         ^             ^
# | |          |       |        |         |             |
# 0 4kiB     1MiB    2MiB     4MiB      24MiB        280MiB
#
part u-boot --source rawcopy --sourceparams="file=u-boot.bin-sd" --no-table --align 4
part /boot --source bootimg-partition --fstype=vfat --label boot --active --align 4096 --fixed-size 20M
part / --source rootfs --fstype=ext4 --label root --align 4096

bootloader --ptable msdos
```

## wic/tqmls1043a-sdimg.wks
```
# short-description: Create SD card image with a boot partition
# long-description:
# Create an image that can be written onto a SD card or eMMC using dd for use
# with TQMLS1043a modules
# It uses u-boot as boot loader
#
# The disk layout used is:
#  - ---------- ------- ------------- --------- ------------- -------------
# | |  u-boot  |  env  | fman-ucode  |  /boot  |    rootfs   |
#  - ---------- ------- ------------- --------- ------------- -------------
# ^ ^          ^       ^             ^         ^             ^
# | |          |       |             |         |             |
# 0 4kiB     3MiB    9MiB          16MiB     48MiB        304MiB
#
part u-boot --source rawcopy --sourceparams="file=u-boot.bin-esdhc" --no-table --align 4
part fman-ucode --source rawcopy --sourceparams="file=fsl_fman_ucode_ls1043_r1.1_106_4_18.bin" --no-table --align 9216
part /boot --source bootimg-partition --fstype=vfat --label boot --active --align 16384 --fixed-size 32M
part / --source rootfs --fstype=ext4 --label root --align 4096 --fixed-size 512M

bootloader --ptable msdos
```

## wic/tqmls1046a-emmcimg.wks
```
# short-description: Create eMMC image with a boot partition
# long-description:
# Create an image that can be written onto board eMMC using dd for use
# with TQMLS1046a modules
# It uses u-boot as boot loader
#
# The disk layout used is:
#  - ---------- ------- ------------- --------- ------------- -------------
# | |  u-boot  |  env  | fman-ucode  |  /boot  |    rootfs   |
#  - ---------- ------- ------------- --------- ------------- -------------
# ^ ^          ^       ^             ^         ^             ^
# | |          |       |             |         |             |
# 0 4kiB     3MiB    9MiB          16MiB     48MiB        304MiB
#
part u-boot --source rawcopy --sourceparams="file=u-boot.bin-emmc" --ondisk mmcblk0 --no-table --align 4
part fman-ucode --source rawcopy --sourceparams="file=fsl_fman_ucode_ls1046_r1.0_106_4_18.bin" --ondisk mmcblk0 --no-table --align 9216
part /boot --source bootimg-partition --ondisk mmcblk0 --fstype=vfat --label boot --active --align 16384 --fixed-size 32M
part / --source rootfs --ondisk mmcblk0 --fstype=ext4 --label root --align 4096 --fixed-size 256M

bootloader --ptable msdos
```

## wic/tqmt104x-sdimg.wks
```
# short-description: Create SD card image with a boot partition
# long-description:
# Create an image that can be written onto a SD card or eMMC using dd for use
# with TQMT104x modules
# It uses u-boot as boot loader
#
# The disk layout used is:
#  - ---------- ------- ------------- --------- ------------- -------------
# | |  u-boot  |  env  | fman-ucode  |  /boot  |    rootfs   |
#  - ---------- ------- ------------- --------- ------------- -------------
# ^ ^          ^       ^             ^         ^             ^
# | |          |       |             |         |             |
# 0 4kiB             1040kiB        16MiB     48MiB        304MiB
#
part u-boot --source rawcopy --sourceparams="file=u-boot.bin-sdcard" --no-table --align 4
part fman-ucode --source rawcopy --sourceparams="file=fsl_fman_ucode_t1040_r1.1_107_4_2.bin" --no-table --align 1040
part /boot --source bootimg-partition --fstype=vfat --label boot --active --align 16384 --fixed-size 32M
part / --source rootfs --fstype=ext4 --label root --align 4096 --fixed-size 256M

bootloader --ptable msdos
```
